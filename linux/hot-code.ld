/* The functions the Linux player runs while it plays and sits idle, linked together so the
   pages it keeps are mostly code it uses (docs/memory.md, "Linux code layout").
   Generated by linux/code-profile.sh; refresh it after large code changes. */
SECTIONS
{
  .text.hot_cordinal : ALIGN(4096)
  {
    *(.text._ZNSt17_Function_handlerIFvP6HWND__jmlEZN2lx3RunEiPPcEUlS1_jmlE_E9_M_invokeERKSt9_Any_dataOS1_OjOmOl)
    *(.text._ZN2lx9OpenFilesERKSt6vectorINSt7__cxx1112basic_stringIwSt11char_traitsIwESaIwEEESaIS6_EEb)
    *(.text._ZN2lx8OnRemoteENS_6RemoteEl)
    *(.text._ZN2lx12_GLOBAL__N_1L13DrainMessagesEv)
    *(.text._ZN2lx11CapturePumpEv)
    *(.text._ZN2lx3RunEiPPc)
    *(.text._ZN2lx14FormatForTrackERKNSt7__cxx1112basic_stringIwSt11char_traitsIwESaIwEEEjb)
    *(.text._ZN2lx17UpdateWindowTitleEv)
    *(.text._ZN2lx13SetGpuDrawingEb)
    *(.text._ZN2lx12OnFileChosenEiPNSt7__cxx1112basic_stringIwSt11char_traitsIwESaIwEEE)
    *(.text._ZN2lx15OnFoldersChosenEPSt6vectorINSt7__cxx1112basic_stringIwSt11char_traitsIwESaIwEEESaIS6_EE)
    *(.text._ZN2lx11HandleEventERK9SDL_Event)
    *(.text._ZN2lx16PrefetchWaveformEj)
    *(.text._ZN2lx8SetCoverEPNS_10CoverImageE)
    *(.text._ZN2lx8SetThumbEPNS_10CoverImageE)
    *(.text._ZN2lx12_GLOBAL__N_1L11FlattenMenuERKSt6vectorINS_8MenuItemESaIS2_EERKNSt7__cxx1112basic_stringIcSt11char_traitsIcESaIcEEERS1_INS_14PaletteCommandESaISF_EE)
    *(.text._ZN2lx12RadioRebuildEv)
    *(.text._ZN2lx9InitRadioEv)
    *(.text._ZN2lx11RadioSearchEv)
    *(.text._ZNSt15_Sp_counted_ptrIDnLN9__gnu_cxx12_Lock_policyE2EE10_M_disposeEv)
    *(.text._ZNSt17_Function_handlerIFvP6HWND__jmlEZN2lx3RunEiPPcEUlS1_jmlE_E10_M_managerERSt9_Any_dataRKS8_St18_Manager_operation)
    *(.text._ZNSt23_Sp_counted_ptr_inplaceISt5mutexSaIvELN9__gnu_cxx12_Lock_policyE2EE10_M_disposeEv)
    *(.text._ZNSt5dequeIN2lx12_GLOBAL__N_17MessageESaIS2_EED1Ev)
    *(.text._ZNSt5dequeIN2lx12_GLOBAL__N_17MessageESaIS2_EED2Ev)
    *(.text._ZNSt23_Sp_counted_ptr_inplaceISt5mutexSaIvELN9__gnu_cxx12_Lock_policyE2EED0Ev)
    *(.text._ZNSt23_Sp_counted_ptr_inplaceISt5mutexSaIvELN9__gnu_cxx12_Lock_policyE2EE10_M_destroyEv)
    *(.text._ZNSt16_Sp_counted_baseILN9__gnu_cxx12_Lock_policyE2EE10_M_destroyEv)
    *(.text._ZNSt8_Rb_treeINSt7__cxx1112basic_stringIwSt11char_traitsIwESaIwEEESt4pairIKS5_N2lx15PlaybackSectionEESt10_Select1stISA_ESt4lessIS5_ESaISA_EE8_M_eraseEPSt13_Rb_tree_nodeISA_E.isra.0)
    *(.text._ZNSt6vectorIN2lx5PopupESaIS1_EED1Ev)
    *(.text._ZNSt6vectorIN2lx5PopupESaIS1_EED2Ev)
    *(.text._ZNSt10unique_ptrIN2lx12PlaylistFileESt14default_deleteIS1_EED1Ev)
    *(.text._ZNSt10unique_ptrIN2lx12PlaylistFileESt14default_deleteIS1_EED2Ev)
    *(.text._ZN2lx14RunMenuCommandEm)
    *(.text._ZN2lx14LastInputTicksEv)
    *(.text._ZN2lx9MiniCoverEv)
    *(.text._ZN2lx14CurrentPaletteEv)
    *(.text._ZN2lx10ApplyThemeEv)
    *(.text._ZN2lx11UiAnimatingEv)
    *(.text._ZN2lx17SeekAnimationOnlyEv)
    *(.text._ZN2lx11ShowMessageERKNSt7__cxx1112basic_stringIwSt11char_traitsIwESaIwEEE)
    *(.text._ZN2lx7ConfirmERKNSt7__cxx1112basic_stringIcSt11char_traitsIcESaIcEEEPKc)
    *(.text._ZN2lx6InitUiEv)
    *(.text._ZN2lx10ShutdownUiEv)
    *(.text._ZN2lx14OnScaleChangedEv)
    *(.text._ZN2lx15RefreshTrackArtEj)
    *(.text._ZN2lx14ForgetCoverArtEv)
    *(.text._ZN2lx6RenderEv)
    *(.text._ZN2lx10RenderSeekEv)
    *(.text._ZN2lx6UiBusyEv)
    *(.text._ZN2lx15PrepareWaveformEj)
    *(.text._ZN2lx12OnPeaksReadyEj)
    *(.text._ZN2lx13OpenTrackMenuEff)
    *(.text._ZN2lx10RateTracksERKSt6vectorIjSaIjEEh)
    *(.text._ZNSt10unique_ptrIN2lx10CoverImageESt14default_deleteIS1_EED1Ev)
    *(.text._ZNSt10unique_ptrIN2lx10CoverImageESt14default_deleteIS1_EED2Ev)
    *(.text._ZN2lx8MenuItemD1Ev)
    *(.text._ZN2lx8MenuItemD2Ev)
    *(.text._ZN2lx8MenuItemC1ERKS0_)
    *(.text._ZN2lx8MenuItemC2ERKS0_)
    *(.text._ZN5radio7StationD1Ev)
    *(.text._ZN5radio7StationD2Ev)
    *(.text._ZN2lx13InternetRadioEv)
    *(.text._ZN2lx10LeaveRadioEv)
    *(.text._ZN5radio6SearchD1Ev)
    *(.text._ZN5radio6SearchD2Ev)
    *(.text._ZN5radio7StationC1ERKS0_)
    *(.text._ZN5radio7StationC2ERKS0_)
    *(.text._ZN2lx12RadioSetModeEb)
    *(.text._ZN2lx19RadioToggleFavoriteEi)
    *(.text._ZN2lx9RadioPlayEi)
    *(.text._ZN2lx12RadioPlayingEv)
    *(.text._ZN2lx9RadioTickEv)
    *(.text._ZNSt16_Sp_counted_baseILN9__gnu_cxx12_Lock_policyE2EE10_M_releaseEv)
    *(.text._ZN2lx10RadioStateD1Ev)
    *(.text._ZN2lx10RadioStateD2Ev)
    *(.text._ZN2lx19RadioCancelPlaybackEv)
    *(.text._ZN2lx16RadioEngineEventE11EngineEventy)
    *(.text._ZN2lx12_GLOBAL__N_1L9DecodePngESt17basic_string_viewIcSt11char_traitsIcEEPiS5_PSt6vectorIhSaIhEE)
    *(.text._ZNSt23_Sp_counted_ptr_inplaceINSt7__cxx1112basic_stringIcSt11char_traitsIcESaIcEEESaIvELN9__gnu_cxx12_Lock_policyE2EE14_M_get_deleterERKSt9type_info)
    *(.text._ZNSt6vectorIN2lx12_GLOBAL__N_14PageESaIS2_EED1Ev)
    *(.text._ZNSt6vectorIN2lx12_GLOBAL__N_14PageESaIS2_EED2Ev)
    *(.text.__tcf_ZN2lx12_GLOBAL__N_1L7g_fontsE)
    *(.text._ZNSt6vectorISt10unique_ptrIN2lx4type4FontESt14default_deleteIS3_EESaIS6_EED1Ev)
    *(.text._ZNSt6vectorISt10unique_ptrIN2lx4type4FontESt14default_deleteIS3_EESaIS6_EED2Ev)
    *(.text._ZNSt13unordered_mapIN2lx12_GLOBAL__N_13KeyESt6vectorINS0_4type4Font4QuadESaIS6_EENS1_7KeyHashESt8equal_toIS2_ESaISt4pairIKS2_S8_EEED1Ev)
    *(.text._ZNSt13unordered_mapIN2lx12_GLOBAL__N_13KeyESt6vectorINS0_4type4Font4QuadESaIS6_EENS1_7KeyHashESt8equal_toIS2_ESaISt4pairIKS2_S8_EEED2Ev)
    *(.text._ZNSt23_Sp_counted_ptr_inplaceINSt7__cxx1112basic_stringIcSt11char_traitsIcESaIcEEESaIvELN9__gnu_cxx12_Lock_policyE2EE10_M_disposeEv)
    *(.text._ZN2lx12_GLOBAL__N_1L8FindFontEPKcPNS_5fonts5MatchE)
    *(.text._ZN2lx12_GLOBAL__N_1L6FamilyEPKw)
    *(.text._ZN2lx4Utf8ERKNSt7__cxx1112basic_stringIwSt11char_traitsIwESaIwEEE)
    *(.text._ZN2lx13DeltaruneFontEPm)
    *(.text._ZN2lx7AppIconEi)
    *(.text._ZN2lx12UsesPackFontENS_4FontE)
    *(.text._ZN2lx18UiSymbolsAvailableEv)
    *(.text._ZN2lx14ClearTextCacheEv)
    *(.text._ZN2lx10LineHeightENS_4FontE)
    *(.text._ZN2lx9TextWidthENS_4FontERKNSt7__cxx1112basic_stringIcSt11char_traitsIcESaIcEEE)
    *(.text._ZN2lx6CaretXENS_4FontERKNSt7__cxx1112basic_stringIcSt11char_traitsIcESaIcEEEm)
    *(.text._ZN2lx8DrawTextENS_4FontERKNSt7__cxx1112basic_stringIcSt11char_traitsIcESaIcEEEffjfi)
    *(.text._ZNSt13unordered_mapINSt7__cxx1112basic_stringIcSt11char_traitsIcESaIcEEESt10shared_ptrIKSt17basic_string_viewIcS3_EESt4hashIS5_ESt8equal_toIS5_ESaISt4pairIKS5_SA_EEED1Ev)
    *(.text._ZNSt13unordered_mapINSt7__cxx1112basic_stringIcSt11char_traitsIcESaIcEEESt10shared_ptrIKSt17basic_string_viewIcS3_EESt4hashIS5_ESt8equal_toIS5_ESaISt4pairIKS5_SA_EEED2Ev)
    *(.text._ZNSt6vectorIN2lx12_GLOBAL__N_110MemoryFontESaIS2_EED1Ev)
    *(.text._ZNSt6vectorIN2lx12_GLOBAL__N_110MemoryFontESaIS2_EED2Ev)
    *(.text._ZN7LibraryaSEOS_.isra.0)
    *(.text._ZN2lx12_GLOBAL__N_1L6EnvDirEPKcS2_)
    *(.text._ZNSt7__cxx119to_stringEi)
    *(.text._ZNSt7__cxx119to_stringEm)
    *(.text._ZNSt7__cxx1112basic_stringIcSt11char_traitsIcESaIcEEC1IS3_EEPKcRKS3_)
    *(.text._ZNSt7__cxx1112basic_stringIcSt11char_traitsIcESaIcEEC2IS3_EEPKcRKS3_)
    *(.text._ZN2lx12_GLOBAL__N_1L6LoadEqERKSt3mapINSt7__cxx1112basic_stringIcSt11char_traitsIcESaIcEEES7_St4lessIS7_ESaISt4pairIKS7_S7_EEER10EqSettings.constprop.0)
    *(.text._ZNKSt17basic_string_viewIcSt11char_traitsIcEE7compareES2_)
    *(.text._ZN2lx12LoadSettingsEv)
    *(.text._ZN2lx12StartScannerEv)
    *(.text._ZN2lx15EnsureTagThreadEv)
    *(.text._ZN2lx14StartTagWorkerEv)
    *(.text._ZN2lx13StopTagWorkerEv)
    *(.text._ZN2lx9QueueTagsERKSt6vectorIjSaIjEE)
    *(.text._ZN2lx13QueueChaptersEj)
    *(.text._ZN2lx14AcceptChaptersEPNS_13ChapterResultE)
    *(.text._ZN2lx9AddFolderERKNSt7__cxx1112basic_stringIwSt11char_traitsIwESaIwEEE)
    *(.text._ZN2lx12RemoveFolderEm)
    *(.text._ZN11CueSubtrackD1Ev)
    *(.text._ZN11CueSubtrackD2Ev)
    *(.text._ZN2lx12_GLOBAL__N_1L9TagWorkerEv)
    *(.text._ZN2lx12OnScanResultEP10ScanResultb)
    *(.text._ZN2lx12_GLOBAL__N_1L5QueueEv)
    *(.text._ZNSt5dequeIjSaIjEED1Ev)
    *(.text._ZNSt5dequeIjSaIjEED2Ev)
    *(.text._ZNSt13unordered_mapIyN2lx12_GLOBAL__N_19TokenInfoESt4hashIyESt8equal_toIyESaISt4pairIKyS2_EEED1Ev)
    *(.text._ZNSt13unordered_mapIyN2lx12_GLOBAL__N_19TokenInfoESt4hashIyESt8equal_toIyESaISt4pairIKyS2_EEED2Ev)
    *(.text._ZN2lx12_GLOBAL__N_1L14TrackListeningEv.part.0)
    *(.text._ZNKSt10_HashtableIySt4pairIKyN2lx12_GLOBAL__N_19TokenInfoEESaIS5_ENSt8__detail10_Select1stESt8equal_toIyESt4hashIyENS7_18_Mod_range_hashingENS7_20_Default_ranged_hashENS7_20_Prime_rehash_policyENS7_17_Hashtable_traitsILb0ELb0ELb1EEEE12_M_locate_trIyEENSI_15__location_typeERKT_.constprop.0.isra.0)
    *(.text._ZNSt8__detail9_Map_baseIySt4pairIKyN2lx12_GLOBAL__N_19TokenInfoEESaIS6_ENS_10_Select1stESt8equal_toIyESt4hashIyENS_18_Mod_range_hashingENS_20_Default_ranged_hashENS_20_Prime_rehash_policyENS_17_Hashtable_traitsILb0ELb0ELb1EEELb1EEixERS2_.constprop.0)
    *(.text._ZN2lx12_GLOBAL__N_1L8NewTokenEij)
    *(.text._ZNKSt7__cxx1112basic_stringIwSt11char_traitsIwESaIwEE7compareERKS4_.isra.0)
    *(.text._ZNSt15_Deque_iteratorIiRiPiEpLEl.isra.0)
    *(.text._ZNSt15_Deque_iteratorIjRjPjEpLEl.isra.0)
    *(.text._ZSt16__introsort_loopISt16reverse_iteratorIN9__gnu_cxx17__normal_iteratorIPySt6vectorIySaIyEEEEElSt4lessIvEEvT_SB_T0_T1_.isra.0)
    *(.text._ZSt22__uninitialized_move_aIjRjPjjjESt15_Deque_iteratorIT2_RS3_PS3_ES2_IT_T0_T1_ESA_S6_RSaIT3_E.isra.0)
    *(.text._ZNSt8_Rb_treeINSt7__cxx1112basic_stringIwSt11char_traitsIwESaIwEEESt4pairIKS5_N2lx15PlaybackSectionEESt10_Select1stISA_ESt4lessIS5_ESaISA_EE24_M_get_insert_unique_posERS7_.isra.0)
    *(.text._ZNSt7__cxx1110to_wstringEm)
    *(.text._ZN2lx10HeardIndexEv)
    *(.text._ZN2lx9SectionOfEj)
    *(.text._ZN2lx13SetSectionForEjRKNS_15PlaybackSectionE)
    *(.text._ZN2lx8IsPausedEv)
    *(.text._ZN2lx16EngineHoldsTrackEj)
    *(.text._ZN2lx11QueuedByYouEv)
    *(.text._ZN2lx12_GLOBAL__N_1L11PickIndexAtEmi)
    *(.text._ZN2lx12_GLOBAL__N_1L13PopQueueFrontEv)
    *(.text._ZN2lx12TastePickingEv)
    *(.text._ZN2lx13QueuePositionEj)
    *(.text._ZN2lx10TrackTitleB5cxx11Ej)
    *(.text._ZN2lx11TrackArtistB5cxx11Ej)
    *(.text._ZN2lx11GainOptionsEv)
    *(.text._ZN2lx7GainForEj)
    *(.text._ZN2lx15GainForEstimateEjd)
    *(.text._ZN2lx12RefreshGainsEb)
    *(.text._ZN2lx12ApplyEffectsEv)
    *(.text._ZN2lx7ApplyEqEv)
    *(.text._ZN2lx14UpcomingTracksEv)
    *(.text._ZN2lx12UpNextTracksEv)
    *(.text._ZN2lx9SetVolumeEf)
    *(.text._ZN2lx11SetResumeOnEb)
    *(.text._ZN2lx12SetExclusiveEb)
    *(.text._ZN2lx8SetSpeedEd)
    *(.text._ZN2lx8SetTempoEd)
    *(.text._ZN2lx12PlaybackTickEv)
    *(.text._ZN8PlayItemD1Ev)
    *(.text._ZN8PlayItemD2Ev)
    *(.text._ZN2lx12_GLOBAL__N_1L8MakeItemEyj)
    *(.text._ZN2lx6SeekToEd)
    *(.text._ZStplIwSt11char_traitsIwESaIwEENSt7__cxx1112basic_stringIT_T0_T1_EEOS8_S9_)
    *(.text._ZN2lx15RecordListeningEjdbj)
    *(.text._ZNSt23mersenne_twister_engineImLm32ELm624ELm397ELm31ELm2567483615ELm11ELm4294967295ELm7ELm2636928640ELm15ELm4022730752ELm18ELm1812433253EE11_M_gen_randEv)
    *(.text._ZN2lx12_GLOBAL__N_1L12DrawLikeThisERKSt6vectorIjSaIjEEjb)
    *(.text._ZN2lx12_GLOBAL__N_1L9ReshuffleEi)
    *(.text._ZN2lx12_GLOBAL__N_1L5AfterEib)
    *(.text._ZN2lx12_GLOBAL__N_1L9FollowingEyb)
    *(.text._ZNSt5dequeIjSaIjEE17_M_reallocate_mapEmb)
    *(.text._ZNSt5dequeIjSaIjEE16_M_push_back_auxIJRKjEEEvDpOT_)
    *(.text._ZN2lx12_GLOBAL__N_1L10LeaveTrackEb.part.0)
    *(.text._ZN2lx12_GLOBAL__N_1L10LeaveTrackEb)
    *(.text._ZN2lx4StopEv)
    *(.text._ZN2lx10StartRadioERKN5radio7StationE)
    *(.text._ZN2lx10PlayQueuedEji)
    *(.text._ZN2lx13PlayFromQueueEidb)
    *(.text._ZN2lx6ResumeEv)
    *(.text._ZN2lx15ReopenLastTrackEv)
    *(.text._ZN2lx8PreviousEv)
    *(.text._ZN2lx4NextEv.part.0)
    *(.text._ZN2lx4NextEv)
    *(.text._ZNSt5dequeIiSaIiEE17_M_reallocate_mapEmb)
    *(.text._ZN2lx19EnsureNowPlayingTabEv)
    *(.text._ZN2lx7PlayRowEi)
    *(.text._ZN2lx11TogglePauseEv)
    *(.text._ZN2lx10PlayTracksERKSt6vectorIjSaIjEEid)
    *(.text._ZN2lx8PlaySpotEm)
    *(.text._ZNSt5dequeIjSaIjEE24_M_new_elements_at_frontEm)
    *(.text._ZNSt5dequeIjSaIjEE23_M_new_elements_at_backEm)
    *(.text._ZNSt5dequeIiSaIiEE24_M_new_elements_at_frontEm)
    *(.text._ZNSt5dequeIjSaIjEE13_M_insert_auxIN9__gnu_cxx17__normal_iteratorIPjSt6vectorIjS0_EEEEEvSt15_Deque_iteratorIjRjS5_ET_SC_m)
    *(.text._ZNSt5dequeIjSaIjEE8_M_eraseESt15_Deque_iteratorIjRjPjE)
    *(.text._ZN2lx12_GLOBAL__N_1L14DropTastePicksEv)
    *(.text._ZN2lx16EnsureTastePicksEv)
    *(.text._ZN2lx12_GLOBAL__N_1L10AnswerNextEyb)
    *(.text._ZN2lx11RefreshNextEv)
    *(.text._ZN2lx10ClearQueueEv)
    *(.text._ZN2lx13ToggleShuffleEv)
    *(.text._ZN2lx13OnEngineEventE11EngineEventy)
    *(.text._ZL24stbi__decode_jpeg_headerP10stbi__jpegi.part.0)
    *(.text._ZN2lx12_GLOBAL__N_1L9ReadWholeERKNSt7__cxx1112basic_stringIwSt11char_traitsIwESaIwEEE)
    *(.text._ZN2lx12_GLOBAL__N_1L10CoverBytesERKNSt7__cxx1112basic_stringIwSt11char_traitsIwESaIwEEEb)
    *(.text._ZL16stbi__gif_headerP13stbi__contextP9stbi__gifPii)
    *(.text._ZL16stbi__loadf_mainP13stbi__contextPiS1_S1_i)
    *(.text._ZN2lx12_GLOBAL__N_1L6DecodeERKNSt7__cxx1112basic_stringIcSt11char_traitsIcESaIcEEERNS_10CoverImageEi.isra.0)
    *(.text.stbi_failure_reason)
    *(.text.stbi_image_free)
    *(.text.stbi_set_flip_vertically_on_load)
    *(.text.stbi_set_flip_vertically_on_load_thread)
    *(.text.stbi_load)
    *(.text.stbi_is_16_bit_from_callbacks)
    *(.text._ZN2lx10CoverImageD1Ev)
    *(.text._ZN2lx10CoverImageD2Ev)
    *(.text._ZN2lx12_GLOBAL__N_1L6WorkerEv)
    *(.text._ZN2lx12RequestThumbEji)
    *(.text._ZN2lx12ForgetThumbsEv)
    *(.text._ZN2lx12RequestCoverEj)
    *(.text._ZNSt17_Function_handlerIFvRN2lx4dbus3BusERKNS1_7MessageEEPS7_E9_M_invokeERKSt9_Any_dataS3_S6_)
    *(.text._ZN2lx12_GLOBAL__N_1L20MenuAboutToShowGroupERNS_4dbus4CallE)
    *(.text._ZNSt10unique_ptrIN2lx4dbus3BusESt14default_deleteIS2_EED1Ev)
    *(.text._ZNSt10unique_ptrIN2lx4dbus3BusESt14default_deleteIS2_EED2Ev)
    *(.text._ZN2lx12_GLOBAL__N_1L4SeekERNS_4dbus4CallE)
    *(.text._ZNSt17_Function_handlerIFvRN2lx4dbus3BusERKNS1_7MessageEEPS7_E10_M_managerERSt9_Any_dataRKSA_St18_Manager_operation)
    *(.text._ZNSt7__cxx1112basic_stringIcSt11char_traitsIcESaIcEEaSEOS4_.isra.0)
    *(.text._ZN2lx12_GLOBAL__N_1L10PositionUsERKNS0_8SnapshotE)
    *(.text._ZN2lx12_GLOBAL__N_1L19RegisterWithWatcherEv)
    *(.text._ZN2lx12_GLOBAL__N_1L6SimpleERNS_4dbus4CallE)
    *(.text._ZN2lx12_GLOBAL__N_18SnapshotD1Ev)
    *(.text._ZN2lx12_GLOBAL__N_18SnapshotD2Ev)
    *(.text._ZN2lx12_GLOBAL__N_1L9RadioPathERKNSt7__cxx1112basic_stringIcSt11char_traitsIcESaIcEEE)
    *(.text._ZN2lx12_GLOBAL__N_1L7FileUriERKNSt7__cxx1112basic_stringIcSt11char_traitsIcESaIcEEE)
    *(.text._ZN2lx12_GLOBAL__N_1L10OpenMethodERNS_4dbus4CallE)
    *(.text._ZN2lx12_GLOBAL__N_1L15MenuAboutToShowERNS_4dbus4CallE)
    *(.text._ZN2lx12_GLOBAL__N_1L9TrackPathEj)
    *(.text._ZN2lx12_GLOBAL__N_18SnapshotaSEOS1_.isra.0)
    *(.text._ZN2lx12_GLOBAL__N_1L4SnapEv)
    *(.text._ZN2lx12_GLOBAL__N_1L11MenuClickedEiSt17basic_string_viewIcSt11char_traitsIcEE)
    *(.text._ZN2lx12_GLOBAL__N_1L14MenuEventGroupERNS_4dbus4CallE)
    *(.text._ZN2lx12_GLOBAL__N_1L9MenuEventERNS_4dbus4CallE)
    *(.text._ZN2lx12_GLOBAL__N_1L9SniMethodERNS_4dbus4CallE)
    *(.text._ZN2lx12_GLOBAL__N_1L11SetPositionERNS_4dbus4CallE)
    *(.text._ZN2lx12_GLOBAL__N_1L7OpenUriERNS_4dbus4CallE)
    *(.text._ZN2lx12_GLOBAL__N_1L13AutostartPathEv)
    *(.text._ZN2lx12_GLOBAL__N_1L11MenuEntriesEv)
    *(.text._ZN2lx4dbus6Writer5EntryESt17basic_string_viewIcSt11char_traitsIcEES5_)
    *(.text._ZN2lx4dbus3Bus4SendERKNS0_6TargetESt17basic_string_viewIcSt11char_traitsIcEERKNS0_6WriterE)
    *(.text._ZN2lx9StopMprisEv)
    *(.text._ZN2lx11MprisSetArtEjRKNSt7__cxx1112basic_stringIcSt11char_traitsIcESaIcEEE)
    *(.text._ZN2lx13StartsOnLoginEv)
    *(.text._ZN2lx4dbus6Writer3PutIjEEvT_)
    *(.text._ZN2lx12_GLOBAL__N_1L12MenuPropertyESt17basic_string_viewIcSt11char_traitsIcEERNS_4dbus6WriterE)
    *(.text._ZN2lx12_GLOBAL__N_1L14WriteMenuPropsERNS_4dbus6WriterERKNS0_9MenuEntryE)
    *(.text._ZN2lx12_GLOBAL__N_1L22MenuGetGroupPropertiesERNS_4dbus4CallE)
    *(.text._ZN2lx12_GLOBAL__N_1L13MenuGetLayoutERNS_4dbus4CallE)
    *(.text._ZN2lx4dbus6Writer3PutIdEEvT_)
    *(.text._ZNSt7__cxx1112basic_stringIcSt11char_traitsIcESaIcEE12_M_constructILb1EEEvPKcm)
    *(.text._ZN2lx12_GLOBAL__N_1L7TipBodyERKNS0_8SnapshotE)
    *(.text._ZN2lx12_GLOBAL__N_1L9BarMethodERNS_4dbus4CallE)
    *(.text._ZN2lx12MprisChangedEb)
    *(.text._ZN2lx18ToggleStartOnLoginEv)
    *(.text._ZN2lx12ToggleTopBarEv)
    *(.text._ZN2lx12_GLOBAL__N_1L11SetPropertyESt17basic_string_viewIcSt11char_traitsIcEERNS_4dbus6ReaderE)
    *(.text._ZN2lx12_GLOBAL__N_1L11SniPropertyESt17basic_string_viewIcSt11char_traitsIcEERNS_4dbus6WriterE)
    *(.text._ZN2lx12_GLOBAL__N_1L11GetPropertyESt17basic_string_viewIcSt11char_traitsIcEERNS_4dbus6WriterE)
    *(.text._ZN2lx12_GLOBAL__N_1L9OnMessageERNS_4dbus3BusERKNS1_7MessageE)
    *(.text._ZN2lx4dbus7MessageD1Ev)
    *(.text._ZN2lx4dbus7MessageD2Ev)
    *(.text._ZN2lx16ForwardToRunningERKSt6vectorINSt7__cxx1112basic_stringIcSt11char_traitsIcESaIcEEESaIS6_EE)
    *(.text._ZN2lx12_GLOBAL__N_1L11RegisterAllEv)
    *(.text._ZN2lx12_GLOBAL__N_1L3RunEv)
    *(.text._ZN2lx10StartMprisEv)
    *(.text._ZNSt17_Function_handlerIFvRN2lx4dbus3BusERKNS1_7MessageEEZNS0_6waybar9RunModuleEvEUlS3_S6_E_E9_M_invokeERKSt9_Any_dataS3_S6_)
    *(.text._ZNSt17_Function_handlerIFvRN2lx4dbus3BusERKNS1_7MessageEEZNS0_6waybar9RunModuleEvEUlS3_S6_E_E10_M_managerERSt9_Any_dataRKSB_St18_Manager_operation)
    *(.text._ZNSt7__cxx1112basic_stringIcSt11char_traitsIcESaIcEEC2EPKcmRKS3_.isra.0)
    *(.text._ZN2lx6waybar8SetShownEb)
    *(.text._ZNSt7__cxx1112basic_stringIcSt11char_traitsIcESaIcEE12_M_constructIPKcEEvT_S8_St20forward_iterator_tag.isra.0)
    *(.text._ZN2lx4dbus12_GLOBAL__N_1L4FindESt4spanIKNS0_9InterfaceELm18446744073709551615EESt17basic_string_viewIcSt11char_traitsIcEES9_)
    *(.text._ZNSt7__cxx1112basic_stringIcSt11char_traitsIcESaIcEE6appendEPKcm.isra.0)
    *(.text._ZN2lx4dbus6Writer1SESt17basic_string_viewIcSt11char_traitsIcEE)
    *(.text._ZN2lx4dbus6Writer1GESt17basic_string_viewIcSt11char_traitsIcEE)
    *(.text._ZZN2lx4dbus3Bus5QueueEhhRKNS0_6TargetESt17basic_string_viewIcSt11char_traitsIcEERKNS0_6WriterEjS8_ENKUlhPKcS8_E_clEhSD_S8_)
    *(.text._ZN2lx4dbus6Writer4OpenEm)
    *(.text._ZN2lx4dbus6Writer5CloseENS1_5ArrayE)
    *(.text._ZN2lx4dbus6Writer7StringsESt16initializer_listISt17basic_string_viewIcSt11char_traitsIcEEE)
    *(.text._ZN2lx4dbus6Reader5AlignEm)
    *(.text._ZN2lx4dbus6Reader5FixedIjEET_v)
    *(.text._ZN2lx4dbus6Reader5FixedImEET_v)
    *(.text._ZN2lx4dbus6Reader1YEv)
    *(.text._ZN2lx4dbus6Reader1BEv)
    *(.text._ZN2lx4dbus6Reader1DEv)
    *(.text._ZN2lx4dbus6Reader1SEv)
    *(.text._ZN2lx4dbus6Reader1OEv)
    *(.text._ZN2lx4dbus6Reader4OpenEm)
    *(.text._ZN2lx4dbus10TypeLengthESt17basic_string_viewIcSt11char_traitsIcEEmi)
    *(.text._ZN2lx4dbus10TypeLengthESt17basic_string_viewIcSt11char_traitsIcEEmi.constprop.0)
    *(.text._ZN2lx4dbus6Reader1GEv)
    *(.text._ZN2lx4dbus6Reader4WalkERSt17basic_string_viewIcSt11char_traitsIcEEi.part.0)
    *(.text._ZN2lx4dbus6Reader4WalkERSt17basic_string_viewIcSt11char_traitsIcEEi)
    *(.text._ZN2lx4dbus6Reader4SkipESt17basic_string_viewIcSt11char_traitsIcEE)
    *(.text._ZN2lx4dbus14ValidSignatureESt17basic_string_viewIcSt11char_traitsIcEE)
    *(.text._ZN2lx4dbus9ValidPathESt17basic_string_viewIcSt11char_traitsIcEE)
    *(.text._ZN2lx4dbus12ParseMessageESt17basic_string_viewIcSt11char_traitsIcEERNS0_7MessageERm)
    *(.text._ZN2lx4dbus3Bus5CloseEv)
    *(.text._ZN2lx4dbus3Bus7WaitForEsl)
    *(.text._ZN2lx4dbus3Bus7ConnectERKNS0_7AddressEl)
    *(.text._ZN2lx4dbus3Bus4ReadEv)
    *(.text._ZN2lx4dbus3Bus5FlushEv)
    *(.text._ZN2lx4dbus3Bus12AuthenticateEl)
    *(.text._ZN2lx4dbus3BusD1Ev)
    *(.text._ZN2lx4dbus3BusD2Ev)
    *(.text._ZN2lx4dbus3Bus4NextERNS0_7MessageE)
    *(.text._ZNK2lx4dbus3Bus6EventsEv)
    *(.text._ZNK2lx4dbus3Bus9TimeoutMsEv)
    *(.text._ZN2lx4dbus3Bus5QueueEhhRKNS0_6TargetESt17basic_string_viewIcSt11char_traitsIcEERKNS0_6WriterEjS8_)
    *(.text._ZN2lx4dbus3Bus4CallERKNS0_6TargetESt17basic_string_viewIcSt11char_traitsIcEERKNS0_6WriterEiSt8functionIFvPKNS0_7MessageEEE)
    *(.text._ZN2lx4dbus3Bus8CallSyncERKNS0_6TargetESt17basic_string_viewIcSt11char_traitsIcEERKNS0_6WriterEi)
    *(.text._ZN2lx4dbus3Bus6SignalESt17basic_string_viewIcSt11char_traitsIcEES5_S5_S5_RKNS0_6WriterE)
    *(.text._ZN2lx4dbus3Bus5ReplyERKNS0_7MessageESt17basic_string_viewIcSt11char_traitsIcEERKNS0_6WriterE)
    *(.text._ZN2lx4dbus3Bus5ErrorERKNS0_7MessageESt17basic_string_viewIcSt11char_traitsIcEES8_)
    *(.text._ZZN2lx4dbus8DispatchERNS0_3BusERKNS0_7MessageESt4spanIKNS0_9InterfaceELm18446744073709551615EEENKUlPKcSB_E_clESB_SB_)
    *(.text._ZN2lx4dbus3Bus7DeliverERNS0_7MessageE)
    *(.text._ZN2lx4dbus3Bus7ProcessEi)
    *(.text._ZN2lx4dbus11EmitChangedERNS0_3BusERKNS0_9InterfaceESt4spanIKPKcLm18446744073709551615EE)
    *(.text._ZNSt6vectorIN2lx4dbus7AddressESaIS2_EED1Ev)
    *(.text._ZNSt6vectorIN2lx4dbus7AddressESaIS2_EED2Ev)
    *(.text._ZN2lx4dbus14ParseAddressesESt17basic_string_viewIcSt11char_traitsIcEE)
    *(.text._ZN2lx4dbus12_GLOBAL__N_1L10IntrospectESt17basic_string_viewIcSt11char_traitsIcEESt4spanIKNS0_9InterfaceELm18446744073709551615EE)
    *(.text._ZN2lx4dbus8DispatchERNS0_3BusERKNS0_7MessageESt4spanIKNS0_9InterfaceELm18446744073709551615EE)
    *(.text._ZNSt17_Function_handlerIFvvEZN2lx12_GLOBAL__N_1L11StartRemoteEvEUlvE_E10_M_managerERSt9_Any_dataRKS5_St18_Manager_operation)
    *(.text._ZNSt17_Function_handlerIFvvEZN2lx8StartWebEvEUlvE_E10_M_managerERSt9_Any_dataRKS4_St18_Manager_operation)
    *(.text._ZNSt17_Function_handlerIFvvEZN2lx12_GLOBAL__N_1L11StartRemoteEvEUlvE_E9_M_invokeERKSt9_Any_data)
    *(.text._ZNSt17_Function_handlerIFvvEZN2lx8StartWebEvEUlvE_E9_M_invokeERKSt9_Any_data)
    *(.text._ZN2lx12_GLOBAL__N_1L13AcceptListensEv)
    *(.text._ZN2lx8StartWebEv)
    *(.text._ZN2lx7InitWebEv)
    *(.text._ZN2lx7StopWebEv)
    *(.text._ZN2lx10WebRunningEv)
    *(.text._ZN2lx9WebStatusEv)
    *(.text._ZN2lx7PairWebEv)
    *(.text._ZN2lx16FinishReplayGainEml)
    *(.text._ZN2lx16ReplayGainStatusB5cxx11Ev)
    *(.text._ZN2lx14ScanReplayGainERKSt6vectorIjSaIjEE)
    *(.text._ZN2lx16MaybeAutoMeasureEb)
    *(.text._ZNSt6vectorIN2lx12_GLOBAL__N_18DeferredESaIS2_EED1Ev)
    *(.text._ZNSt6vectorIN2lx12_GLOBAL__N_18DeferredESaIS2_EED2Ev)
    *(.text._ZNSt6thread11_State_implINS_8_InvokerISt5tupleIJPFvN2lx12_GLOBAL__N_18WriteJobEES5_EEEEED0Ev)
    *(.text._ZNSt6thread11_State_implINS_8_InvokerISt5tupleIJPFvN2lx12_GLOBAL__N_18WriteJobEES5_EEEEE6_M_runEv)
    *(.text._ZN2lx12TagWriteBusyEv)
    *(.text._ZN2lx14TagWriteStatusB5cxx11Ev)
    *(.text._ZN2lx17OnTagWriteMessageEml)
    *(.text._ZN2lx5panel12_GLOBAL__N_1L12kWebFetchOpsMUliRKNSt7__cxx1112basic_stringIwSt11char_traitsIwESaIwEEEE_4_FUNEiSA_)
    *(.text._ZN2lx5panel12_GLOBAL__N_1L12kWebFetchOpsMUlffiE_4_FUNEffi)
    *(.text._ZN2lx5panel12_GLOBAL__N_1L10kExportOpsMUlffiE_4_FUNEffi)
    *(.text._ZN2lx5panel12_GLOBAL__N_1L10kArtistOpsMUlffiE_4_FUNEffi)
    *(.text._ZN2lx5panel12_GLOBAL__N_1L11CloseCoversEv)
    *(.text._ZN2lx5panel12_GLOBAL__N_1L10kCoversOpsMUliRKNSt7__cxx1112basic_stringIwSt11char_traitsIwESaIwEEEE_4_FUNEiSA_)
    *(.text._ZN2lx5panel12_GLOBAL__N_1L10kCoversOpsMUlffiE_4_FUNEffi)
    *(.text._ZN2lx5panel12_GLOBAL__N_1L10kCoversOpsMUlRK7PaletteE_4_FUNES5_)
    *(.text._ZN2lx5panel12_GLOBAL__N_1L12kEditionsOpsMUlffiE_4_FUNEffi)
    *(.text._ZN2lx5panel12_GLOBAL__N_1L9kGamesOpsMUlffiE_4_FUNEffi)
    *(.text._ZN2lx5panel12_GLOBAL__N_1L9kGamesOpsMUlRK7PaletteE_4_FUNES5_)
    *(.text._ZN2lx5panel12_GLOBAL__N_1L14kHeadphonesOpsMUlfffE_4_FUNEfff)
    *(.text._ZN2lx5panel12_GLOBAL__N_1L14kHeadphonesOpsMUlffiE_4_FUNEffi)
    *(.text._ZN2lx5panel12_GLOBAL__N_1L9kGamesOpsMUlPKcE_4_FUNES4_)
    *(.text._ZN2lx5panelL10PostChosenEPvPKPKci)
    *(.text._ZN2lx5panel12_GLOBAL__N_1L12kEditionsOpsMUlPKcE_4_FUNES4_)
    *(.text._ZN2lx7PolygonERKSt6vectorI10SDL_FPointSaIS1_EEjf)
    *(.text._ZN2lx4WrapENS_4FontERKNSt7__cxx1112basic_stringIcSt11char_traitsIcESaIcEEEf)
    *(.text._ZN2lx14OpenHeadphonesEv)
    *(.text._ZN2lx9OpenGamesEi)
    *(.text._ZN2lx9GamesOpenEv)
    *(.text._ZN2lx17OpenAlbumEditionsEj)
    *(.text._ZN2lx26OpenAlbumEditionComparisonEjj)
    *(.text._ZN2lx18ResetPanelRendererEb)
    *(.text._ZN2lx9PanelOpenEv)
    *(.text._ZN2lx10ClosePanelEv)
    *(.text._ZN2lx12OpenOrganizeESt6vectorIjSaIjEE)
    *(.text._ZN2lx18PanelReplanPendingEv)
    *(.text._ZNSt6vectorI10CopyRecordSaIS0_EED1Ev)
    *(.text._ZNSt6vectorI10CopyRecordSaIS0_EED2Ev)
    *(.text._ZZN2lx5panel12_GLOBAL__N_1L5BuildEvENKUlNSt7__cxx1112basic_stringIcSt11char_traitsIcESaIcEEERKNS3_IwS4_IwESaIwEEEE_clES7_SC_.isra.0)
    *(.text._ZN2lx12RememberSpotEjd)
    *(.text._ZN2lx10ForgetSpotEj)
    *(.text._ZN2lx12HasComebacksEv)
    *(.text._ZN2lx5panel12_GLOBAL__N_1L5BuildEv)
    *(.text._ZN2lx5panel12_GLOBAL__N_1L11DrawPaletteERK7Palette)
    *(.text._ZN2lx19PickerOnlinePendingEv)
    *(.text._ZN2lx16StopPickerOnlineEv)
    *(.text._ZN2lx14SongPickerRowsB5cxx11Ev)
    *(.text._ZN2lx16PickerOnlineTickEv)
    *(.text._ZN2lx12_GLOBAL__N_1L13PresetLayoutsEv)
    *(.text._ZNSt7__cxx1112basic_stringIwSt11char_traitsIwESaIwEEC1IS3_EEPKwRKS3_)
    *(.text._ZNSt7__cxx1112basic_stringIwSt11char_traitsIwESaIwEEC2IS3_EEPKwRKS3_)
    *(.text._ZN8speakers7SpeakerD1Ev)
    *(.text._ZN8speakers7SpeakerD2Ev)
    *(.text._ZN2lx7PackRowD1Ev)
    *(.text._ZN2lx7PackRowD2Ev)
    *(.text._ZN2lx9HelperRowD1Ev)
    *(.text._ZN2lx9HelperRowD2Ev)
    *(.text._ZN2lx11OpenHelpersEv)
    *(.text._ZN2lx9OpenPacksEv)
    *(.text._ZN2lx10OpenLayoutEv)
    *(.text._ZNK2lx12WindowLayouteqERKS0_)
    *(.text._ZN2lx15RunLayoutActionEii)
    *(.text._ZNSt17_Function_handlerIFviEZN2lx5panel12_GLOBAL__N_1L14LayoutActivateEiEUliE1_E9_M_invokeERKSt9_Any_dataOi)
    *(.text._ZN2lx16OpenOutputDeviceEv)
    *(.text._ZN2lx10OpenFormatEv)
    *(.text._ZN2lx12_GLOBAL__N_1L16LayoutBarButtonsEv)
    *(.text._ZN2lx13DrawLayoutBarERK7Palette)
    *(.text._ZN2lx18LayoutBarMouseDownEff)
    *(.text._ZN2lx5panel12_GLOBAL__N_1L12ChooseDeviceEi)
    *(.text._ZN2lx5panel12_GLOBAL__N_1L9DeviceKeyERK17SDL_KeyboardEvent)
    *(.text._ZN2lx5panel10kDeviceOpsMUlffiE_4_FUNEffi)
    *(.text._ZNSt10unique_ptrISt6vectorIN8speakers7SpeakerESaIS2_EESt14default_deleteIS4_EED1Ev)
    *(.text._ZNSt10unique_ptrISt6vectorIN8speakers7SpeakerESaIS2_EESt14default_deleteIS4_EED2Ev)
    *(.text._ZN2lx5panel12_GLOBAL__N_1L5StartEv)
    *(.text._ZN2lx5panel12_GLOBAL__N_1L3KeyERK17SDL_KeyboardEvent)
    *(.text._ZN2lx5panel17ConvertPanelDirtyEv)
    *(.text._ZN2lx11OpenConvertESt6vectorIjSaIjEE)
    *(.text._ZN2lx5panel12_GLOBAL__N_1L9MouseDownEff)
    *(.text._ZStplIwSt11char_traitsIwESaIwEENSt7__cxx1112basic_stringIT_T0_T1_EERKS8_PKS5_.constprop.0)
    *(.text._ZN2lx11ConvertBusyEv)
    *(.text._ZN2lx17CanUndoConversionEv)
    *(.text._ZN2lx11InitConvertEv)
    *(.text._ZN2lx17PlanConvertTracksERKSt6vectorIjSaIjEE10CordExportbRKNSt7__cxx1112basic_stringIwSt11char_traitsIwESaIwEEE)
    *(.text._ZN2lx15DrawExportPanelERK7Palette)
    *(.text._ZNSt7__cxx1112basic_stringIwSt11char_traitsIwESaIwEE12_M_constructILb1EEEvPKwm)
    *(.text._ZNSt17_Function_handlerIFvRN2lx12_GLOBAL__N_14DoneEEZNS1_L9ConfirmedERKNSt7__cxx1112basic_stringIwSt11char_traitsIwESaIwEEEEUlS3_E_E10_M_managerERSt9_Any_dataRKSF_St18_Manager_operation)
    *(.text._ZNSt17_Function_handlerIFvRN2lx12_GLOBAL__N_14DoneEEZNS0_19OnCollectionMessageEmlEUlS3_E_E10_M_managerERSt9_Any_dataRKS7_St18_Manager_operation)
    *(.text._ZN2lx12_GLOBAL__N_1L12FinishImportERNS0_4DoneE)
    *(.text._ZN2lxL14MovePaneCursorERNS_12_GLOBAL__N_14PaneEib)
    *(.text._ZN2lx15ViewButtonLabelEi)
    *(.text._ZN2lx16BrowserShowValueENS_11BrowseFieldEj)
    *(.text._ZN2lx13ToggleBrowserEv)
    *(.text._ZN2lx12BrowserShownEv)
    *(.text._ZN2lx13BrowserHeightEv)
    *(.text._ZN2lx16SetBrowserHeightEf)
    *(.text._ZN2lx16BrowserMouseDownERKNS_4RectEffiit)
    *(.text._ZN2lx12_GLOBAL__N_1L12DrawTrackRowERKNS0_5AlbumEiRKNS_4RectEbRK7Palette)
    *(.text._ZN2lx9ThickLineEfffffj)
    *(.text._ZN2lx21CanvasScrollAnimatingEv)
    *(.text._ZN2lx16TickCanvasScrollEv)
    *(.text._ZN2lx14SetLibraryModeENS_11LibraryModeE)
    *(.text._ZN2lx12CanvasActiveEv)
    *(.text._ZN2lx17OpenEditionChoiceEiff)
    *(.text._ZN2lx12_GLOBAL__N_1L10MakeListenEj)
    *(.text._ZN2lx12InitScrobbleEv)
    *(.text._ZN2lx12StopScrobbleEv)
    *(.text._ZN2lx11StopDiscordEv)
    *(.text._ZN2lx11DiscordTickEv)
    *(.text._ZN2lx13GroupedNumberB5cxx11Em)
    *(.text._ZN2lx18CurrentPointsLevelEv)
    *(.text._ZN2lx19PointsChipAnimatingEv)
    *(.text._ZN2lx14StepPointsChipEv)
    *(.text._ZN2lx14DrawPointsChipERKNS_4RectERK7Palette)
    *(.text._ZSt21__inplace_stable_sortIN9__gnu_cxx17__normal_iteratorIPSt4pairIdNSt7__cxx1112basic_stringIwSt11char_traitsIwESaIwEEEESt6vectorIS9_SaIS9_EEEEZN2lx12_GLOBAL__N_1L11ParseLyricsERKS8_RbEUlRKT_RKT0_E_EvSK_SK_SN_.isra.0)
    *(.text._ZN6online11LyricsQueryD1Ev)
    *(.text._ZN6online11LyricsQueryD2Ev)
    *(.text._ZN2lx11LyricsShownEv)
    *(.text._ZN2lx11LyricsWidthEv)
    *(.text._ZN2lx12ToggleLyricsEv)
    *(.text._ZN2lx10StopLyricsEv)
    *(.text._ZN2lx15LyricsAnimatingEv)
    *(.text._ZN2lx20CanSaveFetchedLyricsEb)
    *(.text._ZN2lx20LyricsSourcesChangedEv)
    *(.text._ZN2lx11LyricsWheelEf)
    *(.text._ZN2lx15LyricsMouseDownEff)
    *(.text._ZNSt6thread11_State_implINS_8_InvokerISt5tupleIJPFvjNSt7__cxx1112basic_stringIwSt11char_traitsIwESaIwEEEmN6online11LyricsQueryESt10shared_ptrINS9_6CancelEEEjS8_mSA_SD_EEEEED1Ev)
    *(.text._ZNSt6thread11_State_implINS_8_InvokerISt5tupleIJPFvjNSt7__cxx1112basic_stringIwSt11char_traitsIwESaIwEEEmN6online11LyricsQueryESt10shared_ptrINS9_6CancelEEEjS8_mSA_SD_EEEEED2Ev)
    *(.text._ZN2lx12_GLOBAL__N_1L9StartLoadEv)
    *(.text._ZN2lx14OnLyricsLoadedEl)
    *(.text._ZN2lx10LyricsTickEv)
    *(.text._ZN2lx17SaveFetchedLyricsEb)
    *(.text._ZN2lx9LeaveMiniEv.part.0)
    *(.text._ZN2lx12_GLOBAL__N_1L6CircleEfffi.constprop.0)
    *(.text._ZN2lx12_GLOBAL__N_1L6PartAtEff)
    *(.text._ZN2lx10MiniActiveEv)
    *(.text._ZN2lx9LeaveMiniEv)
    *(.text._ZN2lx10ToggleMiniEv)
    *(.text._ZN2lx8DrawMiniERK7Palette)
    *(.text._ZN2lx9MiniEventERK9SDL_Event)
    *(.text._ZN2lx16EnterLightweightEv.part.0)
    *(.text._ZN2lx16LeaveLightweightEb.part.0)
    *(.text._ZN2lx22LightweightHidesWindowEv)
    *(.text._ZN2lx21LightweightPausesWorkEv)
    *(.text._ZN2lx16EnterLightweightEv)
    *(.text._ZN2lx16LeaveLightweightEb)
    *(.text._ZN2lx17ToggleLightweightEv)
    *(.text._ZN2lx22LightweightSizeChangedENS_8ViewSizeE)
    *(.text._ZN2lx29LightweightPreferencesChangedEv)
    *(.text._ZN2lx22OpenSongPickerFromTrayEv)
    *(.text._ZN2lx23LightweightPickerClosedEv)
    *(.text._ZN2lx14LightweightKeyERK17SDL_KeyboardEvent)
    *(.text._ZN2lx12_GLOBAL__N_1L5FieldESt17basic_string_viewIcSt11char_traitsIcEES4_)
    *(.text._ZN2lx12_GLOBAL__N_1L12ReadProcFileEPKc)
    *(.text._ZN2lx18DropCleanFilePagesEv)
    *(.text._ZN2lx18PrepareCodeProfileEv)
    *(.text._ZN2lx14GiveMemoryBackEv)
    *(.text._ZN2lx13ResidentBytesEv)
    *(.text._ZN2lx18GiveMemoryBackSoonEv)
    *(.text._ZN2lx10MemoryTickEv)
    *(.text._ZN2lx12_GLOBAL__N_1L6NameOfERKNS_14PaletteCommandE)
    *(.text._ZNSt6vectorISt10unique_ptrIN2lx12_GLOBAL__N_16LoadedESt14default_deleteIS3_EESaIS6_EED1Ev)
    *(.text._ZNSt6vectorISt10unique_ptrIN2lx12_GLOBAL__N_16LoadedESt14default_deleteIS3_EESaIS6_EED2Ev)
    *(.text._ZSteqIwSt11char_traitsIwESaIwEEbRKNSt7__cxx1112basic_stringIT_T0_T1_EEPKS5_)
    *(.text._ZN2lx12_GLOBAL__N_1L11FindCommandERKSt6vectorINS_14PaletteCommandESaIS2_EERKNSt7__cxx1112basic_stringIwSt11char_traitsIwESaIwEEE)
    *(.text._ZN2lx17GlobalKeyTriggersB5cxx11Ev)
    *(.text._ZN2lx18StopPackGlobalKeysEv)
    *(.text._ZN2lx20PackGlobalKeysActiveEv)
    *(.text._ZN2lx11ColumnTotalEv)
    *(.text._ZN2lx8ColumnAtEi)
    *(.text._ZN2lx14PackColumnTypeERKNSt7__cxx1112basic_stringIcSt11char_traitsIcESaIcEEE)
    *(.text._ZN2lx14LayoutOfValuesERK10IniSection)
    *(.text._ZN2lx11PackLayoutsEv)
    *(.text._ZN2lx15ApplyPackLayoutEm)
    *(.text._ZN2lx15EffectiveFormatE14PackFormatSlotRKNSt7__cxx1112basic_stringIwSt11char_traitsIwESaIwEEE)
    *(.text._ZN2lx13PackGroupLookEv)
    *(.text._ZN2lx16PackOwningFormatE14PackFormatSlot)
    *(.text._ZN2lx12PackThemeForE9ThemeMode)
    *(.text._ZN2lx9PackFieldEjRKNSt7__cxx1112basic_stringIwSt11char_traitsIwESaIwEEERS5_)
    *(.text._ZN2lx12AllEqPresetsEv)
    *(.text._ZN2lx9PackCountEv)
    *(.text._ZN12StarterSetupD1Ev)
    *(.text._ZN12StarterSetupD2Ev)
    *(.text._ZNSt6vectorI13TitleFunctionSaIS0_EED1Ev)
    *(.text._ZNSt6vectorI13TitleFunctionSaIS0_EED2Ev)
    *(.text._ZSteqIcSt11char_traitsIcESaIcEEbRKNSt7__cxx1112basic_stringIT_T0_T1_EEPKS5_)
    *(.text._ZSteqIcSt11char_traitsIcESaIcEEbRKNSt7__cxx1112basic_stringIT_T0_T1_EESA_)
    *(.text._ZN2lx11PackKeyDownERK17SDL_KeyboardEvent)
    *(.text._ZN2lx18TickPackGlobalKeysEv)
    *(.text._ZN2lx13PackColumnKeyB5cxx11Ei)
    *(.text._ZN2lx19AddPackAutoPlaylistEm)
    *(.text._ZZN2lx9LoadPacksEvENKUlRT_RT0_E_clISt4pairINSt7__cxx1112basic_stringIcSt11char_traitsIcESaIcEEEbESD_EEDaS1_S3_.isra.0)
    *(.text._ZN2lx12_GLOBAL__N_1L8FailuresERKNS0_8ToolDoneE)
    *(.text._ZN2lx11HelperCountEv)
    *(.text._ZN2lx23HelperVisualizerRunningEm)
    *(.text._ZN2lx24HelperVisualizersRunningEv)
    *(.text._ZN2lx21TickHelperVisualizersEv)
    *(.text._ZN2lx12_GLOBAL__N_1L7DrawBoxERKNS_4RectEbbRK7Palette)
    *(.text._ZN2lx26ResetPreferenceSuggestionsEv)
    *(.text._ZN2lx25FlushAutomaticPreferencesEv)
    *(.text._ZN2lx19SetPreferenceSavingENS_16PreferenceSavingE)
    *(.text._ZN2lx19ShowStartupDefaultsEb)
    *(.text._ZN2lx17StartupReviewOpenEv)
    *(.text._ZN2lx19OpenStartupDefaultsEv)
    *(.text._ZN2lx14PreferenceTickEm)
    *(.text._ZN2lx22StartupReviewMouseDownEffi)
    *(.text._ZN2lx17DrawStartupReviewERK7Paletteff)
    *(.text._ZN2lx12_GLOBAL__N_1L8RelayoutEv)
    *(.text._ZN2lx17ResetGameRendererEb)
    *(.text._ZN2lx14GamesAnimatingEv)
    *(.text._ZN2lx14GamesWantsTextEff)
    *(.text._ZNSt6vectorISt6threadSaIS0_EED1Ev)
    *(.text._ZNSt6vectorISt6threadSaIS0_EED2Ev)
    *(.text._ZN2lx10CloseGamesEv)
    *(.text._ZN2lx12_GLOBAL__N_1L15DrawSaveChoicesERA3_NS_4RectEffRK7Palette)
    *(.text._ZN2lx5FrameERKNS_4RectEj)
    *(.text._ZN6online14CoverCandidateD1Ev)
    *(.text._ZN6online14CoverCandidateD2Ev)
    *(.text._ZN6online10CoverFoundD1Ev)
    *(.text._ZN6online10CoverFoundD2Ev)
    *(.text._ZNSt6thread11_State_implINS_8_InvokerISt5tupleIJZN2lx12_GLOBAL__N_1L7TakeOwnENSt7__cxx1112basic_stringIcSt11char_traitsIcESaIcEEESA_SA_SA_EUlvE_EEEEE6_M_runEv)
    *(.text._ZNSt17_Function_handlerIFvON6online10CoverFoundEEZZN2lx12_GLOBAL__N_1L11StartSearchEvENKUlvE_clEvEUlS2_E_E9_M_invokeERKSt9_Any_dataS2_)
    *(.text._ZN10coverfetch5AlbumD1Ev)
    *(.text._ZN10coverfetch5AlbumD2Ev)
    *(.text._ZN6online10CoverFoundC1EOS0_)
    *(.text._ZN6online10CoverFoundC2EOS0_)
    *(.text._ZN10coverfetch11CoverChoiceD1Ev)
    *(.text._ZN10coverfetch11CoverChoiceD2Ev)
    *(.text._ZN2lx16IsCoverImageFileERKNSt7__cxx1112basic_stringIwSt11char_traitsIwESaIwEEE)
    *(.text._ZN2lx15ChooseCoverFileERKSt6vectorIjSaIjEE)
    *(.text._ZN2lx5panel21OnReleaseRadarMessageEml)
    *(.text._ZN2lx21OnReleaseRadarMessageEml)
    *(.text._ZN2lx5panel12RadarMessageEml)
    *(.text._ZNSt17_Function_handlerIFbRKNSt7__cxx1112basic_stringIwSt11char_traitsIwESaIwEEERS5_EZN2lx6LookupB5cxx11EjbEUlS7_S8_E_E10_M_managerERSt9_Any_dataRKSD_St18_Manager_operation)
    *(.text._ZNSt17_Function_handlerIFbRKNSt7__cxx1112basic_stringIwSt11char_traitsIwESaIwEEERS5_EZN2lx15GroupHeaderTextES7_RKNSA_5GroupEEUlS7_S8_E_E10_M_managerERSt9_Any_dataRKSG_St18_Manager_operation)
    *(.text._ZNSt6vectorIjSaIjEEaSERKS1_.isra.0)
    *(.text._ZNSt7__cxx1112basic_stringIwSt11char_traitsIwESaIwEEaSEOS4_.isra.0)
    *(.text._ZN8PlaylistaSEOS_.isra.0)
    *(.text._ZNSt17_Function_handlerIFbRKNSt7__cxx1112basic_stringIwSt11char_traitsIwESaIwEEERS5_EZN2lx15GroupHeaderTextES7_RKNSA_5GroupEEUlS7_S8_E_E9_M_invokeERKSt9_Any_dataS7_S8_)
    *(.text._ZNSt17_Function_handlerIFbRKNSt7__cxx1112basic_stringIwSt11char_traitsIwESaIwEEERS5_EZN2lx6LookupB5cxx11EjbEUlS7_S8_E_E9_M_invokeERKSt9_Any_dataS7_S8_)
    *(.text._ZN2lx6ActiveEv)
    *(.text._ZN2lx15NowPlayingIndexEv)
    *(.text._ZN2lx6LookupB5cxx11Ejb)
    *(.text._ZN2lx14CompareNaturalERKNSt7__cxx1112basic_stringIwSt11char_traitsIwESaIwEEES7_)
    *(.text._ZN2lx11CompareTextESt17basic_string_viewIwSt11char_traitsIwEES3_)
    *(.text._ZN2lx11LibraryLessEjj)
    *(.text._ZN2lx15SortKeepsAlbumsEi)
    *(.text._ZN2lx9GroupLookEv)
    *(.text._ZN2lx15GroupHeaderTextERKNSt7__cxx1112basic_stringIwSt11char_traitsIwESaIwEEERKNS_5GroupE)
    *(.text._ZN2lx14GroupHidesCellERKNS_4LineEi)
    *(.text._ZN2lx13CellTextWidthERKNS_4LineEmf)
    *(.text._ZN2lx14SelectedTracksEv)
    *(.text._ZN2lx10SelectOnlyEi)
    *(.text._ZN2lx11SelectRangeEii)
    *(.text._ZN2lx9MoveFocusEib)
    *(.text._ZN2lx18ExcludeFromLibraryERKSt6vectorIjSaIjEE)
    *(.text._ZN2lx19CanStepPlaylistEditEbPNSt7__cxx1112basic_stringIwSt11char_traitsIwESaIwEEE)
    *(.text._ZN2lx19InvalidateCellCacheEv)
    *(.text._ZN2lx20NowPlayingAlbumTrackEv)
    *(.text._ZSt24__merge_sort_with_bufferIN9__gnu_cxx17__normal_iteratorIPjSt6vectorIjSaIjEEEES2_ZN2lx18SortPlaylistTracksERS5_RK8PlaylistEUljjE_EvT_SD_T0_T1_)
    *(.text._ZNSt10_HashtableImSt4pairIKmNSt7__cxx1112basic_stringIcSt11char_traitsIcESaIcEEEESaIS8_ENSt8__detail10_Select1stESt8equal_toImESt4hashImENSA_18_Mod_range_hashingENSA_20_Default_ranged_hashENSA_20_Prime_rehash_policyENSA_17_Hashtable_traitsILb0ELb0ELb1EEEE21_M_insert_unique_nodeEmmPNSA_10_Hash_nodeIS8_Lb0EEEm)
    *(.text._ZNSt10_HashtableImSt4pairIKmNSt7__cxx1112basic_stringIcSt11char_traitsIcESaIcEEEESaIS8_ENSt8__detail10_Select1stESt8equal_toImESt4hashImENSA_18_Mod_range_hashingENSA_20_Default_ranged_hashENSA_20_Prime_rehash_policyENSA_17_Hashtable_traitsILb0ELb0ELb1EEEE15_M_emplace_uniqIJRmS7_EEES0_INSA_14_Node_iteratorIS8_Lb0ELb0EEEbEDpOT_)
    *(.text._ZN2lx4CellB5cxx11Eji)
    *(.text._ZSt24__merge_sort_with_bufferIN9__gnu_cxx17__normal_iteratorIPjSt6vectorIjSaIjEEEES2_PFbjjEEvT_S9_T0_T1_)
    *(.text._ZN2lx21RemoveDuplicateTracksEv)
    *(.text._ZN2lx16StepPlaylistEditEb)
    *(.text._ZN2lx10UndoLatestEv)
    *(.text._ZN2lx21FollowNowPlayingAlbumEv)
    *(.text._ZN2lx12SetActiveTabEi)
    *(.text._ZN2lx13RevealPlayingEv)
    *(.text._ZZN2lx12ColumnWidthsEvEN3KeyD1Ev)
    *(.text._ZZN2lx12ColumnWidthsEvEN3KeyD2Ev)
    *(.text._ZNSt8_Rb_treeINSt7__cxx1112basic_stringIwSt11char_traitsIwESaIwEEESt4pairIKS5_ZN2lx7TabNameB5cxx11EmE5CountESt10_Select1stISA_ESt4lessIS5_ESaISA_EE24_M_get_insert_unique_posERS7_.constprop.0.isra.0)
    *(.text._ZNSt8_Rb_treeINSt7__cxx1112basic_stringIwSt11char_traitsIwESaIwEEESt4pairIKS5_ZN2lx7TabNameB5cxx11EmE5CountESt10_Select1stISA_ESt4lessIS5_ESaISA_EE8_M_eraseEPSt13_Rb_tree_nodeISA_E.isra.0)
    *(.text._ZNSt3mapINSt7__cxx1112basic_stringIwSt11char_traitsIwESaIwEEEZN2lx7TabNameB5cxx11EmE5CountSt4lessIS5_ESaISt4pairIKS5_S7_EEED1Ev)
    *(.text._ZNSt3mapINSt7__cxx1112basic_stringIwSt11char_traitsIwESaIwEEEZN2lx7TabNameB5cxx11EmE5CountSt4lessIS5_ESaISt4pairIKS5_S7_EEED2Ev)
    *(.text._ZN2lx12SeekVerticalEv)
    *(.text._ZN2lx13ContentHeightEv)
    *(.text._ZN2lx9MaxScrollEv)
    *(.text._ZN2lx11ClampScrollEv)
    *(.text._ZN2lx13EnsureVisibleEi)
    *(.text._ZN2lx6LineAtEf)
    *(.text._ZN2lx11ColumnSpecsEv)
    *(.text._ZN2lx13ColumnStretchEv)
    *(.text._ZN2lx12ColumnWidthsEv)
    *(.text._ZN2lx11ColumnWidthEi)
    *(.text._ZN2lx15CurrentTabSlotsEv)
    *(.text._ZN2lx18TabOfPlaylistIndexEi)
    *(.text._ZN2lx9IsAutoTabEi)
    *(.text._ZN2lx7TabNameB5cxx11Em)
    *(.text._ZN2lx8TabLabelB5cxx11Em)
    *(.text._ZN2lx8DoLayoutEv)
    *(.text._ZNSt17_Function_handlerIFviEZN2lx15OpenAutoTabMenuEiEUliE_E10_M_managerERSt9_Any_dataRKS4_St18_Manager_operation)
    *(.text._ZNSt17_Function_handlerIFviEZN2lx15OpenAutoTabMenuEiEUliE_E9_M_invokeERKSt9_Any_dataOi)
    *(.text._ZNSt6vectorIjSaIjEE15_M_range_insertIN9__gnu_cxx17__normal_iteratorIPKjS1_EEEEvNS4_IPjS1_EET_SA_St20forward_iterator_tag.isra.0)
    *(.text._ZN2lx22ShowMissingInformationEm)
    *(.text._ZN2lx23CanvasHasFocusedEditionEv)
    *(.text._ZN2lx8BarMenusEv)
    *(.text._ZN2lx15PopupItemHeightERKNS_8MenuItemE)
    *(.text._ZN2lx13PopupItemRectERKNS_5PopupEm)
    *(.text._ZN2lx13SectionActionEi)
    *(.text._ZN2lx23DiscoverRegisterPreviewEjRK8WebTrackRKNSt7__cxx1112basic_stringIwSt11char_traitsIwESaIwEEESA_)
    *(.text._ZN2lx19DiscoverFindPreviewERKNSt7__cxx1112basic_stringIcSt11char_traitsIcESaIcEEES7_Rj)
    *(.text._ZN2lx17IsDiscoverPreviewEj)
    *(.text._ZN2lx15DiscoverCanKeepEv)
    *(.text._ZN2lx17DiscoverKeepTrackEjPNSt7__cxx1112basic_stringIwSt11char_traitsIwESaIwEEE)
    *(.text._ZN2lx12DiscoverKeepEv)
    *(.text._ZN2lx12DiscoverTickEv)
    *(.text._ZNSt6thread11_State_implINS_8_InvokerISt5tupleIJZN2lx12_GLOBAL__N_1L9StartLookEvEUlvE_EEEEED1Ev)
    *(.text._ZNSt6thread11_State_implINS_8_InvokerISt5tupleIJZN2lx12_GLOBAL__N_1L9StartLookEvEUlvE_EEEEED2Ev)
    *(.text._ZNSt6thread11_State_implINS_8_InvokerISt5tupleIJZN2lx12_GLOBAL__N_1L9StartLookEvEUlvE_EEEEED0Ev)
    *(.text._ZN6online11SearchTrackaSERKS0_.isra.0)
    *(.text._ZN6online11SearchTrackD1Ev)
    *(.text._ZN6online11SearchTrackD2Ev)
    *(.text._ZN6online11SearchTrackC1ERKS0_)
    *(.text._ZN6online11SearchTrackC2ERKS0_)
    *(.text._ZN2lx25OnlineSearchOwnedSnapshotEv)
    *(.text._ZN2lx19OnlineSearchVisibleEv)
    *(.text._ZN2lx24OnlineSearchWantedHeightEf)
    *(.text._ZN2lx24OnlineSearchQueryChangedERKNSt7__cxx1112basic_stringIwSt11char_traitsIwESaIwEEE)
    *(.text._ZN2lx21OnOnlineSearchMessageEml)
    *(.text._ZNSt8_Rb_treeISt4pairINSt7__cxx1112basic_stringIcSt11char_traitsIcESaIcEEES6_ES0_IKS7_NS2_IwS3_IwESaIwEEEESt10_Select1stISC_ESt4lessIS7_ESaISC_EE7_M_copyILb0ENSI_11_Alloc_nodeEEEPSt18_Rb_tree_node_basePSt13_Rb_tree_nodeISC_ESM_RT0_.isra.0)
    *(.text._ZN2lx16OnlineSearchTickEv)
    *(.text._ZN2lx4FillERKNS_4RectEjh.constprop.0)
    *(.text._ZNSt10_HashtableImSt4pairIKmN2lx5ThumbEESaIS4_ENSt8__detail10_Select1stESt8equal_toImESt4hashImENS6_18_Mod_range_hashingENS6_20_Default_ranged_hashENS6_20_Prime_rehash_policyENS6_17_Hashtable_traitsILb0ELb0ELb1EEEE5eraseENS6_20_Node_const_iteratorIS4_Lb0ELb0EEE.isra.0)
    *(.text._ZZN2lx14DrawAlbumCoverEjjRKNSt7__cxx1112basic_stringIwSt11char_traitsIwESaIwEEERKNS_4RectERK7PaletteENKUldddE_clEddd.isra.0)
    *(.text._ZZN2lx12DrawWaveformERKNS_4RectEdRK7PaletteENKUljE_clEj.isra.0)
    *(.text._ZNSt6vectorI10SDL_FPointSaIS0_EEC2ESt16initializer_listIS0_ERKS1_.constprop.0)
    *(.text._ZN2lx12_GLOBAL__N_1L12EndCoverFadeEv)
    *(.text._ZSt16__introsort_loopIN9__gnu_cxx17__normal_iteratorIPSt4pairImmESt6vectorIS3_SaIS3_EEEElSt4lessIvEEvT_SB_T0_T1_.isra.0)
    *(.text._ZZN2lx9DrawRadioERK7PaletteENKUlRKNS_4RectERKNSt7__cxx1112basic_stringIwSt11char_traitsIwESaIwEEEPKciE_clES5_SD_SF_i)
    *(.text._ZZN2lx9DrawRadioERK7PaletteENKUlRKNS_4RectEPKcbE_clES5_S7_b)
    *(.text._ZN2lx12DrawWaveformERKNS_4RectEdRK7Palette.part.0)
    *(.text._ZNSt7__cxx119to_stringEj)
    *(.text._ZZN2lx8DrawIconENS_4IconERKNS_4RectEjENKUlffffbE_clEffffb)
    *(.text._ZZN2lx8DrawIconENS_4IconERKNS_4RectEjENKUlffffE0_clEffff.constprop.0.isra.0)
    *(.text._ZN4Wind5SpawnEPKffb)
    *(.text._ZN4Wind4StepEPKfbf)
    *(.text._ZN2lx6CircleEfffj)
    *(.text._ZN2lx9RoundPathERKNS_4RectEf)
    *(.text._ZN2lx9FillRoundERKNS_4RectEfjf)
    *(.text._ZN2lx10FrameRoundERKNS_4RectEfj)
    *(.text._ZN2lx5PlainB5cxx11EPKw)
    *(.text._ZN2lx8DrawIconENS_4IconERKNS_4RectEj)
    *(.text._ZN2lx14DrawBandButtonERKNS_4RectENS_4IconERK7Palettebb.constprop.0)
    *(.text._ZN2lx11DrawMenuBarERK7Palette)
    *(.text._ZN2lx10DrawPopupsERK7Palette)
    *(.text._ZN2lx14DrawBandButtonERKNS_4RectENS_4IconERK7Palettebb)
    *(.text._ZN2lx10DrawSliderERKNS_4RectEdbbRK7Palettebd)
    *(.text._ZN2lx10PeakSourceEjRNSt7__cxx1112basic_stringIwSt11char_traitsIwESaIwEEERdS7_)
    *(.text._ZN2lx12RequestPeaksEjR5PeaksRj)
    *(.text._ZN2lx17LiveWaveformShownEv)
    *(.text._ZN2lx15SeekGlowPulsingEv)
    *(.text._ZN2lx17LiveFountainShownEv)
    *(.text._ZN2lx12DrawWaveformERKNS_4RectEdRK7Palette)
    *(.text._ZN2lx12DrawMoodCellERKNS_4RectEjRK7Palette)
    *(.text._ZN2lx11DrawSectionERKNS_4RectEdRK7Palette)
    *(.text._ZN2lx12DrawLiveSeekERK7Palette.part.0)
    *(.text._ZN2lx11CoverFadingEv)
    *(.text._ZN2lx16ReleaseCoverFadeEv)
    *(.text._ZN2lx13TrackDurationEv)
    *(.text._ZN2lx13PlayerPaletteERK7Palette)
    *(.text._ZN2lx12DrawLiveSeekERK7Palette)
    *(.text._ZN2lx8DrawBandERK7Palette)
    *(.text._ZN2lx10PlayingTabEv)
    *(.text._ZN2lx8DrawTabsERK7Palette)
    *(.text._ZN2lx12RadioColumnsEv)
    *(.text._ZN2lx14RadioMaxScrollEv)
    *(.text._ZN2lx9RadioCardEi)
    *(.text._ZN2lx11DrawVisualsERK7Palette)
    *(.text._ZN2lx17ListWindAnimatingEv)
    *(.text._ZN2lx11ThumbBudgetEv)
    *(.text._ZN2lx10TrimThumbsEv)
    *(.text._ZN2lx13AlbumCoverHueEjjf)
    *(.text._ZN2lx13StatusMessageB5cxx11Ev)
    *(.text._ZN2lx10DrawStatusERK7Palette)
    *(.text._ZStssINSt7__cxx1112basic_stringIcSt11char_traitsIcESaIcEEEiS5_iENSt26common_comparison_categoryIJDTclL_ZNSt8__detail11__synth3wayEEcl7declvalIRT_EEcl7declvalIRT1_EEEEDTclL_ZNS7_11__synth3wayEEcl7declvalIRT0_EEcl7declvalIRT2_EEEEEE4typeERKSt4pairIS8_SD_ERKSK_ISA_SF_E)
    *(.text._ZNSt8_Rb_treeISt4pairINSt7__cxx1112basic_stringIcSt11char_traitsIcESaIcEEEiES0_IKS7_P11SDL_TextureESt10_Select1stISB_ESt4lessIS7_ESaISB_EE24_M_get_insert_unique_posERS8_)
    *(.text._ZNSt10_HashtableIjSt4pairIKjmESaIS2_ENSt8__detail10_Select1stESt8equal_toIjESt4hashIjENS4_18_Mod_range_hashingENS4_20_Default_ranged_hashENS4_20_Prime_rehash_policyENS4_17_Hashtable_traitsILb0ELb0ELb1EEEE21_M_insert_unique_nodeEmmPNS4_10_Hash_nodeIS2_Lb0EEEm)
    *(.text._ZNSt8_Rb_treeISt4pairINSt7__cxx1112basic_stringIcSt11char_traitsIcESaIcEEEiES0_IKS7_P11SDL_TextureESt10_Select1stISB_ESt4lessIS7_ESaISB_EE29_M_get_insert_hint_unique_posESt23_Rb_tree_const_iteratorISB_ERS8_)
    *(.text._ZN2lx15DrawGroupHeaderERKNS_5GroupEiffRK7Palette)
    *(.text._ZN2lx8DrawListERK7Palette)
    *(.text._ZN2lx4DrawEv)
    *(.text._ZNSt8_Rb_treeISt4pairINSt7__cxx1112basic_stringIcSt11char_traitsIcESaIcEEEiES0_IKS7_N2lx12_GLOBAL__N_16CachedEESt10_Select1stISC_ESt4lessIS7_ESaISC_EE8_M_eraseEPSt13_Rb_tree_nodeISC_E.isra.0)
    *(.text._ZNSt3mapISt4pairINSt7__cxx1112basic_stringIcSt11char_traitsIcESaIcEEEiEN2lx12_GLOBAL__N_16CachedESt4lessIS7_ESaIS0_IKS7_SA_EEED1Ev)
    *(.text._ZNSt3mapISt4pairINSt7__cxx1112basic_stringIcSt11char_traitsIcESaIcEEEiEN2lx12_GLOBAL__N_16CachedESt4lessIS7_ESaIS0_IKS7_SA_EEED2Ev)
    *(.text._ZNSt8_Rb_treeISt4pairINSt7__cxx1112basic_stringIcSt11char_traitsIcESaIcEEEiES0_IKS7_N2lx12_GLOBAL__N_16CachedEESt10_Select1stISC_ESt4lessIS7_ESaISC_EE24_M_get_insert_unique_posERS8_.constprop.0)
    *(.text._ZN2lx14DrawFluentIconESt17basic_string_viewIcSt11char_traitsIcEEfffjh)
    *(.text._ZN2lx19ReleaseIconTexturesEv)
    *(.text._ZN2lx7MenuHitEffPi)
    *(.text._ZN2lx9BarItemAtEff)
    *(.text._ZN2lx7DensityEv)
    *(.text._ZN2lx11SeekValueAtEff)
    *(.text._ZN2lx11SectionTimeB5cxx11Ed)
    *(.text._ZN2lx8VolumeAtEf)
    *(.text._ZN2lx12ColumnEdgeAtEff)
    *(.text._ZN2lx8ColumnAtEf)
    *(.text._ZN2lx15HeaderHotColumnEv)
    *(.text._ZN2lx11HeaderDropXEv)
    *(.text._ZN2lx6SortByEi)
    *(.text._ZN2lx10ClickGroupEib)
    *(.text._ZN2lx16PrepareTrackDragEffib)
    *(.text._ZN2lx14ReopenPlaylistEv)
    *(.text._ZN2lx15ReorderPlaylistEi)
    *(.text._ZN2lx10ToggleMuteEv)
    *(.text._ZN2lx10AddDroppedERKSt6vectorINSt7__cxx1112basic_stringIwSt11char_traitsIwESaIwEEESaIS6_EE)
    *(.text._ZN2lx21PlaylistImportPendingEv)
    *(.text._ZN2lx18TickPlaylistImportEv)
    *(.text._ZN2lx12_GLOBAL__N_1L4SyncEv)
    *(.text._ZN2lx10DrawUpNextERK7Palette)
    *(.text._ZN2lx12_GLOBAL__N_1L9SyncPanelEv)
    *(.text._ZN2lx20EnsureProfilesLoadedEv)
    *(.text._ZN2lx20EnsureHeadsetPollingEv)
    *(.text._ZN2lx15StartHeadphonesEv)
    *(.text._ZN2lx14StopHeadphonesEv)
    *(.text._ZN2lx21SaveHeadphoneProfilesEv)
    *(.text._ZN2lx14HeadphonesTickEv)
    *(.text._ZN2lx18HeadphonesGlobalEqEv)
    *(.text._ZN2lx18HeadphonesHeadroomEv)
    *(.text._ZN2lx22PrepareHeadphonesPanelEv)
    *(.text._ZN2lx15HeadphonesWheelEf)
    *(.text._ZN9__gnu_cxx12__to_xstringINSt7__cxx1112basic_stringIcSt11char_traitsIcESaIcEEEcEET_PFiPT0_mPKS8_P13__va_list_tagEmSB_z)
    *(.text._ZN2lx14DrawHeadphonesERK7Palette)
    *(.text._ZSt14__copy_move_a1ILb1EPN2lx8platform12_GLOBAL__N_16QueuedES3_EN9__gnu_cxx11__enable_ifIXsrSt27__is_any_random_access_iterIT0_DTcl26__iter_concept_or_categoryIS8_EEEE7__valueESt15_Deque_iteratorIT1_RSC_PSC_EE6__typeES8_S8_SF_)
    *(.text._ZSt23__copy_move_backward_a1ILb1EPN2lx8platform12_GLOBAL__N_16QueuedES3_EN9__gnu_cxx11__enable_ifIXsrSt27__is_any_random_access_iterIT0_DTcl26__iter_concept_or_categoryIS8_EEEE7__valueESt15_Deque_iteratorIT1_RSC_PSC_EE6__typeES8_S8_SF_)
    *(.text._ZN2lx8platform12_GLOBAL__N_19OffscreenD1Ev)
    *(.text._ZN2lx8platform12_GLOBAL__N_19OffscreenD2Ev)
    *(.text._ZN2lx8platform12_GLOBAL__N_19OffscreenD0Ev)
    *(.text._ZN2lx8platform12_GLOBAL__N_19Offscreen14ClipboardTypesEv)
    *(.text._ZNSt8_Rb_treeINSt7__cxx1112basic_stringIcSt11char_traitsIcESaIcEEESt4pairIKS5_S5_ESt10_Select1stIS8_ESt4lessIS5_ESaIS8_EE4findERS7_.isra.0)
    *(.text._ZN2lx8platform12_GLOBAL__N_19Offscreen12GetClipboardERKNSt7__cxx1112basic_stringIcSt11char_traitsIcESaIcEEE)
    *(.text._ZN2lx8platform12_GLOBAL__N_19Offscreen12SetClipboardERKNSt7__cxx1112basic_stringIcSt11char_traitsIcESaIcEEE)
    *(.text._ZN2lx8platform12_GLOBAL__N_1L1SEv)
    *(.text._ZN2lx8platform12_GLOBAL__N_19Offscreen11GlobalMouseERfS3_)
    *(.text._ZN2lx8platform12_GLOBAL__N_1L4PumpEv)
    *(.text._ZN12_GLOBAL__N_1L13ClipboardTextEv)
    *(.text._ZNSt8__detail10__erase_ifISt5dequeIN2lx8platform12_GLOBAL__N_16QueuedESaIS5_EES7_Z17SDL_DestroyWindowP10SDL_WindowEUlRKS5_E_EENT_9size_typeERSD_RT0_T1_.isra.0)
    *(.text._ZN2lx8platform8SetErrorERKNSt7__cxx1112basic_stringIcSt11char_traitsIcESaIcEEE)
    *(.text._ZN2lx8platform14CurrentBackendEv)
    *(.text._ZN2lx8platform6NativeEP10SDL_Window)
    *(.text._ZN2lx8platform15TextInputActiveEv)
    *(.text._ZN2lx8platform13WakeEventLoopEv)
    *(.text._ZN2lx8platform15RunOnMainThreadESt8functionIFvvEE)
    *(.text._ZN2lx8platform10WindowByIdEj)
    *(.text._ZN2lx8platform16WindowFromNativeEPNS0_12NativeWindowE)
    *(.text._ZN2lx8platform9PushEventERK9SDL_EventNSt7__cxx1112basic_stringIcSt11char_traitsIcESaIcEEE)
    *(.text._ZN2lx8platform15OnWindowResizedEP10SDL_Windowiiii)
    *(.text._ZN2lx8platform12_GLOBAL__N_115OffscreenWindow7SetSizeEii)
    *(.text._ZN2lx8platform14OnDisplayScaleEP10SDL_Windowf)
    *(.text._ZN2lx8platform13OnWindowStateEP10SDL_Windowmm)
    *(.text._ZN2lx8platform7OnFocusEP10SDL_Windowb)
    *(.text._ZN2lx8platform17OnMouseEnterLeaveEP10SDL_Windowb)
    *(.text._ZN2lx8platform14OnCloseRequestEP10SDL_Window)
    *(.text._ZN2lx8platform9OnExposedEP10SDL_Window)
    *(.text._ZN2lx8platform13OnMouseMotionEP10SDL_Windowff)
    *(.text._ZN2lx8platform13OnMouseButtonEP10SDL_Windowibff)
    *(.text._Z8SDL_Initj)
    *(.text._Z25SDL_GetCurrentVideoDriverv)
    *(.text._Z12SDL_GetTicksv)
    *(.text._Z9SDL_Delayj)
    *(.text._Z8SDL_freePv)
    *(.text._Z23SDL_GetRectIntersectionPK8SDL_RectS1_PS_)
    *(.text._Z13SDL_PushEventP9SDL_Event)
    *(.text._Z18SDL_RegisterEventsi)
    *(.text._Z16SDL_CreateWindowPKciim)
    *(.text._Z17SDL_SetWindowIconP10SDL_WindowP11SDL_Surface)
    *(.text._Z17SDL_SetWindowSizeP10SDL_Windowii)
    *(.text._Z17SDL_GetWindowSizeP10SDL_WindowPiS1_)
    *(.text._Z25SDL_GetWindowSizeInPixelsP10SDL_WindowPiS1_)
    *(.text._Z24SDL_SetWindowMinimumSizeP10SDL_Windowii)
    *(.text._Z21SDL_SetWindowPositionP10SDL_Windowii)
    *(.text._Z21SDL_GetWindowPositionP10SDL_WindowPiS1_)
    *(.text._Z22SDL_SetWindowResizableP10SDL_Windowb)
    *(.text._Z21SDL_SetWindowBorderedP10SDL_Windowb)
    *(.text._Z24SDL_SetWindowAlwaysOnTopP10SDL_Windowb)
    *(.text._Z18SDL_SetWindowShapeP10SDL_WindowP11SDL_Surface)
    *(.text._Z18SDL_MaximizeWindowP10SDL_Window)
    *(.text._Z17SDL_RestoreWindowP10SDL_Window)
    *(.text._Z15SDL_RaiseWindowP10SDL_Window)
    *(.text._Z14SDL_HideWindowP10SDL_Window)
    *(.text._Z19SDL_WindowFrameKeptP10SDL_Window)
    *(.text._Z14SDL_SyncWindowP10SDL_Window)
    *(.text._Z25SDL_GetWindowPixelDensityP10SDL_Window)
    *(.text._Z25SDL_GetWindowDisplayScaleP10SDL_Window)
    *(.text._Z23SDL_GetDisplayForWindowP10SDL_Window)
    *(.text._Z26SDL_GetDisplayUsableBoundsjP8SDL_Rect)
    *(.text._Z11SDL_SetHintPKcS0_)
    *(.text._ZNSt5dequeINSt7__cxx1112basic_stringIcSt11char_traitsIcESaIcEEESaIS5_EE17_M_reallocate_mapEmb)
    *(.text._ZN2lx8platform12_GLOBAL__N_1L3PopEP9SDL_Event)
    *(.text._Z13SDL_PollEventP9SDL_Event)
    *(.text._Z20SDL_WaitEventTimeoutP9SDL_Eventi)
    *(.text._ZN2lx8platform12_GLOBAL__N_1L13StretchLinearERKNS1_5ImageERK8SDL_RectS4_S7_)
    *(.text._ZNSt8_Rb_treeIP11SDL_TextureS1_St9_IdentityIS1_ESt4lessIS1_ESaIS1_EE8_M_eraseEPSt13_Rb_tree_nodeIS1_E.isra.0)
    *(.text._ZN2lx8platform12_GLOBAL__N_1L4LineERKNS1_3PenEiiiib)
    *(.text._ZN2lx8platform12_GLOBAL__N_1L9FillRectsEP12SDL_RendererPK8SDL_Rectihhhh13SDL_BlendMode.constprop.0)
    *(.text._ZN2lx8platform12_GLOBAL__N_1L4BlitERKNS1_5ImageE8SDL_RectS4_iiRKS5_RKNS1_9CopyStateE)
    *(.text._ZN2lx8platform12_GLOBAL__N_1L5SetupERK9SDL_PointS4_S4_PK8SDL_RectRS6_RNS1_6RasterE)
    *(.text._ZZ18SDL_RenderGeometryP12SDL_RendererP11SDL_TexturePK10SDL_VertexiPKiiENKUlS7_E_clES7_.isra.0)
    *(.text._ZN2lx8platform17RendererForWindowEP10SDL_Window)
    *(.text._ZN2lx8platform18RendererWindowGoneEP10SDL_Window)
    *(.text._Z18SDL_CreateRendererP10SDL_WindowPKc)
    *(.text._Z19SDL_DestroyRendererP12SDL_Renderer)
    *(.text._Z19SDL_GetRendererNameP12SDL_Renderer)
    *(.text._Z18SDL_SetRenderVSyncP12SDL_Rendereri)
    *(.text._Z23SDL_GetRenderOutputSizeP12SDL_RendererPiS1_)
    *(.text._Z22SDL_SetRenderDrawColorP12SDL_Rendererhhhh)
    *(.text._Z26SDL_SetRenderDrawBlendModeP12SDL_Renderer13SDL_BlendMode)
    *(.text._Z21SDL_SetRenderClipRectP12SDL_RendererPK8SDL_Rect)
    *(.text._Z21SDL_GetRenderClipRectP12SDL_RendererP8SDL_Rect)
    *(.text._Z21SDL_RenderClipEnabledP12SDL_Renderer)
    *(.text._Z15SDL_RenderClearP12SDL_Renderer)
    *(.text._Z19SDL_RenderFillRectsP12SDL_RendererPK9SDL_FRecti)
    *(.text._Z18SDL_RenderFillRectP12SDL_RendererPK9SDL_FRect)
    *(.text._Z15SDL_RenderLinesP12SDL_RendererPK10SDL_FPointi)
    *(.text._Z14SDL_RenderRectP12SDL_RendererPK9SDL_FRect)
    *(.text._Z17SDL_RenderTextureP12SDL_RendererP11SDL_TexturePK9SDL_FRectS5_)
    *(.text._Z18SDL_RenderGeometryP12SDL_RendererP11SDL_TexturePK10SDL_VertexiPKii)
    *(.text._Z20SDL_RenderReadPixelsP12SDL_RendererPK8SDL_Rect)
    *(.text._Z17SDL_FlushRendererP12SDL_Renderer)
    *(.text._Z17SDL_RenderPresentP12SDL_Renderer)
    *(.text._Z28SDL_UpdateWindowSurfaceRectsP10SDL_WindowPK8SDL_Recti)
    *(.text._Z17SDL_CreateTextureP12SDL_Renderer15SDL_PixelFormat17SDL_TextureAccessii)
    *(.text._Z18SDL_DestroyTextureP11SDL_Texture)
    *(.text._Z17SDL_UpdateTextureP11SDL_TexturePK8SDL_RectPKvi)
    *(.text._Z18SDL_GetTextureSizeP11SDL_TexturePfS1_)
    *(.text._Z23SDL_SetTextureBlendModeP11SDL_Texture13SDL_BlendMode)
    *(.text._Z23SDL_SetTextureScaleModeP11SDL_Texture13SDL_ScaleMode)
    *(.text._Z22SDL_SetTextureAlphaModP11SDL_Textureh)
    *(.text._Z17SDL_CreateSurfaceii15SDL_PixelFormat)
    *(.text._Z21SDL_CreateSurfaceFromii15SDL_PixelFormatPvi)
    *(.text._Z18SDL_DestroySurfaceP11SDL_Surface)
    *(.text._Z16SDL_ClearSurfaceP11SDL_Surfaceffff)
    *(.text._Z21SDL_WriteSurfacePixelP11SDL_Surfaceiihhhh)
    *(.text._Z11SDL_SaveBMPP11SDL_SurfacePKc)
    *(.text._Z17SDL_GetUserFolder10SDL_Folder)
    *(.text._Z18SDL_GetSystemThemev)
    *(.text._ZNSt6thread11_State_implINS_8_InvokerISt5tupleIJZN2lx8platform12_GLOBAL__N_1L11StartDialogEPFvPvPKPKciES6_P10SDL_WindowNS4_14ChooserRequestEEUlvE_EEEEED1Ev)
    *(.text._ZNSt6thread11_State_implINS_8_InvokerISt5tupleIJZN2lx8platform12_GLOBAL__N_1L11StartDialogEPFvPvPKPKciES6_P10SDL_WindowNS4_14ChooserRequestEEUlvE_EEEEED2Ev)
    *(.text._ZNSt6thread11_State_implINS_8_InvokerISt5tupleIJZN2lx8platform12_GLOBAL__N_1L11StartDialogEPFvPvPKPKciES6_P10SDL_WindowNS4_14ChooserRequestEEUlvE_EEEEED0Ev)
    *(.text._ZN2lx8platform18OverlayFileChooserB5cxx11EP10SDL_WindowRKNS0_14ChooserRequestE)
    *(.text._ZNK2lx8platform12_GLOBAL__N_13X114NameEv)
    *(.text._ZNK2lx8platform12_GLOBAL__N_13X112FdEv)
    *(.text._ZNK2lx8platform12_GLOBAL__N_13X119TimeoutMsEv)
    *(.text._ZN2lx8platform12_GLOBAL__N_1L3R32ERKNSt7__cxx1112basic_stringIcSt11char_traitsIcESaIcEEEm.part.0.constprop.2.isra.0)
    *(.text._ZN2lx8platform12_GLOBAL__N_1L3R32ERKNSt7__cxx1112basic_stringIcSt11char_traitsIcESaIcEEEm.part.0.constprop.1.isra.0)
    *(.text._ZN2lx8platform12_GLOBAL__N_1L3R32ERKNSt7__cxx1112basic_stringIcSt11char_traitsIcESaIcEEEm.part.0.constprop.0.isra.0)
    *(.text._ZN2lx8platform12_GLOBAL__N_1L3S16ERKNSt7__cxx1112basic_stringIcSt11char_traitsIcESaIcEEEm.part.0.isra.0)
    *(.text._ZN2lx8platform12_GLOBAL__N_1L3R32ERKNSt7__cxx1112basic_stringIcSt11char_traitsIcESaIcEEEm.part.0.isra.0)
    *(.text._ZNKSt7__cxx1112basic_stringIcSt11char_traitsIcESaIcEE7compareERKS4_.isra.0)
    *(.text._ZN2lx8platform12_GLOBAL__N_13X116LookupEhtPjS3_)
    *(.text._ZNSt7__cxx1112basic_stringIcSt11char_traitsIcESaIcEE14_M_replace_auxEmmmc.isra.0)
    *(.text._ZNSt8_Rb_treeIiSt4pairIKijESt10_Select1stIS2_ESt4lessIiESaIS2_EE8_M_eraseEPSt13_Rb_tree_nodeIS2_E.isra.0)
    *(.text._ZN2lx8platform12_GLOBAL__N_13X118FlushOutEv)
    *(.text._ZN2lx8platform12_GLOBAL__N_13X115FlushEv)
    *(.text._ZN2lx8platform12_GLOBAL__N_13X114SendERKNSt7__cxx1112basic_stringIcSt11char_traitsIcESaIcEEE.isra.0)
    *(.text._ZNSt8_Rb_treeINSt7__cxx1112basic_stringIcSt11char_traitsIcESaIcEEESt4pairIKS5_jESt10_Select1stIS8_ESt4lessIS5_ESaIS8_EE24_M_get_insert_unique_posERS7_.isra.0)
    *(.text._ZN2lx8platform12_GLOBAL__N_13Req4DoneEv)
    *(.text._ZNSt7__cxx1112basic_stringIcSt11char_traitsIcESaIcEE6assignEPKc.isra.0)
    *(.text._ZN2lx8platform12_GLOBAL__N_19X11Window12PortalHandleEv)
    *(.text._ZN2lx8platform12_GLOBAL__N_13X118ReadSomeEi)
    *(.text._ZNSt8_Rb_treeINSt7__cxx1112basic_stringIcSt11char_traitsIcESaIcEEESt4pairIKS5_jESt10_Select1stIS8_ESt4lessIS5_ESaIS8_EE8_M_eraseEPSt13_Rb_tree_nodeIS8_E.isra.0)
    *(.text._ZNSt8_Rb_treeImSt4pairIKmNSt7__cxx1112basic_stringIcSt11char_traitsIcESaIcEEEESt10_Select1stIS8_ESt4lessImESaIS8_EE8_M_eraseEPSt13_Rb_tree_nodeIS8_E.isra.0)
    *(.text._ZN2lx8platform12_GLOBAL__N_13X11D1Ev)
    *(.text._ZN2lx8platform12_GLOBAL__N_13X11D2Ev)
    *(.text._ZN2lx8platform12_GLOBAL__N_13X11D0Ev)
    *(.text._ZZN2lx8platform15FindXcursorFileERKNSt7__cxx1112basic_stringIcSt11char_traitsIcESaIcEEES8_iENKUlS8_mE_clES8_m.isra.0)
    *(.text._ZN2lx8platform12_GLOBAL__N_13ReqC1Ehh)
    *(.text._ZN2lx8platform12_GLOBAL__N_13ReqC2Ehh)
    *(.text._ZN2lx8platform12_GLOBAL__N_13X1113ClientMessageEjjSt16initializer_listIjEj)
    *(.text._ZN2lx8platform12_GLOBAL__N_19X11Window4HideEv)
    *(.text._ZNSt8_Rb_treeIiSt4pairIKijESt10_Select1stIS2_ESt4lessIiESaIS2_EE22_M_emplace_hint_uniqueIJRKSt21piecewise_construct_tSt5tupleIJRS1_EESD_IJEEEEESt17_Rb_tree_iteratorIS2_ESt23_Rb_tree_const_iteratorIS2_EDpOT_.isra.0)
    *(.text._ZN2lx8platform12_GLOBAL__N_19X11Window11SetPositionEii)
    *(.text._ZN2lx8platform12_GLOBAL__N_13X1110DeliverKeyERKNSt7__cxx1112basic_stringIcSt11char_traitsIcESaIcEEEbb.isra.0)
    *(.text._ZNSt7__cxx1112basic_stringIcSt11char_traitsIcESaIcEE6appendEPKcm.constprop.1.isra.0)
    *(.text._ZNSt7__cxx1112basic_stringIcSt11char_traitsIcESaIcEE6appendEPKcm.constprop.0.isra.0)
    *(.text._ZN2lx8platform12_GLOBAL__N_13X114PropEjjjiPKvm)
    *(.text._ZN2lx8platform12_GLOBAL__N_19X11Window8SetShapeEiiPKh)
    *(.text._ZN2lx8platform15FindXcursorFileERKNSt7__cxx1112basic_stringIcSt11char_traitsIcESaIcEEES8_i)
    *(.text._ZN2lx8platform12_GLOBAL__N_13X119TakeUnitsEv)
    *(.text._ZN2lx8platform12_GLOBAL__N_13X115ReplyEmi.constprop.0)
    *(.text._ZN2lx8platform12_GLOBAL__N_13X114AtomERKNSt7__cxx1112basic_stringIcSt11char_traitsIcESaIcEEE)
    *(.text._ZN2lx8platform12_GLOBAL__N_13X1112SetClipboardERKNSt7__cxx1112basic_stringIcSt11char_traitsIcESaIcEEE)
    *(.text._ZN2lx8platform12_GLOBAL__N_13X114PropEjPKcS4_iPKvm)
    *(.text._ZN2lx8platform12_GLOBAL__N_19X11Window12SetTextInputEbPK8SDL_Rect)
    *(.text._ZN2lx8platform12_GLOBAL__N_13X115RoundEv)
    *(.text._ZN2lx8platform12_GLOBAL__N_19X11Window10FreeBufferEv)
    *(.text._ZN2lx8platform12_GLOBAL__N_19X11WindowD1Ev)
    *(.text._ZN2lx8platform12_GLOBAL__N_19X11WindowD2Ev)
    *(.text._ZN2lx8platform12_GLOBAL__N_19X11WindowD0Ev)
    *(.text._ZN2lx8platform12_GLOBAL__N_19X11Window7PresentEPK8SDL_Recti)
    *(.text._ZN2lx8platform12_GLOBAL__N_19X11Window11FramebufferERiS3_S3_)
    *(.text._ZN2lx8platform12_GLOBAL__N_13X1110LoadKeymapEv)
    *(.text._ZN2lx8platform12_GLOBAL__N_13X116HandleERKNSt7__cxx1112basic_stringIcSt11char_traitsIcESaIcEEE)
    *(.text._ZN2lx8platform12_GLOBAL__N_13X118DispatchEv)
    *(.text._ZN2lx8platform12_GLOBAL__N_13X118NetStateERNS1_9X11WindowEbPKcS6_)
    *(.text._ZN2lx8platform12_GLOBAL__N_19X11Window7RestoreEv)
    *(.text._ZN2lx8platform12_GLOBAL__N_19X11Window8MaximizeEv)
    *(.text._ZN2lx8platform12_GLOBAL__N_19X11Window14SetAlwaysOnTopEb)
    *(.text._ZN2lx8platform12_GLOBAL__N_19X11Window9SetCursorENS0_6CursorE)
    *(.text._ZN2lx3x1110ParseSetupESt17basic_string_viewIcSt11char_traitsIcEE)
    *(.text._ZN2lx3x118NextUnitESt17basic_string_viewIcSt11char_traitsIcEE)
    *(.text._ZN2lx3x1110FindCookieB5cxx11ESt17basic_string_viewIcSt11char_traitsIcEES4_S4_)
    *(.text._ZN2lx3x1112ParseDisplayESt17basic_string_viewIcSt11char_traitsIcEE)
    *(.text._ZN2lx8platform9XkbKeymap5ParseESt17basic_string_viewIcSt11char_traitsIcEEPNSt7__cxx1112basic_stringIcS4_SaIcEEE)
    *(.text._ZN2lx2wl11NextMessageESt17basic_string_viewIcSt11char_traitsIcEERNS0_7MessageE)
    *(.text._ZN2lx2wl4Args6StringEPb)
    *(.text._ZN2lx2wl4Args5ArrayEv)
    *(.text._ZN2lx8platform12_GLOBAL__N_18WlWindow11SetPositionEii)
    *(.text._ZN2lx8platform12_GLOBAL__N_18WlWindow11GetPositionERiS3_)
    *(.text._ZN2lx8platform12_GLOBAL__N_18WlWindow14SetAlwaysOnTopEb)
    *(.text._ZNK2lx8platform12_GLOBAL__N_17Wayland4NameEv)
    *(.text._ZNK2lx8platform12_GLOBAL__N_17Wayland2FdEv)
    *(.text._ZN2lx8platform12_GLOBAL__N_17Wayland11GlobalMouseERfS3_)
    *(.text._ZN2lx8platform12_GLOBAL__N_18WlWindow9FrameKeptEv)
    *(.text._ZNSt17_Function_handlerIFbvEZN2lx8platform12_GLOBAL__N_17Wayland9RoundtripEiEUlvE_E9_M_invokeERKSt9_Any_data)
    *(.text._ZNSt17_Function_handlerIFbvEZN2lx8platform12_GLOBAL__N_18WlWindow6CreateERKNSt7__cxx1112basic_stringIcSt11char_traitsIcESaIcEEEiimEUlvE_E9_M_invokeERKSt9_Any_data)
    *(.text._ZNSt17_Function_handlerIFbvEZN2lx8platform12_GLOBAL__N_18WlWindow7RestoreEvEUlvE_E9_M_invokeERKSt9_Any_data)
    *(.text._ZN2lx8platform12_GLOBAL__N_18WlWindow10UpdateSizeEii)
    *(.text._ZN2lx8platform12_GLOBAL__N_17Wayland12UsableBoundsER8SDL_Rect)
    *(.text._ZNSt6thread11_State_implINS_8_InvokerISt5tupleIJZN2lx8platform12_GLOBAL__N_17Wayland6HandleEjNS5_2IfEPvtRNS3_2wl4ArgsEEUlvE_EEEEE6_M_runEv)
    *(.text._ZNSt17_Function_handlerIFbvEZN2lx8platform12_GLOBAL__N_17Wayland9RoundtripEiEUlvE_E10_M_managerERSt9_Any_dataRKS7_St18_Manager_operation)
    *(.text._ZNSt17_Function_handlerIFbvEZN2lx8platform12_GLOBAL__N_18WlWindow7RestoreEvEUlvE_E10_M_managerERSt9_Any_dataRKS7_St18_Manager_operation)
    *(.text._ZNSt17_Function_handlerIFbvEZN2lx8platform12_GLOBAL__N_18WlWindow6CreateERKNSt7__cxx1112basic_stringIcSt11char_traitsIcESaIcEEEiimEUlvE_E10_M_managerERSt9_Any_dataRKSF_St18_Manager_operation)
    *(.text._ZNSt8_Rb_treeIjSt4pairIKjN2lx8platform12_GLOBAL__N_17Wayland6OutputEESt10_Select1stIS7_ESt4lessIjESaIS7_EE24_M_get_insert_unique_posERS1_.isra.0)
    *(.text._ZNSt8_Rb_treeIjSt4pairIKjjESt10_Select1stIS2_ESt4lessIjESaIS2_EE24_M_get_insert_unique_posERS1_.isra.0)
    *(.text._ZNSt8_Rb_treeIiSt4pairIKiS0_IPN2lx8platform12_GLOBAL__N_16BufferES0_IiiEEESt10_Select1stIS9_ESt4lessIiESaIS9_EE24_M_get_insert_unique_posERS1_.isra.0)
    *(.text._ZNSt8__detail10__erase_ifISt6vectorIjSaIjEES3_N9__gnu_cxx5__ops14_Comp_with_valISt8equal_toIvEjLb1EEEEENT_9size_typeERSA_RT0_T1_.isra.0)
    *(.text._ZNSt8__detail9_Map_baseIjSt4pairIKjN2lx8platform12_GLOBAL__N_17Wayland3ObjEESaIS8_ENS_10_Select1stESt8equal_toIjESt4hashIjENS_18_Mod_range_hashingENS_20_Default_ranged_hashENS_20_Prime_rehash_policyENS_17_Hashtable_traitsILb0ELb0ELb1EEELb1EEixERS2_.isra.0)
    *(.text._ZNK2lx8platform12_GLOBAL__N_17Wayland9TimeoutMsEv)
    *(.text._ZN2lx8platform12_GLOBAL__N_17Wayland9DestroyedEj)
    *(.text._ZNSt8_Rb_treeIjSt4pairIKjPN2lx8platform12_GLOBAL__N_18WlWindowEESt10_Select1stIS7_ESt4lessIjESaIS7_EE8_M_eraseEPSt13_Rb_tree_nodeIS7_E.isra.0)
    *(.text._ZNSt8_Rb_treeIiSt4pairIKiS0_IPN2lx8platform12_GLOBAL__N_16BufferES0_IiiEEESt10_Select1stIS9_ESt4lessIiESaIS9_EE8_M_eraseEPSt13_Rb_tree_nodeIS9_E.isra.0)
    *(.text._ZNSt8_Rb_treeIjSt4pairIKjN2lx8platform12_GLOBAL__N_17Wayland6OutputEESt10_Select1stIS7_ESt4lessIjESaIS7_EE8_M_eraseEPSt13_Rb_tree_nodeIS7_E.isra.0)
    *(.text._ZNSt8_Rb_treeIjSt4pairIKjjESt10_Select1stIS2_ESt4lessIjESaIS2_EE8_M_eraseEPSt13_Rb_tree_nodeIS2_E.isra.0)
    *(.text._ZNSt6thread11_State_implINS_8_InvokerISt5tupleIJZN2lx8platform12_GLOBAL__N_17Wayland6HandleEjNS5_2IfEPvtRNS3_2wl4ArgsEEUlvE_EEEEED1Ev)
    *(.text._ZNSt6thread11_State_implINS_8_InvokerISt5tupleIJZN2lx8platform12_GLOBAL__N_17Wayland6HandleEjNS5_2IfEPvtRNS3_2wl4ArgsEEUlvE_EEEEED2Ev)
    *(.text._ZNSt6thread11_State_implINS_8_InvokerISt5tupleIJZN2lx8platform12_GLOBAL__N_17Wayland6HandleEjNS5_2IfEPvtRNS3_2wl4ArgsEEUlvE_EEEEED0Ev)
    *(.text._ZN2lx8platform12_GLOBAL__N_13MsgD1Ev)
    *(.text._ZN2lx8platform12_GLOBAL__N_13MsgD2Ev)
    *(.text._ZN2lx8platform12_GLOBAL__N_17Wayland4LostEv)
    *(.text._ZNSt8_Rb_treeIjSt4pairIKjSt6vectorINSt7__cxx1112basic_stringIcSt11char_traitsIcESaIcEEESaIS8_EEESt10_Select1stISB_ESt4lessIjESaISB_EE8_M_eraseEPSt13_Rb_tree_nodeISB_E.isra.0)
    *(.text._ZNSt8_Rb_treeIjSt4pairIKjN2lx8platform9XkbKeymap3KeyEESt10_Select1stIS6_ESt4lessIjESaIS6_EE8_M_eraseEPSt13_Rb_tree_nodeIS6_E.isra.0)
    *(.text._ZN2lx8platform12_GLOBAL__N_17Wayland8FlushOutEv)
    *(.text._ZN2lx8platform12_GLOBAL__N_17Wayland5FlushEv)
    *(.text._ZN2lx8platform12_GLOBAL__N_17WaylandD1Ev)
    *(.text._ZN2lx8platform12_GLOBAL__N_17WaylandD2Ev)
    *(.text._ZN2lx8platform12_GLOBAL__N_17WaylandD0Ev)
    *(.text._ZNSt8_Rb_treeIjSt4pairIKjPN2lx8platform12_GLOBAL__N_18WlWindowEESt10_Select1stIS7_ESt4lessIjESaIS7_EE22_M_emplace_hint_uniqueIJRKSt21piecewise_construct_tSt5tupleIJRS1_EESI_IJEEEEESt17_Rb_tree_iteratorIS7_ESt23_Rb_tree_const_iteratorIS7_EDpOT_.constprop.0)
    *(.text._ZN2lx8platform12_GLOBAL__N_13MsgC1Ejt)
    *(.text._ZN2lx8platform12_GLOBAL__N_13MsgC2Ejt)
    *(.text._ZN2lx8platform12_GLOBAL__N_13Msg1SESt17basic_string_viewIcSt11char_traitsIcEE)
    *(.text._ZN2lx8platform12_GLOBAL__N_17Wayland4SendEONS1_3MsgE)
    *(.text._ZN2lx8platform12_GLOBAL__N_1L13FreeShmBufferERNS1_7WaylandEPNS1_6BufferE)
    *(.text._ZN2lx8platform12_GLOBAL__N_18WlWindow8DropRoleEv)
    *(.text._ZN2lx8platform12_GLOBAL__N_18WlWindow4HideEv)
    *(.text._ZN2lx8platform12_GLOBAL__N_18WlWindow15ApplySizeLimitsEv)
    *(.text._ZN2lx8platform12_GLOBAL__N_18WlWindow12SetResizableEb)
    *(.text._ZN2lx8platform12_GLOBAL__N_18WlWindow14SetMinimumSizeEii)
    *(.text._ZN2lx8platform12_GLOBAL__N_18WlWindow7SetSizeEii)
    *(.text._ZN2lx8platform12_GLOBAL__N_17Wayland14ApplyTextInputEv)
    *(.text._ZN2lx8platform12_GLOBAL__N_18WlWindow12SetTextInputEbPK8SDL_Rect)
    *(.text._ZN2lx8platform12_GLOBAL__N_18WlWindow7PresentEPK8SDL_Recti)
    *(.text._ZN2lx8platform12_GLOBAL__N_18WlWindow8MaximizeEv)
    *(.text._ZN2lx8platform12_GLOBAL__N_18WlWindow11SetBorderedEb)
    *(.text._ZN2lx8platform12_GLOBAL__N_1L12NewShmBufferERNS1_7WaylandEiib)
    *(.text._ZN2lx8platform12_GLOBAL__N_18WlWindow11FramebufferERiS3_S3_)
    *(.text._ZN2lx8platform12_GLOBAL__N_18WlWindow9ApplyIconEv)
    *(.text._ZN2lx8platform12_GLOBAL__N_18WlWindow15SetIntegerScaleEi)
    *(.text._ZN2lx8platform12_GLOBAL__N_18WlWindow9SetCursorENS0_6CursorE)
    *(.text._ZNSt3mapIjSt6vectorINSt7__cxx1112basic_stringIcSt11char_traitsIcESaIcEEESaIS6_EESt4lessIjESaISt4pairIKjS8_EEEixERSC_)
    *(.text._ZN2lx8platform12_GLOBAL__N_17Wayland8ReadSomeEi.part.0)
    *(.text._ZN2lx8platform12_GLOBAL__N_17Wayland7ReceiveEjRKNSt7__cxx1112basic_stringIcSt11char_traitsIcESaIcEEE)
    *(.text._ZN2lx8platform12_GLOBAL__N_17Wayland6HandleEjNS1_2IfEPvtRNS_2wl4ArgsE.constprop.0)
    *(.text._ZN2lx8platform12_GLOBAL__N_17Wayland9HandleAllEv)
    *(.text._ZN2lx8platform12_GLOBAL__N_17Wayland7WaitForERKSt8functionIFbvEEi)
    *(.text._ZN2lx8platform12_GLOBAL__N_17Wayland4OpenERNSt7__cxx1112basic_stringIcSt11char_traitsIcESaIcEEE)
    *(.text._ZN2lx8platform12_GLOBAL__N_18WlWindow5RaiseEv)
    *(.text._ZN2lx8platform12_GLOBAL__N_17Wayland12CreateWindowEP10SDL_WindowRKNSt7__cxx1112basic_stringIcSt11char_traitsIcESaIcEEEiim)
    *(.text._ZN2lx8platform12_GLOBAL__N_17Wayland8DispatchEv)
    *(.text._ZN16HelperFeedWriter4OpenEv)
    *(.text._ZN2lx12DrawFountainERKNS_4RectEdRK7PalettePKhmbb)
    *(.text._ZN2lx16DrawLiveFountainERKNS_4RectEdRK7Palette)
    *(.text._ZNSt6thread11_State_implINS_8_InvokerISt5tupleIJZN2lx12_GLOBAL__N_1L16StartProbeWorkerEvEUlvE_EEEEED1Ev)
    *(.text._ZNSt6thread11_State_implINS_8_InvokerISt5tupleIJZN2lx12_GLOBAL__N_1L16StartProbeWorkerEvEUlvE_EEEEED2Ev)
    *(.text._ZNSt6thread11_State_implINS_8_InvokerISt5tupleIJZN2lx12_GLOBAL__N_1L16StartProbeWorkerEvEUlvE_EEEEED0Ev)
    *(.text._ZN2lx12_GLOBAL__N_1L12PauseFadeNowEv)
    *(.text._ZN2lx12_GLOBAL__N_1L4ModeEv)
    *(.text._ZSt10from_charsIiLi0EESt17from_chars_resultPKcS2_RT_i.constprop.0)
    *(.text._ZNKSt8_Rb_treeINSt7__cxx1112basic_stringIcSt11char_traitsIcESaIcEEESt4pairIKS5_S5_ESt10_Select1stIS8_ESt4lessIS5_ESaIS8_EE4findERS7_.isra.0)
    *(.text._ZN2lx12_GLOBAL__N_1L7TextureERP11SDL_TextureSt17basic_string_viewIcSt11char_traitsIcEEPfS8_)
    *(.text._ZN2lx12_GLOBAL__N_1L10ApplyColorEb)
    *(.text._ZNSt8_Rb_treeINSt7__cxx1112basic_stringIwSt11char_traitsIwESaIwEEES5_St9_IdentityIS5_ESt4lessIS5_ESaIS5_EE8_M_eraseEPSt13_Rb_tree_nodeIS5_E.isra.0)
    *(.text._ZN2lx13TickAlternateEv)
    *(.text._ZN2lx13StopAlternateEv)
    *(.text._ZN2lx13AlbumListNodeD1Ev)
    *(.text._ZN2lx13AlbumListNodeD2Ev)
    *(.text._ZN2lx12_GLOBAL__N_19AlternateD1Ev)
    *(.text._ZN2lx12_GLOBAL__N_19AlternateD2Ev)
    *(.text._ZZN2lx14BuildAlbumListERK7LibraryiRKNSt7__cxx1112basic_stringIwSt11char_traitsIwESaIwEEEENKUlOT_mE_clIRSD_EENS_13AlbumListNodeESC_m)
    *(.text._ZN2lx18FountainAppearanceEv)
    *(.text._ZN2lx18FountainStyleShownEv)
    *(.text._ZN2lx11PauseFadingEv)
    *(.text._ZN2lx15WavePlayedColorERK7Palette)
    *(.text._ZN2lx16WaveRestingColorERK7Palette)
    *(.text._ZN2lx13WaveRestColorERK7Paletteb)
    *(.text._ZN2lx21LoadAlternateSettingsERKSt3mapINSt7__cxx1112basic_stringIcSt11char_traitsIcESaIcEEES6_St4lessIS6_ESaISt4pairIKS6_S6_EEE)
    *(.text._ZN2lx13AlternateModeEv)
    *(.text._ZN2lx19ActiveColumnHeadingEi)
    *(.text._ZN2lx17ActiveColumnTypesEv)
    *(.text._ZN2lx18ActiveColumnWidthsEv)
    *(.text._ZN2lx21AlternateThemeChangedEv)
    *(.text._ZN2lx23AlternateCatalogChangedEv)
    *(.text._ZN2lx20ApplyAlternateLayoutEv)
    *(.text._ZN2lx17DrawAlternateCellEjiRKNS_4RectENS_4FontERK7Palettei)
    *(.text._ZN2lx28FilterAlternateLibraryTracksERSt6vectorIjSaIjEE)
    *(.text._ZN2lx24ReleaseAlternateTexturesEv)
    *(.text._ZN2lx18WaveAppearanceMenuEv)
    *(.text._ZN2lx18RunAlternateActionEii)
    *(.text._ZN2lx20DrawAlternateOverlayERK7Palette)
    *(.text._ZN2lx14AlternateWheelEfff)
    *(.text._ZN2lx13AlternateTextEPKc)
    *(.text._ZN2lx12_GLOBAL__N_1L10ColumnTextERNS0_7ColumnsE)
    *(.text._ZN2lx12_GLOBAL__N_1L10DrawApolloERK7Palette)
    *(.text._ZN2lx13DrawAlternateERK7Palette)
    *(.text._ZN2lx19DrawAlternateStatusERK7Palette)
    *(.text._ZN2lx12_GLOBAL__N_1L13ToolbarActionEiff)
    *(.text._ZN2lx12AlternateKeyERK17SDL_KeyboardEvent)
    *(.text._ZN2lx14AlternateFieldEjRKNSt7__cxx1112basic_stringIwSt11char_traitsIwESaIwEEERS5_)
    *(.text._ZN2lx13LoadBigLayoutERKNSt7__cxx1112basic_stringIcSt11char_traitsIcESaIcEEE)
    *(.text._ZN2lx13BigLayoutTextB5cxx11Ev)
    *(.text._ZN2lx14ResetBigPanelsEv)
    *(.text._ZN2lx13BigPanelShownEi)
    *(.text._ZN2lx14ToggleBigPanelEi)
    *(.text._ZN2lx18LayoutPresentationENS_4RectERS0_)
    *(.text._ZN2lx13DrawBigPanelsERK7Palette)
    *(.text._ZN2lx21PresentationMouseDownEffii)
    *(.text._ZN2lx16CheckLinuxMemoryEv)
    *(.text.read)
    *(.text.write)
    *(.text.writev)
    *(.text.pread)
    *(.text.pwrite)
    *(.text.lseek)
    *(.text.close)
    *(.text.fsync)
    *(.text.ftruncate)
    *(.text.truncate)
    *(.text.sendfile)
    *(.text.posix_fadvise)
    *(.text.openat)
    *(.text.open)
    *(.text.fcntl)
    *(.text.ioctl)
    *(.text.dup)
    *(.text.dup2)
    *(.text.pipe)
    *(.text.pipe2)
    *(.text.poll)
    *(.text.select)
    *(.text.eventfd)
    *(.text.memfd_create)
    *(.text.inotify_init1)
    *(.text.inotify_add_watch)
    *(.text.__read_chk)
    *(.text.__openat_2)
    *(.text.__open_2)
    *(.text.stat)
    *(.text.lstat)
    *(.text.fstat)
    *(.text.statfs)
    *(.text.access)
    *(.text.chdir)
    *(.text.chmod)
    *(.text.fchmod)
    *(.text.mkdir)
    *(.text.rmdir)
    *(.text.unlink)
    *(.text.unlinkat)
    *(.text.rename)
    *(.text.link)
    *(.text.symlink)
    *(.text.readlink)
    *(.text.utimensat)
    *(.text.futimens)
    *(.text.socket)
    *(.text.socketpair)
    *(.text.bind)
    *(.text.listen)
    *(.text.accept)
    *(.text.connect)
    *(.text.shutdown)
    *(.text.sendto)
    *(.text.send)
    *(.text.sendmsg)
    *(.text.recvfrom)
    *(.text.recv)
    *(.text.recvmsg)
    *(.text.setsockopt)
    *(.text.getsockopt)
    *(.text.getsockname)
    *(.text.mmap)
    *(.text.munmap)
    *(.text.madvise)
    *(.text.mprotect)
    *(.text.shmget)
    *(.text.shmat)
    *(.text.shmdt)
    *(.text.getpid)
    *(.text.getuid)
    *(.text.geteuid)
    *(.text.getgid)
    *(.text.kill)
    *(.text.killpg)
    *(.text.setpriority)
    *(.text.nanosleep)
    *(.text.usleep)
    *(.text._exit)
    *(.text.syscall)
    *(.text.getrandom)
    *(.text.getentropy)
    *(.text._ZN4sse26MemchrEPKvim)
    *(.text._ZN4sse26StrlenEPKc)
    *(.text._ZN4sse26StrchrEPKci)
    *(.text._ZN4sse27StrncmpEPKcS1_m)
    *(.text._ZN4sse26StrcmpEPKcS1_)
    *(.text._ZN4avx26MemchrEPKvim)
    *(.text._ZN4avx26StrlenEPKc)
    *(.text._ZN4avx26StrchrEPKci)
    *(.text._ZN4avx27StrncmpEPKcS1_m)
    *(.text._ZN4avx26StrcmpEPKcS1_)
    *(.text._ZN4sse27MemmoveEPvPKvm)
    *(.text._ZN4avx26MemsetEPvim)
    *(.text._ZN4sse26MemsetEPvim)
    *(.text._ZN4avx27MemmoveEPvPKvm)
    *(.text._ZN4sse26MemcpyEPvPKvm)
    *(.text._ZN4avx26MemcpyEPvPKvm)
    *(.text._ZN4sse26MemcmpEPKvS1_m)
    *(.text._ZN4avx26MemcmpEPKvS1_m)
    *(.text.cordinal_resolve_memcpy)
    *(.text.cordinal_resolve_memmove)
    *(.text.cordinal_resolve_memset)
    *(.text.cordinal_resolve_memcmp)
    *(.text.cordinal_resolve_memchr)
    *(.text.cordinal_resolve_strlen)
    *(.text.cordinal_resolve_strchr)
    *(.text.cordinal_resolve_strcmp)
    *(.text.cordinal_resolve_strncmp)
    *(.text.cordinal_string_functions)
    *(.text.explicit_bzero)
    *(.text.strnlen)
    *(.text.strncpy)
    *(.text.strdup)
    *(.text.strspn)
    *(.text.strcspn)
    *(.text.strstr)
    *(.text.strcasecmp)
    *(.text.strncasecmp)
    *(.text.wcslen)
    *(.text.wcscmp)
    *(.text.wcschr)
    *(.text.wmemchr)
    *(.text.wmemcmp)
    *(.text.wmemcpy)
    *(.text.wmemmove)
    *(.text.wmemset)
    *(.text.wcscpy)
    *(.text._ZN12_GLOBAL__N_1L6ZoneAtEPKNS_4ZoneElRlRiRPKc)
    *(.text.cordinal_time_vdso)
    *(.text.cordinal_zone_name)
    *(.text.clock_gettime)
    *(.text.gettimeofday)
    *(.text.time)
    *(.text.difftime)
    *(.text.gmtime_r)
    *(.text.timegm)
    *(.text.tzset)
    *(.text.localtime_r)
    *(.text.readdir64)
    *(.text.closedir)
    *(.text.dirfd)
    *(.text.seekdir)
    *(.text.telldir)
    *(.text.rewinddir)
    *(.text.getcwd)
    *(.text.realpath)
    *(.text.mkstemp)
    *(.text.mkdtemp)
    *(.text.fchmodat)
    *(.text.statvfs)
    *(.text.fstatvfs)
    *(.text.getenv)
    *(.text._ZN12_GLOBAL__N_1L5SpawnEPiPKcPKvS4_PKPcS7_b)
    *(.text._ZN12_GLOBAL__N_1L10FillLockedEP8_IO_FILE)
    *(.text._ZN12_GLOBAL__N_1L11WriteLockedEP8_IO_FILEPKcm.part.0)
    *(.text._ZN8cordlibc10StreamLock7AcquireEv)
    *(.text._ZN12_GLOBAL__N_1L14FlushAllAtExitEv)
    *(.text._ZN8cordlibc10StreamLock10TryAcquireEv)
    *(.text._ZN8cordlibc10StreamLock7ReleaseEv)
    *(.text._ZN8cordlibc15StreamWantsReadEP8_IO_FILE)
    *(.text._ZN8cordlibc16StreamWantsWriteEP8_IO_FILE)
    *(.text.fopen)
    *(.text.fdopen)
    *(.text._ZN12_GLOBAL__N_1L11FormatFloatERNS_4SinkEeiijcb)
    *(.text._ZN12_GLOBAL__N_1L10FormatCoreERNS_4SinkEPKcPA1_13__va_list_tag)
    *(.text.vdprintf)
    *(.text.dprintf)
    *(.text.__sprintf_chk)
    *(.text.__snprintf_chk)
    *(.text.__vsnprintf_chk)
    *(.text.__vsprintf_chk)
    *(.text.vswprintf)
    *(.text.swprintf)
    *(.text._ZN12_GLOBAL__N_1L11ScanIntegerERNS_6SourceEibPvi.constprop.0)
    *(.text._ZN12_GLOBAL__N_1L8ScanCoreERNS_6SourceEPKcP13__va_list_tag.constprop.0)
    *(.text.__isoc99_scanf)
    *(.text.__isoc99_vswscanf)
    *(.text.__isoc99_swscanf)
    *(.text.__isoc23_vsscanf)
    *(.text.__isoc23_sscanf)
    *(.text.__isoc23_vfscanf)
    *(.text.__isoc23_fscanf)
    *(.text.__isoc23_vscanf)
    *(.text.__isoc23_scanf)
    *(.text.__isoc23_vswscanf)
    *(.text.__isoc23_swscanf)
    *(.text._ZN12_GLOBAL__N_1L6FinishINS_11FloatFormatEEENT_4TypeEbmlNS_4TailE)
    *(.text._ZN12_GLOBAL__N_1L12DecimalValueINS_11FloatFormatEcEENT_4TypeEPKT0_S6_b)
    *(.text._ZN12_GLOBAL__N_1L6FinishINS_12DoubleFormatEEENT_4TypeEbmlNS_4TailE)
    *(.text._ZN12_GLOBAL__N_1L12DecimalValueINS_12DoubleFormatEcEENT_4TypeEPKT0_S6_b)
    *(.text._ZN12_GLOBAL__N_1L6FinishINS_16LongDoubleFormatEEENT_4TypeEbmlNS_4TailE)
    *(.text._ZN12_GLOBAL__N_1L12DecimalValueINS_16LongDoubleFormatEcEENT_4TypeEPKT0_S6_b)
    *(.text._ZN12_GLOBAL__N_1L12ParseIntegerIlcLb0EEET_PKT0_PPS2_ib)
    *(.text._ZN12_GLOBAL__N_1L12ParseIntegerImcLb1EEET_PKT0_PPS2_ib)
    *(.text._ZN12_GLOBAL__N_1L12ParseIntegerIlwLb0EEET_PKT0_PPS2_ib)
    *(.text._ZN12_GLOBAL__N_1L12ParseIntegerImwLb1EEET_PKT0_PPS2_ib)
    *(.text._ZN12_GLOBAL__N_1L12DecimalValueINS_11FloatFormatEwEENT_4TypeEPKT0_S6_b)
    *(.text._ZN12_GLOBAL__N_1L10ParseFloatINS_11FloatFormatEcEENT_4TypeERPKT0_)
    *(.text._ZN12_GLOBAL__N_1L10ParseFloatINS_12DoubleFormatEcEENT_4TypeERPKT0_)
    *(.text._ZN12_GLOBAL__N_1L10ParseFloatINS_16LongDoubleFormatEcEENT_4TypeERPKT0_)
    *(.text.strtof)
    *(.text.strtod)
    *(.text.strtold)
    *(.text.__strtof_l)
    *(.text.__strtod_l)
    *(.text.strtold_l)
    *(.text.strtol)
    *(.text.strtoll)
    *(.text.strtoul)
    *(.text.strtoull)
    *(.text.__isoc23_strtol)
    *(.text.__isoc23_strtoll)
    *(.text.__isoc23_strtoul)
    *(.text.__isoc23_strtoull)
    *(.text.wcstol)
    *(.text.wcstoll)
    *(.text.wcstoul)
    *(.text.wcstoull)
    *(.text.__isoc23_wcstol)
    *(.text.__isoc23_wcstoll)
    *(.text.__isoc23_wcstoul)
    *(.text.__isoc23_wcstoull)
    *(.text.wcstof)
    *(.text.wcstod)
    *(.text.wcstold)
    *(.text._ZN12_GLOBAL__N_1L14IsoWeeksInYearEi)
    *(.text._ZN12_GLOBAL__N_1L10Utf8ToWideEPwPKcmRNS_7MbStateE)
    *(.text._ZN12_GLOBAL__N_1L6NameOfEi)
    *(.text._ZN12_GLOBAL__N_1L14PutNumberFieldERNS_4SinkExRKNS_5FlagsEic.isra.0)
    *(.text._ZN12_GLOBAL__N_1L12EnsureTablesEv.part.0)
    *(.text._ZN12_GLOBAL__N_1L4LoadEPKc.part.0)
    *(.text.newlocale)
    *(.text.__newlocale)
    *(.text.duplocale)
    *(.text.__duplocale)
    *(.text.freelocale)
    *(.text.__freelocale)
    *(.text.uselocale)
    *(.text.__uselocale)
    *(.text.__ctype_get_mb_cur_max)
    *(.text.isalnum)
    *(.text.isalpha)
    *(.text.isspace)
    *(.text.isxdigit)
    *(.text.tolower)
    *(.text.toupper)
    *(.text.iswalnum)
    *(.text.iswalpha)
    *(.text.iswdigit)
    *(.text.iswspace)
    *(.text.iswxdigit)
    *(.text.towlower)
    *(.text.towupper)
    *(.text.CtypeOf)
    *(.text.towlower_l)
    *(.text.towupper_l)
    *(.text.__towlower_l)
    *(.text.__towupper_l)
    *(.text.__wctype_l)
    *(.text.__iswctype_l)
    *(.text.wcscasecmp)
    *(.text.wcsncasecmp)
    *(.text.mbrtowc)
    *(.text.wcrtomb)
    *(.text.btowc)
    *(.text.wctob)
    *(.text.mbsnrtowcs)
    *(.text._ZN9cord_trig12_GLOBAL__N_1L16__rem_pio2_largeEPdS1_iii)
    *(.text._ZN9cord_trig12_GLOBAL__N_1L10__rem_pio2EdPd)
    *(.text._ZN9cord_trig12_GLOBAL__N_1L16__rem_pio2_largeEPdS1_iii.constprop.0)
    *(.text.floorf)
    *(.text.ceilf)
    *(.text.round)
    *(.text.roundf)
    *(.text.roundl)
    *(.text.fegetround)
    *(.text.fesetround)
    *(.text.nearbyint)
    *(.text.nearbyintf)
    *(.text.lrint)
    *(.text.lround)
    *(.text.llround)
    *(.text.lroundf)
    *(.text.sqrt)
    *(.text.sqrtf)
    *(.text.fmod)
    *(.text.hypot)
    *(.text.hypotf)
    *(.text.cabs)
    *(.text.cabsf)
    *(.text.exp)
    *(.text.exp2)
    *(.text.expf)
    *(.text.exp2f)
    *(.text.log)
    *(.text.log2)
    *(.text.log10)
    *(.text.log10f)
    *(.text.log1pf)
    *(.text.pow)
    *(.text.powf)
    *(.text.sin)
    *(.text.cos)
    *(.text.tan)
    *(.text.sincos)
    *(.text.sinf)
    *(.text.cosf)
    *(.text.sincosf)
    *(.text.atan)
    *(.text.atan2)
    *(.text.atanf)
    *(.text.atan2f)
    *(.text.cosh)
    *(.text._ZN12_GLOBAL__N_1L7IsAlnumEh)
    *(.text._ZZN12_GLOBAL__N_1L7InClassEPKcihENUlhE_4_FUNEh)
    *(.text._ZZN12_GLOBAL__N_1L7InClassEPKcihENUlhE0_4_FUNEh)
    *(.text._ZZN12_GLOBAL__N_1L7InClassEPKcihENUlhE1_4_FUNEh)
    *(.text._ZZN12_GLOBAL__N_1L7InClassEPKcihENUlhE2_4_FUNEh)
    *(.text._ZZN12_GLOBAL__N_1L7InClassEPKcihENUlhE3_4_FUNEh)
    *(.text._ZZN12_GLOBAL__N_1L7InClassEPKcihENUlhE4_4_FUNEh)
    *(.text._ZZN12_GLOBAL__N_1L7InClassEPKcihENUlhE5_4_FUNEh)
    *(.text._ZZN12_GLOBAL__N_1L7InClassEPKcihENUlhE6_4_FUNEh)
    *(.text._ZZN12_GLOBAL__N_1L7InClassEPKcihENUlhE7_4_FUNEh)
    *(.text._ZZN12_GLOBAL__N_1L7InClassEPKcihENUlhE8_4_FUNEh)
    *(.text._ZZN12_GLOBAL__N_1L7InClassEPKcihENUlhE9_4_FUNEh)
    *(.text._ZN12_GLOBAL__N_1L11PutTogetherEboiRb)
    *(.text._ZN12_GLOBAL__N_1L12RoundInPlaceEPcRiiS1_)
    *(.text.pthread_getattr_np)
    *(.text.pthread_setschedparam)
    *(.text.pthread_sigmask)
    *(.text.pthread_kill)
    *(.text.pthread_setcancelstate)
    *(.text.pthread_once)
    *(.text.pthread_mutex_lock)
    *(.text.pthread_mutex_trylock)
    *(.text.pthread_mutex_unlock)
    *(.text._ZN12_GLOBAL__N_1L8CondWaitEP14pthread_cond_tP15pthread_mutex_tiPK8timespec)
    *(.text.pthread_mutex_destroy)
    *(.text.pthread_cond_wait)
    *(.text.pthread_cond_timedwait)
    *(.text.pthread_cond_clockwait)
    *(.text.pthread_cond_signal)
    *(.text.pthread_cond_broadcast)
    *(.text.pthread_cond_destroy)
    *(.text.pthread_rwlock_rdlock)
    *(.text.pthread_rwlock_tryrdlock)
    *(.text.pthread_rwlock_wrlock)
    *(.text.pthread_rwlock_trywrlock)
    *(.text.pthread_rwlock_unlock)
    *(.text.pthread_rwlock_destroy)
    *(.text.pthread_key_create)
    *(.text.pthread_key_delete)
    *(.text.pthread_getspecific)
    *(.text.pthread_setspecific)
    *(.text.__cxa_thread_atexit_impl)
    *(.text.__register_atfork)
    *(.text.pthread_atfork)
    *(.text._ZN8cordlibc13AtForkPrepareEv)
    *(.text._ZN8cordlibc12AtForkParentEv)
    *(.text._ZN8cordlibc11AtForkChildEv)
    *(.text._ZN8cordlibc12ThreadsFactsEPl)
    *(.text._ZN8cordlibc8TlsProbeEi)
    *(.text._ZN8cordlibc21RunMainThreadDtorsNowEv)
    *(.text.__tls_get_addr)
    *(.text.dl_iterate_phdr)
    *(.text.__errno_location)
    *(.text._dl_find_object)
    *(.text._ZN12_GLOBAL__N_1L20WriteAslrBaseAndStopEv)
    *(.text._Z24cordlibc_AfterRelocationmRKN12_GLOBAL__N_19StartArgsE)
    *(.text.cordlibc_Boot)
    *(.text._ZZ13__assert_failENKUlPKcE_clES0_.isra.0)
    *(.text.atexit)
    *(.text.__cxa_atexit)
    *(.text.__cxa_finalize)
    *(.text.abort)
    *(.text.__stack_chk_fail)
    *(.text.__assert_fail)
    *(.text._ZN15cordlibc_loader12_GLOBAL__N_1L12SetPathErrorEPKcS2_)
    *(.text._ZN15cordlibc_loader12_GLOBAL__N_1L14SetSymbolErrorEPKcS2_)
    *(.text._ZN15cordlibc_loader12_GLOBAL__N_1L10FindSymbolERKNS0_6ModuleEPKc)
    *(.text.dlsym)
    *(.text.dlclose)
    *(.text.dlerror)
    *(.text.dladdr)
    *(.text.dladdr1)
    *(.text._ZN12_GLOBAL__N_1L14AfterForkChildEv)
    *(.text._ZN12_GLOBAL__N_1L5PurgeEv)
    *(.text._ZN12_GLOBAL__N_1L9FreePagesEPNS_4SpanE)
    *(.text._ZN12_GLOBAL__N_1L15AfterForkParentEv)
    *(.text._ZN12_GLOBAL__N_1L11ThreadEndedEPv)
    *(.text._ZN12_GLOBAL__N_1L10BeforeForkEv)
    *(.text._ZN12_GLOBAL__N_1L8AllocRunEmb)
    *(.text._ZN12_GLOBAL__N_1L10TakeBlocksEiPPNS_5BlockEj)
    *(.text._ZN12_GLOBAL__N_1L5SetUpERNS_5CacheE.constprop.0)
    *(.text._ZN12_GLOBAL__N_1L11ReturnBlockEiPNS_5BlockE)
    *(.text._ZN12_GLOBAL__N_1L10AllocSmallEi)
    *(.text._ZN12_GLOBAL__N_1L8AllocateEmb)
    *(.text._ZN12_GLOBAL__N_1L12AllocateSlowEm)
    *(.text._ZN12_GLOBAL__N_1L11ReleaseSlowEPv)
    *(.text._ZN12_GLOBAL__N_1L7ReleaseEPv)
    *(.text._ZN8cordlibc11ForkPrepareEv)
    *(.text._ZN8cordlibc10ForkParentEv)
    *(.text._ZN8cordlibc9ForkChildEv)
    *(.text.malloc)
    *(.text.free)
    *(.text.calloc)
    *(.text.realloc)
    *(.text.posix_memalign)
    *(.text.aligned_alloc)
    *(.text.memalign)
    *(.text._ZN12_GLOBAL__N_1L13ReadDirectoryER10FileSourceRSt6vectorINS_5EntryESaIS3_EE)
    *(.text._Z12ZipDataStartR10FileSourceRK8ZipEntry)
    *(.text._Z13IsArchiveFileRKNSt7__cxx1112basic_stringIwSt11char_traitsIwESaIwEEE)
    *(.text._Z16SplitArchivePathRKNSt7__cxx1112basic_stringIwSt11char_traitsIwESaIwEEERS4_S7_)
    *(.text._Z11ContainerOfRKNSt7__cxx1112basic_stringIwSt11char_traitsIwESaIwEEE)
    *(.text._Z11ListArchiveRKNSt7__cxx1112basic_stringIwSt11char_traitsIwESaIwEEERSt6vectorIS4_SaIS4_EE)
    *(.text._ZN12_GLOBAL__N_1L12ResolveAudioERKNSt7__cxx1112basic_stringIwSt11char_traitsIwESaIwEEES7_.isra.0)
    *(.text._ZN8CueSheetD1Ev)
    *(.text._ZN8CueSheetD2Ev)
    *(.text._ZN8CueTrackD1Ev)
    *(.text._ZN8CueTrackD2Ev)
    *(.text._Z11AudioFileOfRKNSt7__cxx1112basic_stringIwSt11char_traitsIwESaIwEEE)
    *(.text._Z9IsCueFileRKNSt7__cxx1112basic_stringIwSt11char_traitsIwESaIwEEE)
    *(.text._ZN12_GLOBAL__N_1L14ParseBinaryCueESt17basic_string_viewIcSt11char_traitsIcEEjR8CueSheet.constprop.0)
    *(.text._Z16OpenTrackDecoderRKNSt7__cxx1112basic_stringIwSt11char_traitsIwESaIwEEEjRS4_)
    *(.text._ZNK7Decoder8FastSeekEv)
    *(.text._ZNK7Decoder7ProblemB5cxx11Ev)
    *(.text._ZNK7Decoder14LosslessFormatER9PcmFormat)
    *(.text._ZNK11nativeaudio13PacketDecoder4RateEv)
    *(.text._ZNK11nativeaudio13PacketDecoder8DurationEv)
    *(.text._ZN11nativeaudio13PacketDecoder5ResetEv)
    *(.text._ZNK11nativeaudio13PacketDecoder7PrerollEv)
    *(.text._ZNK11nativeaudio13PacketDecoder7CaptureEv)
    *(.text._ZN11nativeaudio13PacketDecoder7RestoreERKNS0_5StateE)
    *(.text._ZNK12_GLOBAL__N_112RangeDecoder4RateEv)
    *(.text._ZNK12_GLOBAL__N_112RangeDecoder6FailedEv)
    *(.text._ZNK12_GLOBAL__N_111LoopDecoder4RateEv)
    *(.text._ZNK12_GLOBAL__N_111LoopDecoder6FailedEv)
    *(.text._ZN12_GLOBAL__N_112RangeDecoderD1Ev)
    *(.text._ZN12_GLOBAL__N_112RangeDecoderD2Ev)
    *(.text._ZN12_GLOBAL__N_111LoopDecoderD1Ev)
    *(.text._ZN12_GLOBAL__N_111LoopDecoderD2Ev)
    *(.text._ZN12_GLOBAL__N_112RangeDecoderD0Ev)
    *(.text._ZN12_GLOBAL__N_111LoopDecoderD0Ev)
    *(.text._ZN13LosslessExactD1Ev)
    *(.text._ZN13LosslessExactD2Ev)
    *(.text._ZNK11nativeaudio13PacketDecoder8FastSeekEv)
    *(.text._ZNK7Decoder10CanPreviewEv)
    *(.text._ZN13LosslessExactD0Ev)
    *(.text._ZN11nativeaudio13PacketDecoder4SeekEd)
    *(.text._ZNK12_GLOBAL__N_112RangeDecoder8DurationEv)
    *(.text._ZN12_GLOBAL__N_112RangeDecoder5AbortEv)
    *(.text._Z13OpenPcmReaderRKNSt7__cxx1112basic_stringIwSt11char_traitsIwESaIwEEERS4_)
    *(.text._Z11OpenDecoderRKNSt7__cxx1112basic_stringIwSt11char_traitsIwESaIwEEEjRS4_)
    *(.text._ZN11nativeaudio13PacketDecoder8RememberEmm)
    *(.text._ZN11nativeaudio13PacketDecoder4ReadEPfm)
    *(.text._ZN6Reverb7ProcessEPfm)
    *(.text._ZN11TimeStretch5ResetEv)
    *(.text._ZN11TimeStretch9ConfigureEjd)
    *(.text._ZN11PeakLimiter9ConfigureEjf)
    *(.text._ZN11PeakLimiter7ProcessEPfm)
    *(.text._ZNK7Decoder6FailedEv)
    *(.text._ZN12_GLOBAL__N_1L18ObservePipelinePcmEPKfm)
    *(.text._ZNSt6thread11_State_implINS_8_InvokerISt5tupleIJZN6Engine4Impl18EnsureDecodeThreadEvEUlvE_EEEEED1Ev)
    *(.text._ZNSt6thread11_State_implINS_8_InvokerISt5tupleIJZN6Engine4Impl18EnsureDecodeThreadEvEUlvE_EEEEED2Ev)
    *(.text._ZNSt6thread11_State_implINS_8_InvokerISt5tupleIJZN6Engine4Impl18EnsureDecodeThreadEvEUlvE_EEEEED0Ev)
    *(.text._ZNSt17_Function_handlerIFmPfmRyEZN6Engine4Impl11StartOutputERNSt7__cxx1112basic_stringIwSt11char_traitsIwESaIwEEEEUlS0_mS1_E_E10_M_managerERSt9_Any_dataRKSE_St18_Manager_operation)
    *(.text._ZNSt17_Function_handlerIFvjEZN6Engine4Impl11StartOutputERNSt7__cxx1112basic_stringIwSt11char_traitsIwESaIwEEEEUljE_E10_M_managerERSt9_Any_dataRKSC_St18_Manager_operation)
    *(.text._ZNSt15_Deque_iteratorIN12_GLOBAL__N_17CommandERS1_PS1_EpLEl.isra.0)
    *(.text._ZSt23__copy_move_backward_a2ILb1EPfS0_ET1_T0_S2_S1_.isra.0)
    *(.text._ZNSt15_Deque_iteratorIN12_GLOBAL__N_16MarkerERS1_PS1_EpLEl.isra.0)
    *(.text._ZNSt11_Deque_baseIN12_GLOBAL__N_17CommandESaIS1_EE17_M_initialize_mapEm.constprop.0)
    *(.text._ZNSt6vectorIfSaIfEE14_M_move_assignEOS1_St17integral_constantIbLb1EE.isra.0)
    *(.text._ZN6Engine4Impl9WriteRingEPKfm.part.0)
    *(.text._ZN12_GLOBAL__N_1L7DsdPathERKNSt7__cxx1112basic_stringIwSt11char_traitsIwESaIwEEERS5_)
    *(.text._ZN12_GLOBAL__N_113CrossfadeTail4HoldEPKfmRSt6vectorIfSaIfEE)
    *(.text._ZNSt5dequeIN12_GLOBAL__N_16MarkerESaIS1_EE12emplace_backIJS1_EEERS1_DpOT_.isra.0)
    *(.text._ZNSt6vectorIfSaIfEE15_M_range_insertIN9__gnu_cxx17__normal_iteratorIPfS1_EEEEvS6_T_S7_St20forward_iterator_tag.isra.0)
    *(.text._ZNSt5mutex4lockEv)
    *(.text._Z12CrossfadePcmRKSt6vectorIfSaIfEES3_jdff)
    *(.text._Z15VolumeCurveGainfi)
    *(.text._Z7ClipPcmPfm)
    *(.text._ZN6Engine4Impl11StartOutputERNSt7__cxx1112basic_stringIwSt11char_traitsIwESaIwEEE)
    *(.text._ZN6Engine4Impl12AllocateRingEv)
    *(.text._ZZ23BenchmarkPlayerPipelineRKNSt7__cxx1112basic_stringIwSt11char_traitsIwESaIwEEEjjR14PipelineTimingENKUlRmS9_E_clES9_S9_)
    *(.text._ZN6Engine4Impl4EmitEPKfm)
    *(.text._ZN6Engine4Impl9WriteTailEv)
    *(.text._ZN11TimeStretchD1Ev)
    *(.text._ZN11TimeStretchD2Ev)
    *(.text._ZNK6Engine4Impl8PositionEv)
    *(.text._ZN6Engine4InitEP6HWND__RNSt7__cxx1112basic_stringIwSt11char_traitsIwESaIwEEEb)
    *(.text._ZN6Engine19DecodeThreadStartedEv)
    *(.text._ZN6Engine9SetPausedEb)
    *(.text._ZN6Engine9SetVolumeEf)
    *(.text._ZN6Engine8SetLoopsEid)
    *(.text._ZN6Engine12SetCrossfadeEd)
    *(.text._ZN6Engine12SetExclusiveEb)
    *(.text._ZN6Engine12SetNativeDsdEb)
    *(.text._ZN6Engine8SetUpmixEb)
    *(.text._ZN6Engine15SetOutputDeviceERKNSt7__cxx1112basic_stringIcSt11char_traitsIcESaIcEEE)
    *(.text._ZNK6Engine6OutputEv)
    *(.text._ZN6Engine5SetEqERK10EqSettings)
    *(.text._ZN6Engine10SetLimiterEbf)
    *(.text._ZN6Engine9SetReverbERK14ReverbSettings)
    *(.text._ZN6Engine11SetBitcrushERK16BitcrushSettings)
    *(.text._ZN6Engine14SetSmartVolumeEbb)
    *(.text._ZN6Engine12TakeEstimateEy)
    *(.text._ZNK6Engine6PausedEv)
    *(.text._ZNK6Engine8PositionEv)
    *(.text._ZNK6Engine11PlayingGainEv)
    *(.text._ZNK6Engine4RateEv)
    *(.text._ZN6Engine8SetScopeEb)
    *(.text._ZNK6Engine13VisualSamplesEPfmRd)
    *(.text._ZNK6Engine13WaveformPeaksEPhm)
    *(.text._ZNK6Engine13WaveformBandsEPfm)
    *(.text._ZNK6Engine5ScopeEPfm)
    *(.text._ZNK6Engine8DurationEv)
    *(.text._ZN12_GLOBAL__N_1L8OpenItemERK8PlayItemjidRNSt7__cxx1112basic_stringIwSt11char_traitsIwESaIwEEE)
    *(.text._ZN6Engine4Impl10OpenStreamERK8PlayItemR12DsdTransportRjbRNSt7__cxx1112basic_stringIwSt11char_traitsIwESaIwEEE)
    *(.text._ZN8PlayItemaSERKS_)
    *(.text._ZSt14__copy_move_a1ILb1EPN12_GLOBAL__N_16MarkerES1_EN9__gnu_cxx11__enable_ifIXsrSt27__is_any_random_access_iterIT0_DTcl26__iter_concept_or_categoryIS6_EEEE7__valueESt15_Deque_iteratorIT1_RSA_PSA_EE6__typeES6_S6_SD_)
    *(.text._ZSt23__copy_move_backward_a1ILb1EPN12_GLOBAL__N_16MarkerES1_EN9__gnu_cxx11__enable_ifIXsrSt27__is_any_random_access_iterIT0_DTcl26__iter_concept_or_categoryIS6_EEEE7__valueESt15_Deque_iteratorIT1_RSA_PSA_EE6__typeES6_S6_SD_)
    *(.text._ZSt14__copy_move_a1ILb1EPN12_GLOBAL__N_17CommandES1_EN9__gnu_cxx11__enable_ifIXsrSt27__is_any_random_access_iterIT0_DTcl26__iter_concept_or_categoryIS6_EEEE7__valueESt15_Deque_iteratorIT1_RSA_PSA_EE6__typeES6_S6_SD_)
    *(.text._ZSt23__copy_move_backward_a1ILb1EPN12_GLOBAL__N_17CommandES1_EN9__gnu_cxx11__enable_ifIXsrSt27__is_any_random_access_iterIT0_DTcl26__iter_concept_or_categoryIS6_EEEE7__valueESt15_Deque_iteratorIT1_RSA_PSA_EE6__typeES6_S6_SD_)
    *(.text._ZN6Engine4Impl8FlushAllEv)
    *(.text._ZNSt5dequeIN12_GLOBAL__N_16MarkerESaIS1_EE15_M_erase_at_endESt15_Deque_iteratorIS1_RS1_PS1_E)
    *(.text._ZN6Engine8ShutdownEv)
    *(.text._ZN6Engine4Impl7SetNextERN12_GLOBAL__N_17CommandE)
    *(.text._ZNSt5dequeIN12_GLOBAL__N_17CommandESaIS1_EE8_M_eraseESt15_Deque_iteratorIS1_RS1_PS1_ES7_.isra.0)
    *(.text._ZNSt8__detail10__erase_ifISt5dequeIN12_GLOBAL__N_17CommandESaIS3_EES5_ZN6Engine4Impl7EnqueueES3_EUlRKS3_E1_EENT_9size_typeERSB_RT0_T1_.isra.0)
    *(.text._ZNSt8__detail10__erase_ifISt5dequeIN12_GLOBAL__N_17CommandESaIS3_EES5_ZN6Engine4Impl7EnqueueES3_EUlRKS3_E_EENT_9size_typeERSB_RT0_T1_.isra.0)
    *(.text._ZNSt8__detail10__erase_ifISt5dequeIN12_GLOBAL__N_17CommandESaIS3_EES5_ZN6Engine4Impl7EnqueueES3_EUlRKS3_E0_EENT_9size_typeERSB_RT0_T1_.isra.0)
    *(.text._ZNSt8__detail10__erase_ifISt5dequeIN12_GLOBAL__N_17CommandESaIS3_EES5_ZN6Engine4Impl7EnqueueES3_EUlRKS3_E2_EENT_9size_typeERSB_RT0_T1_.isra.0)
    *(.text._ZN6Engine4Impl7EnqueueEN12_GLOBAL__N_17CommandE)
    *(.text._ZNSt17_Function_handlerIFvjEZN6Engine4Impl11StartOutputERNSt7__cxx1112basic_stringIwSt11char_traitsIwESaIwEEEEUljE_E9_M_invokeERKSt9_Any_dataOj)
    *(.text._ZN6Engine4PlayERK8PlayItemdb)
    *(.text._ZN6Engine7SetNextEyPK8PlayItem)
    *(.text._ZN6Engine4StopEv)
    *(.text._ZN6Engine4SeekEdPK8PlayItem)
    *(.text._ZN6Engine8SetSpeedEd)
    *(.text._ZN6Engine8SetTempoEd)
    *(.text._ZNSt5dequeIN12_GLOBAL__N_17CommandESaIS1_EED1Ev)
    *(.text._ZNSt5dequeIN12_GLOBAL__N_17CommandESaIS1_EED2Ev)
    *(.text._Z23BenchmarkPlayerPipelineRKNSt7__cxx1112basic_stringIwSt11char_traitsIwESaIwEEEjjR14PipelineTiming)
    *(.text._ZNSt11unique_lockISt5mutexE6unlockEv)
    *(.text._ZN6Engine4Impl9BeginHoldEv)
    *(.text._ZNSt10_HashtableIySt4pairIKydESaIS2_ENSt8__detail10_Select1stESt8equal_toIyESt4hashIyENS4_18_Mod_range_hashingENS4_20_Default_ranged_hashENS4_20_Prime_rehash_policyENS4_17_Hashtable_traitsILb0ELb0ELb1EEEE21_M_insert_unique_nodeEmmPNS4_10_Hash_nodeIS2_Lb0EEEm)
    *(.text._ZN6Engine4Impl8EstimateEPKfmb)
    *(.text._ZNSt10_HashtableIySt4pairIKyfESaIS2_ENSt8__detail10_Select1stESt8equal_toIyESt4hashIyENS4_18_Mod_range_hashingENS4_20_Default_ranged_hashENS4_20_Prime_rehash_policyENS4_17_Hashtable_traitsILb0ELb0ELb1EEEE21_M_insert_unique_nodeEmmPNS4_10_Hash_nodeIS2_Lb0EEEm)
    *(.text._ZNSt10_HashtableIySt4pairIKyfESaIS2_ENSt8__detail10_Select1stESt8equal_toIyESt4hashIyENS4_18_Mod_range_hashingENS4_20_Default_ranged_hashENS4_20_Prime_rehash_policyENS4_17_Hashtable_traitsILb0ELb0ELb1EEEE5eraseENS4_20_Node_const_iteratorIS2_Lb0ELb0EEE)
    *(.text._ZN6Engine7SetGainEyfb)
    *(.text._ZNSt5dequeISt4pairIyNSt7__cxx1112basic_stringIwSt11char_traitsIwESaIwEEEESaIS7_EE17_M_reallocate_mapEmb)
    *(.text._ZN6Engine4Impl4FailERK8PlayItemRKNSt7__cxx1112basic_stringIwSt11char_traitsIwESaIwEEE)
    *(.text._ZN6Engine4Impl11OpenWaitingEv)
    *(.text._ZN6Engine4Impl9OpenTrackERK8PlayItemdbSt10unique_ptrI7DecoderSt14default_deleteIS5_EEb12DsdTransportj)
    *(.text._ZN6Engine4Impl6DoSeekEdPK8PlayItem)
    *(.text._ZN6Engine4Impl12ReportDamageERKNSt7__cxx1112basic_stringIwSt11char_traitsIwESaIwEEE)
    *(.text._ZN6Engine4Impl10DecodeLoopEv)
    *(.text._ZNSt5dequeISt4pairIyNSt7__cxx1112basic_stringIwSt11char_traitsIwESaIwEEEESaIS7_EE8_M_eraseESt15_Deque_iteratorIS7_RS7_PS7_E)
    *(.text._ZN6Engine9TakeErrorB5cxx11Ey)
    *(.text._ZNK8chiptune8Emulator5EndedEv)
    *(.text._ZN12_GLOBAL__N_116GameMusicDecoder4SeekEd)
    *(.text._ZNK12_GLOBAL__N_116GameMusicDecoder8DurationEv)
    *(.text._ZNK12_GLOBAL__N_116GameMusicDecoder4RateEv)
    *(.text._ZN12_GLOBAL__N_116GameMusicDecoderD1Ev)
    *(.text._ZN12_GLOBAL__N_116GameMusicDecoderD2Ev)
    *(.text._ZN12_GLOBAL__N_116GameMusicDecoderD0Ev)
    *(.text._ZN12_GLOBAL__N_116GameMusicDecoder4ReadEPfm)
    *(.text._Z18SplitGameMusicPathRKNSt7__cxx1112basic_stringIwSt11char_traitsIwESaIwEEERS4_Ri)
    *(.text._Z15IsGameMusicFileRKNSt7__cxx1112basic_stringIwSt11char_traitsIwESaIwEEE)
    *(.text._ZN8chiptune9TrackInfoD1Ev)
    *(.text._ZN8chiptune9TrackInfoD2Ev)
    *(.text._ZN12_GLOBAL__N_1L7OpenEmuERKNSt7__cxx1112basic_stringIwSt11char_traitsIwESaIwEEERSt10unique_ptrIN8chiptune8EmulatorESt14default_deleteISA_EERS5_.constprop.0)
    *(.text._ZN11musicbrainz5StartERKNSt7__cxx1112basic_stringIwSt11char_traitsIwESaIwEEEb)
    *(.text._ZN11musicbrainz4StopEv)
    *(.text._ZN11musicbrainz10SetEnabledEb)
    *(.text._ZN11musicbrainz7EnabledEv)
    *(.text._ZN11musicbrainz4BusyEv)
    *(.text._ZN11musicbrainz4TickEv)
    *(.text._ZNSt8_Rb_treeINSt7__cxx1112basic_stringIwSt11char_traitsIwESaIwEEESt4pairIKS5_N11customcover12_GLOBAL__N_15EntryEESt10_Select1stISB_ESt4lessIS5_ESaISB_EE22_M_emplace_hint_uniqueIJRKSt21piecewise_construct_tSt5tupleIJOS5_EESM_IJEEEEESt17_Rb_tree_iteratorISB_ESt23_Rb_tree_const_iteratorISB_EDpOT_.constprop.0.isra.0)
    *(.text._ZNSt8_Rb_treeINSt7__cxx1112basic_stringIwSt11char_traitsIwESaIwEEESt4pairIKS5_NS1_IcS2_IcESaIcEEEESt10_Select1stISB_ESt4lessIS5_ESaISB_EE22_M_emplace_hint_uniqueIJRKSt21piecewise_construct_tSt5tupleIJRS7_EESM_IJEEEEESt17_Rb_tree_iteratorISB_ESt23_Rb_tree_const_iteratorISB_EDpOT_.isra.0)
    *(.text._ZN11customcover12_GLOBAL__N_1L18EnsureLoadedLockedEv)
    *(.text._ZN11customcover5StartERKNSt7__cxx1112basic_stringIwSt11char_traitsIwESaIwEEE)
    *(.text._ZN11customcover8ImageForERKNSt7__cxx1112basic_stringIwSt11char_traitsIwESaIwEEE)
    *(.text._ZN11customcover12SourceUrlForERKNSt7__cxx1112basic_stringIwSt11char_traitsIwESaIwEEE)
    *(.text._ZN7discord12ActivityJsonB5cxx11ERKNS_10NowPlayingENS_4ShowEllSt17basic_string_viewIcSt11char_traitsIcEE)
    *(.text._ZN7discord14PreferredCoverB5cxx11ESt17basic_string_viewIcSt11char_traitsIcEES3_)
    *(.text._ZN7discord9AvailableEv)
    *(.text._ZN7discord4ModeEv)
    *(.text._ZN7discord4StopEv)
    *(.text._ZN7discord18SetEndpointForTestERKNSt7__cxx1112basic_stringIcSt11char_traitsIcESaIcEEE)
    *(.text._ZN7discord11SentForTestEv)
    *(.text._ZNSt3mapINSt7__cxx1112basic_stringIwSt11char_traitsIwESaIwEEENS1_IcS2_IcESaIcEEESt4lessIS5_ESaISt4pairIKS5_S8_EEEixERSC_)
    *(.text._ZN7discord12_GLOBAL__N_1L8CoverForERKNS_10NowPlayingE)
    *(.text._ZZ11SortObjectsIN9__gnu_cxx17__normal_iteratorIPNSt7__cxx1112basic_stringIwSt11char_traitsIwESaIwEEESt6vectorIS7_SaIS7_EEEEZ17CollectAudioFilesRKS7_RSB_PKSt6atomicIbEEUlSE_SE_E_EvT_SL_T0_ENUlPvmmE0_4_FUNESN_mm)
    *(.text._ZZ11SortObjectsIN9__gnu_cxx17__normal_iteratorIPNSt7__cxx1112basic_stringIwSt11char_traitsIwESaIwEEESt6vectorIS7_SaIS7_EEEEZ17CollectAudioFilesRKS7_RSB_PKSt6atomicIbEEUlSE_SE_E_EvT_SL_T0_ENUlPvmmE_4_FUNESN_mm)
    *(.text._ZNK10StringPool3GetEj.part.0)
    *(.text._ZZ11SortObjectsIN9__gnu_cxx17__normal_iteratorIPSt6vectorIjSaIjEES2_IS4_SaIS4_EEEESt4lessIvEEvT_SB_T0_ENUlPvmmE_4_FUNESD_mm)
    *(.text._ZZ11SortObjectsIN9__gnu_cxx17__normal_iteratorIPSt4pairImjESt6vectorIS3_SaIS3_EEEESt4lessIvEEvT_SB_T0_ENUlPvmmE_4_FUNESD_mm)
    *(.text._ZNSt8_Rb_treeI7AlbumIdSt4pairIKS0_16AlbumMeasurementESt10_Select1stIS4_ESt4lessIS0_ESaIS4_EE24_M_get_insert_unique_posERS2_.isra.0)
    *(.text._ZSt12__move_mergeIPjN9__gnu_cxx17__normal_iteratorIS0_St6vectorIjSaIjEEEEZ16TracksAddedSincejEUljjE_ET0_T_S9_S9_S9_S8_T1_.isra.0)
    *(.text._ZSt12__move_mergeIN9__gnu_cxx17__normal_iteratorIPjSt6vectorIjSaIjEEEES2_Z16TracksAddedSincejEUljjE_ET0_T_S9_S9_S9_S8_T1_.isra.0)
    *(.text._ZSt24__merge_sort_with_bufferIN9__gnu_cxx17__normal_iteratorIPjSt6vectorIjSaIjEEEES2_Z19CompleteAlbumInListRS5_jiS7_EUljjE_EvT_S9_T0_T1_.isra.0)
    *(.text._ZZ11LookupFieldjRKNSt7__cxx1112basic_stringIwSt11char_traitsIwESaIwEEERS4_ENKUlyE_clEy.part.0)
    *(.text._ZSt24__merge_sort_with_bufferIN9__gnu_cxx17__normal_iteratorIPjSt6vectorIjSaIjEEEES2_Z16TracksAddedSincejEUljjE_EvT_S8_T0_T1_.isra.0)
    *(.text._ZNSt8_Rb_treeI7AlbumIdSt4pairIKS0_16AlbumMeasurementESt10_Select1stIS4_ESt4lessIS0_ESaIS4_EE8_M_eraseEPSt13_Rb_tree_nodeIS4_E.isra.0)
    *(.text._ZNSt3mapI7AlbumId16AlbumMeasurementSt4lessIS0_ESaISt4pairIKS0_S1_EEED1Ev)
    *(.text._ZNSt3mapI7AlbumId16AlbumMeasurementSt4lessIS0_ESaISt4pairIKS0_S1_EEED2Ev)
    *(.text._Z18NormalizeMediaPathRKNSt7__cxx1112basic_stringIwSt11char_traitsIwESaIwEEE)
    *(.text._Z6ToUtf8B5cxx11St17basic_string_viewIwSt11char_traitsIwEE)
    *(.text._Z8FromUtf8B5cxx11St17basic_string_viewIcSt11char_traitsIcEE)
    *(.text._ZNK7Library3StrB5cxx11Ej)
    *(.text._Z14FormatDurationB5cxx11d)
    *(.text._Z19FormatTotalDurationB5cxx11d)
    *(.text._Z12HeardSecondsdd)
    *(.text._Z9HeardCelliRK5TrackdRNSt7__cxx1112basic_stringIwSt11char_traitsIwESaIwEEE)
    *(.text._Z11DirectoryOfRKNSt7__cxx1112basic_stringIwSt11char_traitsIwESaIwEEE)
    *(.text._Z13SplitSubtrackSt17basic_string_viewIwSt11char_traitsIwEERNSt7__cxx1112basic_stringIwS1_SaIwEEERi)
    *(.text._Z12SubtrackPathB5cxx11St17basic_string_viewIwSt11char_traitsIwEEi)
    *(.text._ZNK10StringPool3GetEj)
    *(.text._ZN10StringPool4GrowEm)
    *(.text._ZN10StringPool7ReserveEm)
    *(.text._ZNK10StringPool6LookupESt17basic_string_viewIcSt11char_traitsIcEE)
    *(.text._ZNK10StringPool5BytesEv)
    *(.text._ZN7Library7UnindexEj)
    *(.text._ZNK9TrackPath4PathB5cxx11Ev)
    *(.text._ZNK7Library7KeyHashEjj)
    *(.text._ZN7Library5IndexEj)
    *(.text._ZNK7Library4PathB5cxx11Ej)
    *(.text._ZNK7Library7FindKeyERKNSt7__cxx1112basic_stringIwSt11char_traitsIwESaIwEEE)
    *(.text._ZNK7Library4FindERKNSt7__cxx1112basic_stringIwSt11char_traitsIwESaIwEEE)
    *(.text._Z19GroupDuplicateAudioSt6vectorISt4pairImjESaIS1_EE)
    *(.text._Z16EncodeReplayGainf)
    *(.text._Z16EncodeReplayPeakf)
    *(.text._ZNK7Library11MemoryBytesEv)
    *(.text._ZNK7Library13FavoriteCountEv)
    *(.text._Z15AlbumHasCompanyjRKSt6vectorIjSaIjEE)
    *(.text._Z13ExcludeTracksRKSt6vectorIjSaIjEE)
    *(.text._Z7UnixNowv)
    *(.text._Z11RatingStarsB5cxx11h)
    *(.text._Z17IsNativeAudioTypeRKNSt7__cxx1112basic_stringIwSt11char_traitsIwESaIwEEE)
    *(.text._Z18OpenFileFilterSpecB5cxx11v)
    *(.text._Z10FileNameOfRKNSt7__cxx1112basic_stringIwSt11char_traitsIwESaIwEEE)
    *(.text._Z5ExtOfRKNSt7__cxx1112basic_stringIwSt11char_traitsIwESaIwEEE)
    *(.text._Z20IsSupportedAudioFileRKNSt7__cxx1112basic_stringIwSt11char_traitsIwESaIwEEE)
    *(.text._Z14IsPlaylistFileRKNSt7__cxx1112basic_stringIwSt11char_traitsIwESaIwEEE)
    *(.text._Z6StemOfRKNSt7__cxx1112basic_stringIwSt11char_traitsIwESaIwEEE)
    *(.text._ZNSt6vectorINSt7__cxx1112basic_stringIwSt11char_traitsIwESaIwEEESaIS5_EE15_M_range_insertIN9__gnu_cxx17__normal_iteratorIPS5_S7_EEEEvSC_T_SD_St20forward_iterator_tag.isra.0)
    *(.text._Z11LookupFieldjRKNSt7__cxx1112basic_stringIwSt11char_traitsIwESaIwEEERS4_)
    *(.text._ZN12_GLOBAL__N_1L19CollectArchiveAudioERKNSt7__cxx1112basic_stringIwSt11char_traitsIwESaIwEEERSt6vectorIS5_SaIS5_EE)
    *(.text._ZN12_GLOBAL__N_1L8LikenessERK7LibraryRK5TrackjS5_j)
    *(.text._Z15ObservePlaybackjddd)
    *(.text._Z16ConsumeTasteSavev)
    *(.text._Z11NoteSessionj)
    *(.text._Z8NoteMoodjRK5Peaks)
    *(.text._Z12CurrentTastev)
    *(.text._Z8SetTaste10TasteState)
    *(.text._ZNSt6thread11_State_implINS_8_InvokerISt5tupleIJZN5radio7Browser15SearchDirectoryERKNS3_6SearchEEUlvE_EEEEED1Ev)
    *(.text._ZNSt6thread11_State_implINS_8_InvokerISt5tupleIJZN5radio7Browser15SearchDirectoryERKNS3_6SearchEEUlvE_EEEEED2Ev)
    *(.text._ZNSt6thread11_State_implINS_8_InvokerISt5tupleIJZN5radio7Browser15SearchDirectoryERKNS3_6SearchEEUlvE_EEEEED0Ev)
    *(.text._ZN5radio7Browser4PollEv)
    *(.text._ZN5radio7Browser10RecordPlayERKNSt7__cxx1112basic_stringIcSt11char_traitsIcESaIcEEE)
    *(.text._ZN13FolderScanner3RunEv)
    *(.text._ZN13HelperProcess6FinishEj)
    *(.text._ZN13HelperProcess7ReadAllERNSt7__cxx1112basic_stringIcSt11char_traitsIcESaIcEEEmPKSt6atomicIbE)
    *(.text._ZN12_GLOBAL__N_113HelperDecoder5AbortEv)
    *(.text._ZNK13HelperProcess7RunningEv)
    *(.text._ZN13HelperProcess9ComplaintB5cxx11Ev)
    *(.text._Z18ReapHelperProgramsv)
    *(.text._Z18StopHelperProgramsv)
    *(.text._ZNK7tagread4File4ReadB5cxx11Emm)
    *(.text._Z9CodecName5Codec)
    *(.text._Z13ChapterTextAtB5cxx11RKSt6vectorI7ChapterSaIS0_EEd)
    *(.text._ZN7tagread4FileD1Ev)
    *(.text._ZN7tagread4FileD2Ev)
    *(.text._Z14ReadLoopPointsRKNSt7__cxx1112basic_stringIwSt11char_traitsIwESaIwEEERlS7_)
    *(.text._ZN12_GLOBAL__N_1L7ReadAnyERKNSt7__cxx1112basic_stringIwSt11char_traitsIwESaIwEEER7TagDataRN7tagread7ArtSinkE)
    *(.text._ZN12_GLOBAL__N_1L16ReadSubtrackTagsERKNSt7__cxx1112basic_stringIwSt11char_traitsIwESaIwEEER7TagData)
    *(.text._Z15ReadEmbeddedArtRKNSt7__cxx1112basic_stringIwSt11char_traitsIwESaIwEEERNS0_IcS1_IcESaIcEEE)
    *(.text._Z10ReadLyricsRKNSt7__cxx1112basic_stringIwSt11char_traitsIwESaIwEEERNS0_IcS1_IcESaIcEEE)
    *(.text._Z8ReadTagsRKNSt7__cxx1112basic_stringIwSt11char_traitsIwESaIwEEER7TagData)
    *(.text._Z12ReadChaptersRKNSt7__cxx1112basic_stringIwSt11char_traitsIwESaIwEEERSt6vectorI7ChapterSaIS8_EE)
    *(.text._ZN7tagread11Utf16ToUtf8B5cxx11ESt17basic_string_viewIcSt11char_traitsIcEEb)
    *(.text._ZN7tagread4TrimENSt7__cxx1112basic_stringIcSt11char_traitsIcESaIcEEE)
    *(.text._ZN7tagread5UpperB5cxx11ESt17basic_string_viewIcSt11char_traitsIcEE)
    *(.text._ZN7tagread11GenreFromIdB5cxx11Ei)
    *(.text._ZN7tagread10CleanGenreENSt7__cxx1112basic_stringIcSt11char_traitsIcESaIcEEE)
    *(.text._ZN7tagread10SetIfEmptyERNSt7__cxx1112basic_stringIcSt11char_traitsIcESaIcEEERKS5_)
    *(.text._ZN7tagread12_GLOBAL__N_19Mp4Reader4KeysESt17basic_string_viewIcSt11char_traitsIcEE)
    *(.text._ZN7tagread12_GLOBAL__N_19Mp4Reader4FindIRZNS1_5TrackESt17basic_string_viewIcSt11char_traitsIcEEEUlS6_S6_E_EEvS6_OT_i)
    *(.text._ZN7tagread12_GLOBAL__N_19Mp4Reader4FindIZNS1_5TrackESt17basic_string_viewIcSt11char_traitsIcEEEUlS6_S6_E_EEvS6_OT_i)
    *(.text._ZN7tagread12_GLOBAL__N_19Mp4Reader4FindIZNS1_5TrackESt17basic_string_viewIcSt11char_traitsIcEEEUlS6_S6_E_EEvS6_OT_i.constprop.0)
    *(.text._ZN7tagread12_GLOBAL__N_19Mp4Reader5TrackESt17basic_string_viewIcSt11char_traitsIcEE)
    *(.text._ZN7tagread7ArtSink5OfferEiSt17basic_string_viewIcSt11char_traitsIcEE)
    *(.text._ZN7tagread12_GLOBAL__N_19Mp4Reader4ItemESt17basic_string_viewIcSt11char_traitsIcEES5_)
    *(.text._ZN7tagread12_GLOBAL__N_19Mp4Reader4WalkESt17basic_string_viewIcSt11char_traitsIcEEi)
    *(.text._ZN7tagread12_GLOBAL__N_19Mp4Reader4WalkESt17basic_string_viewIcSt11char_traitsIcEEi.constprop.1)
    *(.text._ZN7tagread7ReadMp4ERKNS_4FileER7TagDataRNS_7ArtSinkE)
    *(.text._ZN7tagread5IsAsfESt17basic_string_viewIcSt11char_traitsIcEE)
    *(.text._ZN7tagread7ReadAsfERKNS_4FileER7TagDataRNS_7ArtSinkE)
    *(.text._Z18UniquePlaylistNameB5cxx11RKSt6vectorI8PlaylistSaIS0_EESt17basic_string_viewIwSt11char_traitsIwEE)
    *(.text._Z18RemapPlaylistIndexiii)
    *(.text._Z8TabSlotsRKSt6vectorI8PlaylistSaIS0_EEbi)
    *(.text._Z14IsAutoGroupTabRKSt6vectorI8PlaylistSaIS0_EERKS_IiSaIiEEi)
    *(.text._Z13TabOfPlaylistRKSt6vectorI8PlaylistSaIS0_EERKS_IiSaIiEEi)
    *(.text._Z11FilterWordsB5cxx11St17basic_string_viewIwSt11char_traitsIwEE)
    *(.text._Z14MissingTagTermRK7LibraryjSt17basic_string_viewIwSt11char_traitsIwEE)
    *(.text._ZN3Md56AddPcmEPKimj)
    *(.text._ZN3Md56FinishEv)
    *(.text._ZN9TrimWatch6SampleEmm)
    *(.text._ZZN12_GLOBAL__N_1L8FlacTagsERKNSt7__cxx1112basic_stringIwSt11char_traitsIwESaIwEEERNS1_IcS2_IcESaIcEEERSt6vectorISA_SaISA_EEENKUlRjE0_clESG_.isra.0)
    *(.text._ZN12_GLOBAL__N_1L8FolderOfERKNSt7__cxx1112basic_stringIwSt11char_traitsIwESaIwEEE)
    *(.text._ZSt12__move_mergeIN9__gnu_cxx17__normal_iteratorIPSt4pairINSt7__cxx1112basic_stringIwSt11char_traitsIwESaIwEEEmESt6vectorIS9_SaIS9_EEEESA_Z14ConvertSummaryB5cxx11RKSB_I11ConvertItemSaISF_EEEUlRKT_RKT0_E_ESN_SK_SK_SK_SK_SN_T1_.isra.0)
    *(.text._ZN2lx5fonts8FindFontERKNSt7__cxx1112basic_stringIcSt11char_traitsIcESaIcEEEPNS0_5MatchE)
    *(.text._ZN2lx5fonts4InfoEv)
    *(.text._ZN2lx5fonts8FamiliesERKNSt7__cxx1112basic_stringIcSt11char_traitsIcESaIcEEE)
    *(.text._ZNSt15_Sp_counted_ptrIPN2lx4type4FaceELN9__gnu_cxx12_Lock_policyE2EED1Ev)
    *(.text._ZNSt15_Sp_counted_ptrIPN2lx4type4FaceELN9__gnu_cxx12_Lock_policyE2EED2Ev)
    *(.text._ZNSt15_Sp_counted_ptrIPN2lx4type4FaceELN9__gnu_cxx12_Lock_policyE2EE14_M_get_deleterERKSt9type_info)
    *(.text._ZNSt19_Sp_counted_deleterIPSt17basic_string_viewIcSt11char_traitsIcEEZN2lx4type7MapFileERKNSt7__cxx1112basic_stringIcS2_SaIcEEEEUlPKS3_E_SaIvELN9__gnu_cxx12_Lock_policyE2EED1Ev)
    *(.text._ZNSt19_Sp_counted_deleterIPSt17basic_string_viewIcSt11char_traitsIcEEZN2lx4type7MapFileERKNSt7__cxx1112basic_stringIcS2_SaIcEEEEUlPKS3_E_SaIvELN9__gnu_cxx12_Lock_policyE2EED2Ev)
    *(.text._ZNSt23_Sp_counted_ptr_inplaceIN2lx4type4Face3CffESaIvELN9__gnu_cxx12_Lock_policyE2EED1Ev)
    *(.text._ZNSt23_Sp_counted_ptr_inplaceIN2lx4type4Face3CffESaIvELN9__gnu_cxx12_Lock_policyE2EED2Ev)
    *(.text._ZNSt19_Sp_counted_deleterIPSt17basic_string_viewIcSt11char_traitsIcEEZN2lx4type7MapFileERKNSt7__cxx1112basic_stringIcS2_SaIcEEEEUlPKS3_E_SaIvELN9__gnu_cxx12_Lock_policyE2EED0Ev)
    *(.text._ZNSt15_Sp_counted_ptrIPN2lx4type4FaceELN9__gnu_cxx12_Lock_policyE2EED0Ev)
    *(.text._ZNSt15_Sp_counted_ptrIPN2lx4type4FaceELN9__gnu_cxx12_Lock_policyE2EE10_M_destroyEv)
    *(.text._ZNSt23_Sp_counted_ptr_inplaceIN2lx4type4Face3CffESaIvELN9__gnu_cxx12_Lock_policyE2EED0Ev)
    *(.text._ZNSt19_Sp_counted_deleterIPSt17basic_string_viewIcSt11char_traitsIcEEZN2lx4type7MapFileERKNSt7__cxx1112basic_stringIcS2_SaIcEEEEUlPKS3_E_SaIvELN9__gnu_cxx12_Lock_policyE2EE10_M_destroyEv)
    *(.text._ZNSt23_Sp_counted_ptr_inplaceIN2lx4type4Face3CffESaIvELN9__gnu_cxx12_Lock_policyE2EE10_M_destroyEv)
    *(.text._ZNK2lx4type5Bytes3U16Em.part.0.isra.0)
    *(.text._ZNSt23_Sp_counted_ptr_inplaceIN2lx4type4Face3CffESaIvELN9__gnu_cxx12_Lock_policyE2EE14_M_get_deleterERKSt9type_info)
    *(.text._ZNSt19_Sp_counted_deleterIPSt17basic_string_viewIcSt11char_traitsIcEEZN2lx4type9FromBytesESt10shared_ptrIKNSt7__cxx1112basic_stringIcS2_SaIcEEEEEUlPKS3_E_SaIvELN9__gnu_cxx12_Lock_policyE2EE10_M_disposeEv)
    *(.text._ZNSt23_Sp_counted_ptr_inplaceIN2lx4type4Face3CffESaIvELN9__gnu_cxx12_Lock_policyE2EE10_M_disposeEv)
    *(.text._ZN2lx4type12_GLOBAL__N_110CharString3RunENS0_5BytesE)
    *(.text._ZZNK2lx4type4Face10GlyphIndexEjENKUljE_clEj.isra.0)
    *(.text._ZN2lx4type7Outline3AddEiih)
    *(.text._ZN2lx4type6MulFixEii)
    *(.text._ZN2lx4type6DivFixEii)
    *(.text._ZNK2lx4type7Outline3BoxEPiS2_S2_S2_)
    *(.text._ZN2lx4type7MapFileERKNSt7__cxx1112basic_stringIcSt11char_traitsIcESaIcEEE)
    *(.text._ZN2lx4type4Face5CountESt17basic_string_viewIcSt11char_traitsIcEE)
    *(.text._ZNK2lx4type4Face5TableEj)
    *(.text._ZN2lx4type4Face8ReadCmapEv)
    *(.text._ZNK2lx4type4Face10GlyphIndexEj)
    *(.text._ZNK2lx4type4Face12VariantGlyphEjj)
    *(.text._ZNK2lx4type4Face7AdvanceEt)
    *(.text._ZNK2lx4type4Face11LeftBearingEt)
    *(.text._ZNK2lx4type4Face9KernTableEtt)
    *(.text._ZN2lx4type12_GLOBAL__N_1L7LoadCffENS0_5BytesEb)
    *(.text._ZNSt6vectorIiSaIiEEC1EmRKS0_)
    *(.text._ZNSt6vectorIiSaIiEEC2EmRKS0_)
    *(.text._ZNK2lx4type4Face11GlyfOutlineEtiibiPNS0_7OutlineE)
    *(.text._ZNK2lx4type4Face10GetOutlineEtiibPNS0_7OutlineE)
    *(.text._ZN2lx4type4FaceD1Ev)
    *(.text._ZN2lx4type4FaceD2Ev)
    *(.text._ZN2lx4type4Face4LoadESt10shared_ptrIKSt17basic_string_viewIcSt11char_traitsIcEEEi)
    *(.text._ZN2lx4type9RasterizeERKNS0_7OutlineEbPNS0_8CoverageE)
    *(.text._ZNSt17_Function_handlerIFitEZN2lx4type4Font4OpenESt10shared_ptrIKSt17basic_string_viewIcSt11char_traitsIcEEEifEUltE_E10_M_managerERSt9_Any_dataRKSD_St18_Manager_operation)
    *(.text._ZN2lx4type13SetPngDecoderEPFbSt17basic_string_viewIcSt11char_traitsIcEEPiS5_PSt6vectorIhSaIhEEE)
    *(.text._ZN2lx4type4Font7SetBoldEb)
    *(.text._ZN2lx4type4Font10SetHintingENS1_7HintingE)
    *(.text._ZN2lx4type4FontD1Ev)
    *(.text._ZN2lx4type4FontD2Ev)
    *(.text._ZN2lx4type4Font4OpenESt10shared_ptrIKSt17basic_string_viewIcSt11char_traitsIcEEEif)
    *(.text._ZN2lx4type4Font5ShapeEPKjS3_mjbPS1_PSt6vectorINS1_6PlacedESaIS6_EE)
    *(.text._ZNSt10_HashtableItSt4pairIKtiESaIS2_ENSt8__detail10_Select1stESt8equal_toItESt4hashItENS4_18_Mod_range_hashingENS4_20_Default_ranged_hashENS4_20_Prime_rehash_policyENS4_17_Hashtable_traitsILb0ELb0ELb1EEEE21_M_insert_unique_nodeEmmPNS4_10_Hash_nodeIS2_Lb0EEEm)
    *(.text._ZNK2lx4type4Font7AdvanceEt)
    *(.text._ZNSt17_Function_handlerIFitEZN2lx4type4Font4OpenESt10shared_ptrIKSt17basic_string_viewIcSt11char_traitsIcEEEifEUltE_E9_M_invokeERKSt9_Any_dataOt)
    *(.text._ZNSt10_HashtableINSt7__cxx1112basic_stringIcSt11char_traitsIcESaIcEEESt4pairIKS5_N2lx4type4Font4LineEESaISC_ENSt8__detail10_Select1stESt8equal_toIS5_ESt4hashIS5_ENSE_18_Mod_range_hashingENSE_20_Default_ranged_hashENSE_20_Prime_rehash_policyENSE_17_Hashtable_traitsILb1ELb0ELb1EEEE21_M_insert_unique_nodeEmmPNSE_10_Hash_nodeISC_Lb1EEEm)
    *(.text._ZNSt10_HashtableItSt4pairIKtN2lx4type10GlyphImageEESaIS5_ENSt8__detail10_Select1stESt8equal_toItESt4hashItENS7_18_Mod_range_hashingENS7_20_Default_ranged_hashENS7_20_Prime_rehash_policyENS7_17_Hashtable_traitsILb0ELb0ELb1EEEE21_M_insert_unique_nodeEmmPNS7_10_Hash_nodeIS5_Lb0EEEm)
    *(.text._ZN2lx4type4Font5ImageEt)
    *(.text._ZN2lx4type4Font6LayoutESt17basic_string_viewIcSt11char_traitsIcEE)
    *(.text._ZN2lx4type4Font6CaretXESt17basic_string_viewIcSt11char_traitsIcEEm)
    *(.text._ZN2lx4type4Font5QuadsESt17basic_string_viewIcSt11char_traitsIcEEPSt6vectorINS1_4QuadESaIS7_EE)
    *(.text._ZN2lx4type4Font7MeasureESt17basic_string_viewIcSt11char_traitsIcEEiPiPm)
    *(.text._ZNSt23_Sp_counted_ptr_inplaceISt6vectorI13TitleFunctionSaIS1_EESaIvELN9__gnu_cxx12_Lock_policyE2EED1Ev)
    *(.text._ZNSt23_Sp_counted_ptr_inplaceISt6vectorI13TitleFunctionSaIS1_EESaIvELN9__gnu_cxx12_Lock_policyE2EED2Ev)
    *(.text._ZNSt23_Sp_counted_ptr_inplaceISt6vectorI13TitleFunctionSaIS1_EESaIvELN9__gnu_cxx12_Lock_policyE2EED0Ev)
    *(.text._ZNSt23_Sp_counted_ptr_inplaceISt6vectorI13TitleFunctionSaIS1_EESaIvELN9__gnu_cxx12_Lock_policyE2EE10_M_destroyEv)
    *(.text._ZNKSt7__cxx1112basic_stringIwSt11char_traitsIwESaIwEE16find_last_not_ofEPKwmm.isra.0)
    *(.text._ZNKSt7__cxx1112basic_stringIwSt11char_traitsIwESaIwEE17find_first_not_ofEPKwmm.isra.0)
    *(.text._ZN12_GLOBAL__N_19Evaluator4CallERKNSt7__cxx1112basic_stringIwSt11char_traitsIwESaIwEEERKSt6vectorINS_5ValueESaISA_EE)
    *(.text._ZN12_GLOBAL__N_19Evaluator8SequenceEww)
    *(.text._ZN12_GLOBAL__N_19Evaluator8CallUserERK13TitleFunctionRKSt6vectorINS_5ValueESaIS5_EE)
    *(.text._Z11FormatTitleRKNSt7__cxx1112basic_stringIwSt11char_traitsIwESaIwEEERKSt8functionIFbS6_RS4_EE)
    *(.text._Z19ParseTitleFunctionsRKNSt7__cxx1112basic_stringIwSt11char_traitsIwESaIwEEERSt6vectorIS4_SaIS4_EE)
    *(.text._Z11SmoothPeaksRK5PeaksRS_i)
    *(.text._ZN9SongPeaks3GetERK5Peaksbi)
    *(.text._Z11WaveColorOnij)
    *(.text._Z14FadedWaveColorjj)
    *(.text._ZN11MoodPalette4MakeEjji)
    *(.text._ZNK11MoodPalette4PickE8MoodToneb)
    *(.text._Z10StartPeaksP6HWND__jRKNSt7__cxx1112basic_stringIwSt11char_traitsIwESaIwEEE)
    *(.text._Z9StopPeaksv)
    *(.text._Z11CancelPeaksv)
    *(.text._Z13PrefetchPeaksRKNSt7__cxx1112basic_stringIwSt11char_traitsIwESaIwEEEmmdd)
    *(.text._Z10StorePeaksRKNSt7__cxx1112basic_stringIwSt11char_traitsIwESaIwEEEmmddRK5Peaks)
    *(.text._Z12PeaksKeyNameRKNSt7__cxx1112basic_stringIwSt11char_traitsIwESaIwEEEmm)
    *(.text._ZN9GlowPulse4StepEPKhid)
    *(.text._ZN12_GLOBAL__N_111PeakService3RunEv)
    *(.text._ZN12_GLOBAL__N_111PeakService3GetERKNSt7__cxx1112basic_stringIwSt11char_traitsIwESaIwEEEmmddR5PeaksRj.constprop.0)
    *(.text._Z8GetPeaksRKNSt7__cxx1112basic_stringIwSt11char_traitsIwESaIwEEEmmddR5PeaksRj)
    *(.text._ZNSt6vectorI5ThemeSaIS0_EED1Ev)
    *(.text._ZNSt6vectorI5ThemeSaIS0_EED2Ev)
    *(.text._ZN12_GLOBAL__N_1L8BlendRgbEjjd)
    *(.text._ZN12_GLOBAL__N_1L9LuminanceEj)
    *(.text._ZN12_GLOBAL__N_1L11LegibleWashERK7Palettejjd.isra.0)
    *(.text._Z12LightPalettev)
    *(.text._Z11DarkPalettev)
    *(.text._Z13FoobarPalettev)
    *(.text._Z16DeltarunePalettev)
    *(.text._Z12PaperPalettev)
    *(.text._Z15MidnightPalettev)
    *(.text._Z15TerminalPalettev)
    *(.text._Z13ApolloPalettev)
    *(.text._Z13SetPackThemesSt6vectorI5ThemeSaIS0_EE)
    *(.text._Z10ThemeTotalv)
    *(.text._Z9ThemeInfo9ThemeMode)
    *(.text._Z17CustomThemeColorsb)
    *(.text._Z20HasCustomThemeColorsb)
    *(.text._Z22ResetCustomThemeColorsb)
    *(.text._Z8Contrastjj)
    *(.text._Z6TextOnj)
    *(.text._Z13CustomPaletteb.part.0)
    *(.text._Z13CustomPaletteb)
    *(.text._Z12ThemePalette9ThemeMode)
    *(.text._Z15PausedWaveColorRK7Palettej)
    *(.text._Z8HsvColorddd)
    *(.text._Z17AlbumColourConfigv)
    *(.text._Z8CoverHuePKhmb)
    *(.text._Z13PlayerSurfaceRK7Paletted)
    *(.text._Z17AlbumPanelSurfaceRK7Paletted)
    *(.text._Z9RowStripeRK7Palette)
    *(.text._Z17PaletteLegibilityB5cxx11RK7Palette)
    *(.text._Z12AlbumPaletteRK7PalettedRS_)
    *(.text._ZN10replaygain12_GLOBAL__N_1L8PeakTextEt)
    *(.text._ZN10replaygain12_GLOBAL__N_1L7LevelOfEfRKSt6vectorIjSaIjEE)
    *(.text._ZNSt8_Rb_treeI7AlbumIdSt4pairIKS0_16AlbumMeasurementESt10_Select1stIS4_ESt4lessIS0_ESaIS4_EE4findERS2_.constprop.0.isra.0)
    *(.text._ZNSt8_Rb_treeI7AlbumIdSt4pairIKS0_N10replaygain12_GLOBAL__N_110AlbumLevelEESt10_Select1stIS6_ESt4lessIS0_ESaIS6_EE24_M_get_insert_unique_posERS2_.constprop.0.isra.0)
    *(.text._ZNSt8_Rb_treeI7AlbumIdSt4pairIKS0_ZN10replaygain16UpdateAlbumGainsERKSt6vectorIjSaIjEEE5AlbumESt10_Select1stISA_ESt4lessIS0_ESaISA_EE24_M_get_insert_unique_posERS2_.isra.0)
    *(.text._ZNSt8_Rb_treeI7AlbumIdSt4pairIKS0_St6vectorIjSaIjEEESt10_Select1stIS6_ESt4lessIS0_ESaIS6_EE24_M_get_insert_unique_posERS2_.isra.0)
    *(.text._ZNSt8_Rb_treeI7AlbumIdSt4pairIKS0_N10replaygain12_GLOBAL__N_110AlbumLevelEESt10_Select1stIS6_ESt4lessIS0_ESaIS6_EE8_M_eraseEPSt13_Rb_tree_nodeIS6_E.isra.0)
    *(.text._ZNSt3mapI7AlbumIdN10replaygain12_GLOBAL__N_110AlbumLevelESt4lessIS0_ESaISt4pairIKS0_S3_EEED1Ev)
    *(.text._ZNSt3mapI7AlbumIdN10replaygain12_GLOBAL__N_110AlbumLevelESt4lessIS0_ESaISt4pairIKS0_S3_EEED2Ev)
    *(.text._ZN10replaygain4GainERK5TrackRK17ReplayGainOptionsd.part.0)
    *(.text._ZNSt8_Rb_treeI7AlbumIdSt4pairIKS0_St6vectorIjSaIjEEESt10_Select1stIS6_ESt4lessIS0_ESaIS6_EE8_M_eraseEPSt13_Rb_tree_nodeIS6_E.isra.0)
    *(.text._ZNSt8_Rb_treeI7AlbumIdS0_St9_IdentityIS0_ESt4lessIS0_ESaIS0_EE8_M_eraseEPSt13_Rb_tree_nodeIS0_E.isra.0)
    *(.text._ZNSt8_Rb_treeI7AlbumIdSt4pairIKS0_N10replaygain12_GLOBAL__N_110AlbumLevelEESt10_Select1stIS6_ESt4lessIS0_ESaIS6_EE22_M_emplace_hint_uniqueIJRKSt21piecewise_construct_tSt5tupleIJRS2_EESH_IJEEEEESt17_Rb_tree_iteratorIS6_ESt23_Rb_tree_const_iteratorIS6_EDpOT_.constprop.0)
    *(.text._ZNSt8_Rb_treeI7AlbumIdSt4pairIKS0_ZN10replaygain16UpdateAlbumGainsERKSt6vectorIjSaIjEEE5AlbumESt10_Select1stISA_ESt4lessIS0_ESaISA_EE8_M_eraseEPSt13_Rb_tree_nodeISA_E.isra.0)
    *(.text._ZSt16__introsort_loopIN9__gnu_cxx17__normal_iteratorIPSt4pairIddESt6vectorIS3_SaIS3_EEEElSt7greaterIvEEvT_SB_T0_T1_.isra.0)
    *(.text._ZN11AudioHasher3AddEPKfm)
    *(.text._ZNK11AudioHasher6FinishEv)
    *(.text._ZN10replaygain8EqPeakDbERK10EqSettingsj)
    *(.text._ZN10replaygain4GainERK5TrackRK17ReplayGainOptionsd)
    *(.text._ZN10replaygain15GainForEstimateERK5TrackdRK17ReplayGainOptionsd)
    *(.text._ZN10replaygain19ForgetAlbumDynamicsEb)
    *(.text._ZN10replaygain11AlbumMemberEj)
    *(.text._ZN10replaygain14NeedsMeasuringEj)
    *(.text._ZN10replaygain10NeedsTempoEj)
    *(.text._ZN10replaygain17MeasurementCoversERK16AlbumMeasurementRKSt6vectorIjSaIjEE)
    *(.text._ZN10replaygain18MeasurementMatchesERK16AlbumMeasurementRKSt6vectorIjSaIjEE)
    *(.text._ZN10replaygain13LibraryTracksEv)
    *(.text._ZN10replaygain16HasLibraryTracksEv)
    *(.text._ZN10replaygain5ApplyERK8RgResult)
    *(.text._ZN10replaygain7TagsForERK5Track)
    *(.text._ZN10replaygain7MeasureERK9TrackPathmmRKSt6atomicIbERS3_ISt10shared_ptrI7DecoderEEP19BackgroundCpuBudget)
    *(.text._ZNSt8_Rb_treeI7AlbumIdS0_St9_IdentityIS0_ESt4lessIS0_ESaIS0_EE16_M_insert_uniqueIS0_EESt4pairISt17_Rb_tree_iteratorIS0_EbEOT_)
    *(.text._ZN10replaygain17AutoMeasureTracksERKSt6vectorIjSaIjEEmb)
    *(.text._ZN10replaygain16UpdateAlbumGainsERKSt6vectorIjSaIjEE)
    *(.text._ZN10replaygain5ClearERKSt6vectorIjSaIjEE)
    *(.text._ZN10replaygain13RefreshAlbumsERj)
    *(.text._ZN8speakers12_GLOBAL__N_1L4SoapERKNSt7__cxx1112basic_stringIcSt11char_traitsIcESaIcEEES8_PKcS8_j)
    *(.text._ZN8speakers8DeviceIdB5cxx11ERKNS_7SpeakerE)
    *(.text._ZN8speakers13ParseDeviceIdESt17basic_string_viewIcSt11char_traitsIcEERNS_7SpeakerE)
    *(.text._ZN8speakers7SpeakerC1Ev)
    *(.text._ZN8speakers7SpeakerC2Ev)
    *(.text._ZN9discovery4FindERKNSt7__cxx1112basic_stringIcSt11char_traitsIcESaIcEEERKSt6vectorIS5_SaIS5_EERKNS_8SnapshotERN6online6CancelERNS_5TrackEjRKSt8functionIFNSG_5ReplyES7_EE)
    *(.text._ZN6online12_GLOBAL__N_1L9SameLooseESt17basic_string_viewIcSt11char_traitsIcEES4_)
    *(.text._ZN6online12_GLOBAL__N_1L13MetadataScoreERKNS_11SearchTrackE)
    *(.text._ZN6online12_GLOBAL__N_1L8TrimUtf8ESt17basic_string_viewIcSt11char_traitsIcEE)
    *(.text._ZN6online12_GLOBAL__N_1L14DeezerCoverUrlERKN3web9JsonValueE)
    *(.text._ZStplIcSt11char_traitsIcESaIcEENSt7__cxx1112basic_stringIT_T0_T1_EEPKS5_RKS8_.isra.0)
    *(.text._ZNK6online11SearchTrack10ToWebTrackEv)
    *(.text._ZN6online20NormalizeSearchQueryB5cxx11ESt17basic_string_viewIwSt11char_traitsIwEE)
    *(.text._ZN6online15SearchableQueryESt17basic_string_viewIwSt11char_traitsIwEE)
    *(.text._ZN6online15PushParsedTrackERSt6vectorINS_11SearchTrackESaIS1_EERS1_St17basic_string_viewIcSt11char_traitsIcEES9_S9_)
    *(.text._Z11ReadSvxTagsRKNSt7__cxx1112basic_stringIwSt11char_traitsIwESaIwEEER7TagData)
    *(.text._ZNK11nativeaudio13PacketDecoder6FailedEv)
    *(.text._ZNK11nativeaudio13PacketDecoder14PreviewPrerollEv)
    *(.text._ZNK12_GLOBAL__N_110AacDecoder8FastSeekEv)
    *(.text._ZNK12_GLOBAL__N_110AacDecoder6FailedEv)
    *(.text._ZN12_GLOBAL__N_110AacDecoder5AbortEv)
    *(.text._ZNK12_GLOBAL__N_110AacDecoder7ProblemEv)
    *(.text._ZN12_GLOBAL__N_110AacDecoder5ResetEv)
    *(.text._ZNK12_GLOBAL__N_110AacDecoder7PrerollEv)
    *(.text._ZNSt5arrayIN11nativeaudio10PrefixBookELm12EED1Ev)
    *(.text._ZNSt5arrayIN11nativeaudio10PrefixBookELm12EED2Ev)
    *(.text._ZNK12_GLOBAL__N_110AacDecoder8DurationEv)
    *(.text._ZN12_GLOBAL__N_1L12SignedPowersEv)
    *(.text._ZNK11nativeaudio13PacketDecoder10CanPreviewEv)
    *(.text._ZN12_GLOBAL__N_110AacDecoder4SeekEd)
    *(.text._ZN11nativeaudio13PacketDecoder11PreviewSeekERd)
    *(.text._Z11SkipLiveId3R15LiveAudioSourcePhm)
    *(.text._ZN11nativeaudio4Bits4FillEj)
    *(.text._ZN11nativeaudio4Bits4LongEj)
    *(.text._ZN12_GLOBAL__N_13Ics4InfoERN11nativeaudio4BitsEj)
    *(.text._ZN11nativeaudio10PrefixBookC1ESt4spanIKtLm18446744073709551615EE)
    *(.text._ZN11nativeaudio10PrefixBookC2ESt4spanIKtLm18446744073709551615EE)
    *(.text._ZN12_GLOBAL__N_1L5BooksEv)
    *(.text._ZN12_GLOBAL__N_110AacDecoder14PulsedSpectrumERN11nativeaudio4BitsERNS_7ChannelERKSt6vectorISt4pairIjjESaIS8_EE)
    *(.text._ZN12_GLOBAL__N_1L20SignedSpectralLookupEv)
    *(.text._ZN12_GLOBAL__N_110AacDecoder8SpectrumERN11nativeaudio4BitsERNS_7ChannelERKSt6vectorISt4pairIjjESaIS8_EE)
    *(.text._ZN12_GLOBAL__N_110AacDecoder6StreamERN11nativeaudio4BitsERNS_7ChannelEb)
    *(.text._ZN12_GLOBAL__N_110AacDecoder6DecodeEPKhmRSt6vectorIfSaIfEE)
    *(.text._ZN11nativeaudio4File4ViewEmm)
    *(.text._ZNK11nativeaudio10PacketFile2AtEm)
    *(.text._ZN11nativeaudio10PacketFile4PackEv)
    *(.text._ZN12_GLOBAL__N_110AacDecoder9ConfigureEb)
    *(.text._ZN12_GLOBAL__N_110AacDecoder4ReadEPfm)
    *(.text._ZN11nativeaudio10PacketFile8OpenAdtsERKNSt7__cxx1112basic_stringIwSt11char_traitsIwESaIwEEE)
    *(.text._ZN12_GLOBAL__N_110AacDecoderD1Ev)
    *(.text._ZN12_GLOBAL__N_110AacDecoderD2Ev)
    *(.text._ZN12_GLOBAL__N_110AacDecoderD0Ev)
    *(.text._Z11OpenLiveAacSt10shared_ptrI15LiveAudioSourceE)
    *(.text._ZN11nativeaudio4File4OpenERKNSt7__cxx1112basic_stringIwSt11char_traitsIwESaIwEEE)
    *(.text._Z14OpenAacDecoderRKNSt7__cxx1112basic_stringIwSt11char_traitsIwESaIwEEE)
    *(.text._ZN12_GLOBAL__N_110Ac3Decoder5ResetEv)
    *(.text._ZNK12_GLOBAL__N_110Ac3Decoder7PrerollEv)
    *(.text._ZNK12_GLOBAL__N_111Eac3Decoder7PrerollEv)
    *(.text._ZN12_GLOBAL__N_111Eac3Decoder5ResetEv)
    *(.text._ZN12_GLOBAL__N_1L10SynthesizeERNS_7ChannelERA2_N11nativeaudio4MdctERKSt5arrayIfLm256EEPf)
    *(.text._ZN12_GLOBAL__N_1L15SetupTransformsERA2_N11nativeaudio4MdctERSt5arrayIfLm256EE)
    *(.text._ZN12_GLOBAL__N_1L7InspectEPKhm.part.0)
    *(.text._ZN12_GLOBAL__N_1L11InspectEac3EPKhm.part.0)
    *(.text._ZN12_GLOBAL__N_1L13ReadMantissasEPKhRmmPKPNS_7ChannelEjRNS_10MantGroupsERj.constprop.0)
    *(.text._ZN12_GLOBAL__N_111AlacDecoderD1Ev)
    *(.text._ZN12_GLOBAL__N_111AlacDecoderD2Ev)
    *(.text._ZN12_GLOBAL__N_111AlacDecoderD0Ev)
    *(.text._Z15OpenAlacDecoderRKNSt7__cxx1112basic_stringIwSt11char_traitsIwESaIwEEE)
    *(.text._ZN11nativeaudio15ApeFirChunkAvx2EPsS0_S0_jjbRjPim)
    *(.text._ZN11nativeaudio18AudioCrc16FoldAvx2EPKhmPh)
    *(.text._ZN11nativeaudio24AudioResamplePrepareAvx2EPfjj)
    *(.text._ZN11nativeaudio23AudioResampleLayoutAvx2EPfjj)
    *(.text._ZN11nativeaudio17AudioResampleAvx2EPKfS1_jmjjjRmS2_Pf)
    *(.text._ZN11nativeaudio27AudioSilkResampleStereoAvx2EPKsS1_mjS1_Pf)
    *(.text._ZN11nativeaudio17AudioMdctFoldAvx2EPfPKfS2_S2_PKjjjb)
    *(.text._ZN11nativeaudio22AudioAacLongWindowAvx2EPKfS1_S1_S1_PfS2_)
    *(.text._ZN11nativeaudio17AudioMdctPostAvx2EPKfS1_Pfjj)
    *(.text._ZN11nativeaudio12AudioFftAvx2EPfPKfS2_jb)
    *(.text._ZN11nativeaudio14AudioFft15Avx2EPfS0_PKfS2_jb)
    *(.text._ZN12_GLOBAL__N_111FlacDecoder11PreviewSeekERd)
    *(.text._ZN12_GLOBAL__N_19FlacExact4NextEPim)
    *(.text._ZN12_GLOBAL__N_111FlacDecoder4ReadEPfm)
    *(.text._ZN12_GLOBAL__N_19FlacExactD1Ev)
    *(.text._ZN12_GLOBAL__N_19FlacExactD2Ev)
    *(.text._ZN12_GLOBAL__N_111FlacDecoderD0Ev)
    *(.text._Z14OpenGsmDecoderRKNSt7__cxx1112basic_stringIwSt11char_traitsIwESaIwEEEPKN11nativeaudio11CodedStreamE)
    *(.text._ZN11nativeaudio16FastAudioKernelsEv)
    *(.text._ZN11nativeaudio13FastCrcKernelEv)
    *(.text._ZNSt23_Sp_counted_ptr_inplaceIN12_GLOBAL__N_112PrefixSourceESaIvELN9__gnu_cxx12_Lock_policyE2EED1Ev)
    *(.text._ZNSt23_Sp_counted_ptr_inplaceIN12_GLOBAL__N_112PrefixSourceESaIvELN9__gnu_cxx12_Lock_policyE2EED2Ev)
    *(.text._ZNSt23_Sp_counted_ptr_inplaceIN12_GLOBAL__N_112PrefixSourceESaIvELN9__gnu_cxx12_Lock_policyE2EED0Ev)
    *(.text._ZNSt23_Sp_counted_ptr_inplaceIN12_GLOBAL__N_112PrefixSourceESaIvELN9__gnu_cxx12_Lock_policyE2EE10_M_destroyEv)
    *(.text._ZNSt23_Sp_counted_ptr_inplaceIN12_GLOBAL__N_112PrefixSourceESaIvELN9__gnu_cxx12_Lock_policyE2EE14_M_get_deleterERKSt9type_info)
    *(.text._ZN12_GLOBAL__N_112PrefixSource5AbortEv)
    *(.text._ZNK12_GLOBAL__N_112PrefixSource7ProblemEv)
    *(.text._Z19OpenMatroskaDecoderRKNSt7__cxx1112basic_stringIwSt11char_traitsIwESaIwEEE)
    *(.text._ZN11nativeaudio4Mdct4InitEj)
    *(.text._ZN11nativeaudio4Mdct5Fft15Ev)
    *(.text._ZN11nativeaudio4Mdct7DctCoreILb1EEEvPKfS3_Pf.isra.0)
    *(.text._ZN11nativeaudio4Mdct3RunEPKfPf)
    *(.text._ZN11nativeaudio4Mdct3DctEPKfPf)
    *(.text._ZN11nativeaudio4Mdct7DctCoreILb0EEEvPKfS3_Pf)
    *(.text._ZN11nativeaudio4Mdct3DctEPKfS2_Pf)
    *(.text._ZN11nativeaudio4Mdct3RunEPKfS2_Pf)
    *(.text._ZNK12_GLOBAL__N_111MidiDecoder8DurationEv)
    *(.text._Z14ReadModuleTagsRKNSt7__cxx1112basic_stringIwSt11char_traitsIwESaIwEEER7TagData)
    *(.text._ZN11nativeaudio12_GLOBAL__N_1L5ChildESt4spanIKhLm18446744073709551615EEj)
    *(.text._ZN11nativeaudio12_GLOBAL__N_1L5TrackERNS_10PacketFileESt4spanIKhLm18446744073709551615EES5_jPNS0_16FragmentsCaptureE)
    *(.text._ZN11nativeaudio10PacketFile12NormalizeMp4Ej)
    *(.text._ZN11nativeaudio10PacketFile7OpenMp4ERKNSt7__cxx1112basic_stringIwSt11char_traitsIwESaIwEEE)
    *(.text._ZN11nativeaudio15IsFragmentedMp4ERKNSt7__cxx1112basic_stringIwSt11char_traitsIwESaIwEEE)
    *(.text._ZN12_GLOBAL__N_1L9Convert24ILb0EEEvPKfmPv)
    *(.text._Z11SampleBytes12SampleFormat)
    *(.text._Z10SampleBits12SampleFormat)
    *(.text._Z14ConvertSamplesPKfm12SampleFormatPv)
    *(.text._Z7PackDopPKfmm12SampleFormatRhPv)
    *(.text._ZN12_GLOBAL__N_110PcmDecoder5AdpcmEm)
    *(.text._Z12OpenPcmExactRKNSt7__cxx1112basic_stringIwSt11char_traitsIwESaIwEEE)
    *(.text._ZN9Resampler4InitEjj)
    *(.text._ZN9Resampler5ResetEv)
    *(.text._ZNK9Resampler13PendingOutputEv)
    *(.text._ZN9Resampler7ConvertEPKfmRSt6vectorIfSaIfEEb)
    *(.text._ZN9Resampler4PushEPKfmRSt6vectorIfSaIfEE)
    *(.text._ZN9Resampler7ProcessEPKfmRSt6vectorIfSaIfEE)
    *(.text._ZN9Resampler5FlushERSt6vectorIfSaIfEE)
    *(.text._ZN4ipod6DetectEv)
    *(.text._ZN12_GLOBAL__N_1L9FromErrnoEi)
    *(.text._ZNSt17_Function_handlerIFbvEZ11CopyFileExWPKwS2_PFj13LARGE_INTEGERS3_S3_S3_jjPvS4_S4_ES4_PijEUlvE_E9_M_invokeERKSt9_Any_data)
    *(.text._ZN12_GLOBAL__N_111EventObjectD1Ev)
    *(.text._ZN12_GLOBAL__N_111EventObjectD2Ev)
    *(.text._ZN12_GLOBAL__N_111EventObjectD0Ev)
    *(.text._ZNSt13unordered_mapIPKvmSt4hashIS1_ESt8equal_toIS1_ESaISt4pairIKS1_mEEED1Ev)
    *(.text._ZNSt13unordered_mapIPKvmSt4hashIS1_ESt8equal_toIS1_ESaISt4pairIKS1_mEEED2Ev)
    *(.text._ZN12_GLOBAL__N_113MappingObjectD1Ev)
    *(.text._ZN12_GLOBAL__N_113MappingObjectD2Ev)
    *(.text._ZN12_GLOBAL__N_113MappingObjectD0Ev)
    *(.text._ZN12_GLOBAL__N_1L10DecodeUtf8EPKhmRmRDi.constprop.0)
    *(.text._ZL9CopyBytesRKNSt7__cxx1112basic_stringIcSt11char_traitsIcESaIcEEES6_bRKSt8functionIFbvEE.isra.0)
    *(.text._ZN12_GLOBAL__N_1L10Utf8LocaleEv)
    *(.text._ZNSt8functionIFvP6HWND__jmlEED1Ev)
    *(.text._ZNSt8functionIFvP6HWND__jmlEED2Ev)
    *(.text._ZNSt17_Function_handlerIFbvEZ11CopyFileExWPKwS2_PFj13LARGE_INTEGERS3_S3_S3_jjPvS4_S4_ES4_PijEUlvE_E10_M_managerERSt9_Any_dataRKSA_St18_Manager_operation)
    *(.text._ZN12_GLOBAL__N_1L10AttributesERKNSt7__cxx1112basic_stringIcSt11char_traitsIcESaIcEEES7_)
    *(.text._ZN12_GLOBAL__N_110FileObjectD1Ev)
    *(.text._ZN12_GLOBAL__N_110FileObjectD2Ev)
    *(.text._ZN12_GLOBAL__N_110FileObjectD0Ev)
    *(.text._ZN12_GLOBAL__N_110FindObjectD1Ev)
    *(.text._ZN12_GLOBAL__N_110FindObjectD2Ev)
    *(.text._ZN12_GLOBAL__N_110FindObjectD0Ev)
    *(.text._ZN6compat5WidenB5cxx11EPKcm.constprop.0)
    *(.text._ZN12_GLOBAL__N_1L8FillFindEPNS_10FindObjectEP16WIN32_FIND_DATAW)
    *(.text._ZN6compat6NarrowB5cxx11EPKw)
    *(.text._ZN6compat5WidenB5cxx11EPKcm)
    *(.text._ZN6compat14UnixToFileTimeEll)
    *(.text._Z11CreateFileWPKwjjP19SECURITY_ATTRIBUTESjjPv)
    *(.text._Z8ReadFilePvS_jPjP10OVERLAPPED)
    *(.text._Z9WriteFilePvPKvjPjP10OVERLAPPED)
    *(.text._Z16SetFilePointerExPv13LARGE_INTEGERPS0_j)
    *(.text._Z13GetFileSizeExPvP13LARGE_INTEGER)
    *(.text._Z11GetFileTimePvP8FILETIMES1_S1_)
    *(.text._Z11SetFileTimePvPK8FILETIMES2_S2_)
    *(.text._Z12SetEndOfFilePv)
    *(.text._Z16FlushFileBuffersPv)
    *(.text._Z18CreateFileMappingWPvS_jjjPKw)
    *(.text._Z15UnmapViewOfFilePKv)
    *(.text._Z11CloseHandlePv)
    *(.text._Z18GetFileAttributesWPKw)
    *(.text._Z20GetFileAttributesExWPKw22GET_FILEEX_INFO_LEVELSPv)
    *(.text._Z14FindFirstFileWPKwP16WIN32_FIND_DATAW)
    *(.text._Z18PathCreateFromUrlWPKwPwPjj)
    *(.text._Z14StrCmpLogicalWPKwS0_)
    *(.text._Z18GetModuleFileNameWPvPwj)
    *(.text._Z12GetLastErrorv)
    *(.text._Z12SetLastErrorj)
    *(.text._Z14FormatMessageWjPKvjjPwjPv)
    *(.text._Z9LocalFreePv)
    *(.text._Z19MultiByteToWideCharjjPKciPwi)
    *(.text._Z19WideCharToMultiBytejjPKwiPciPKcPi)
    *(.text._Z13LCMapStringExPKwjS0_iPwiPvS2_l)
    *(.text._Z20CompareStringOrdinalPKwiS0_ii)
    *(.text._Z15FindNLSStringExPKwjS0_iS0_iPiPvS2_l)
    *(.text._Z15CompareStringExPKwjS0_iS0_iPvS1_l)
    *(.text._Z12CreateEventWP19SECURITY_ATTRIBUTESiiPKw)
    *(.text._Z8SetEventPv)
    *(.text._Z10ResetEventPv)
    *(.text._Z22WaitForMultipleObjectsjPKPvij)
    *(.text._Z19WaitForSingleObjectPvj)
    *(.text._Z5Sleepj)
    *(.text._Z14GetTickCount64v)
    *(.text._Z12GetTickCountv)
    *(.text._Z23GetSystemTimeAsFileTimeP8FILETIME)
    *(.text._Z12GetLocalTimeP10SYSTEMTIME)
    *(.text._Z13GetSystemTimeP10SYSTEMTIME)
    *(.text._Z20FileTimeToSystemTimePK8FILETIMEP10SYSTEMTIME)
    *(.text._Z20SystemTimeToFileTimePK10SYSTEMTIMEP8FILETIME)
    *(.text._Z23FileTimeToLocalFileTimePK8FILETIMEPS_)
    *(.text._Z31SystemTimeToTzSpecificLocalTimePKvPK10SYSTEMTIMEPS1_)
    *(.text._Z23QueryPerformanceCounterP13LARGE_INTEGER)
    *(.text._Z25QueryPerformanceFrequencyP13LARGE_INTEGER)
    *(.text._Z19GetCurrentProcessIdv)
    *(.text._Z18GetCurrentThreadIdv)
    *(.text._Z16GetCurrentThreadv)
    *(.text._Z17SetThreadPriorityPvi)
    *(.text._Z23GetEnvironmentVariableWPKwPwj)
    *(.text._Z12PostMessageWP6HWND__jml)
    *(.text._Z21SetPostMessageHandlerSt8functionIFvP6HWND__jmlEE)
    *(.text._ZNSt10_HashtableIPKvSt4pairIKS1_mESaIS4_ENSt8__detail10_Select1stESt8equal_toIS1_ESt4hashIS1_ENS6_18_Mod_range_hashingENS6_20_Default_ranged_hashENS6_20_Prime_rehash_policyENS6_17_Hashtable_traitsILb0ELb0ELb1EEEE21_M_insert_unique_nodeEmmPNS6_10_Hash_nodeIS4_Lb0EEEm)
    *(.text._Z13MapViewOfFilePvjjjm)
    *(.text._ZNK2lx5sound6Stream7ProblemB5cxx11Ev)
    *(.text._ZNK11AudioOutput11SpeakerNameB5cxx11Ev)
    *(.text._ZN11AudioOutput4StopEv)
    *(.text._ZN11AudioOutput4wakeEv)
    *(.text._ZN11AudioOutput10RequestDsdEjb)
    *(.text._ZNK11AudioOutput10UpmixLabelB5cxx11Ev)
    *(.text._ZNK11AudioOutput7ProblemB5cxx11Ev)
    *(.text._ZNSt6vectorIN2lx5sound4SinkESaIS2_EED1Ev)
    *(.text._ZNSt6vectorIN2lx5sound4SinkESaIS2_EED2Ev)
    *(.text._ZN12_GLOBAL__N_1L10OpenStreamER13PipewireStatebjbRNSt7__cxx1112basic_stringIcSt11char_traitsIcESaIcEEE)
    *(.text._ZN11AudioOutput6ReopenEv)
    *(.text._ZNSt6thread11_State_implINS_8_InvokerISt5tupleIJZN11AudioOutput5StartESt8functionIFmPfmRyEES4_IFvjEERNSt7__cxx1112basic_stringIwSt11char_traitsIwESaIwEEEEUlvE_EEEEE6_M_runEv)
    *(.text._ZN11AudioOutput5StartESt8functionIFmPfmRyEES0_IFvjEERNSt7__cxx1112basic_stringIwSt11char_traitsIwESaIwEEE)
    *(.text._ZN2lx5sound9ListSinksEv)
    *(.text._ZNK2lx2pw12_GLOBAL__N_18PwStream7BackendEv)
    *(.text._ZNK2lx2pw12_GLOBAL__N_18PwStream6FailedEv)
    *(.text._ZN2lx2pw12_GLOBAL__N_18PwStream5FlushEv)
    *(.text._ZN2lx2pw12_GLOBAL__N_18PwStream9SetActiveEb)
    *(.text._ZN2lx2pw12_GLOBAL__N_1L7TracingEv)
    *(.text._ZN2lx2pw12_GLOBAL__N_1L6LookupERKSt6vectorISt4pairINSt7__cxx1112basic_stringIcSt11char_traitsIcESaIcEEES9_ESaISA_EESt17basic_string_viewIcS7_E)
    *(.text._ZN2lx2pw12_GLOBAL__N_17MemPool6RemoveEj)
    *(.text._ZN2lx2pw12_GLOBAL__N_1L10ParseSetIoEPKhmRNS1_5SetIoEb)
    *(.text._ZN2lx2pw12_GLOBAL__N_1L11ParseAddMemEPKhmRNS1_6AddMemE)
    *(.text._ZN2lx2pw12_GLOBAL__N_1L14ParseTransportEPKhmRNS1_9TransportE)
    *(.text._ZN2lx2pw12_GLOBAL__N_1L15ParseActivationEPKhmRNS1_10ActivationE)
    *(.text._ZN2lx2pw12_GLOBAL__N_1L12ParseMixInfoEPKhmRNS1_7MixInfoE)
    *(.text._ZN2lx2pw12_GLOBAL__N_1L8IsDspF32ERKNS_3spa5ValueE)
    *(.text._ZN2lx2pw12_GLOBAL__N_17MemPool3MapEjjj)
    *(.text._ZNSt6thread11_State_implINS_8_InvokerISt5tupleIJZN2lx2pw12_GLOBAL__N_18PwStream5StartERNSt7__cxx1112basic_stringIcSt11char_traitsIcESaIcEEEEUlvE_EEEEED1Ev)
    *(.text._ZNSt6thread11_State_implINS_8_InvokerISt5tupleIJZN2lx2pw12_GLOBAL__N_18PwStream5StartERNSt7__cxx1112basic_stringIcSt11char_traitsIcESaIcEEEEUlvE_EEEEED2Ev)
    *(.text._ZNSt6thread11_State_implINS_8_InvokerISt5tupleIJZN2lx2pw12_GLOBAL__N_18PwStream5StartERNSt7__cxx1112basic_stringIcSt11char_traitsIcESaIcEEEEUlvE_EEEEED0Ev)
    *(.text._ZZN2lx2pw9FuzzParseEPKhmEN4Walk2GoENS_3spa6ReaderEi.constprop.1)
    *(.text._ZN2lx2pw12_GLOBAL__N_1L21ParseMetadataPropertyEPKhmRNS1_16MetadataPropertyE.constprop.0)
    *(.text._ZN2lx2pw12_GLOBAL__N_1L9ParseIntsEPKhmPji.constprop.0)
    *(.text._ZN2lx2pw12_GLOBAL__N_1L9ParseIntsEPKhmPji.constprop.1)
    *(.text._ZNSt8_Rb_treeIjSt4pairIKjN2lx2pw12_GLOBAL__N_18PortInfoEESt10_Select1stIS6_ESt4lessIjESaIS6_EE24_M_get_insert_unique_posERS1_.isra.0)
    *(.text._ZNSt8_Rb_treeIjSt4pairIKjN2lx2pw12_GLOBAL__N_14NodeEESt10_Select1stIS6_ESt4lessIjESaIS6_EE24_M_get_insert_unique_posERS1_.isra.0)
    *(.text._ZNSt8_Rb_treeIjSt4pairIKjNSt7__cxx1112basic_stringIcSt11char_traitsIcESaIcEEEESt10_Select1stIS8_ESt4lessIjESaIS8_EE24_M_get_insert_unique_posERS1_.isra.0)
    *(.text._ZNSt8_Rb_treeIjSt4pairIKjN2lx2pw12_GLOBAL__N_18PwStream6TargetEESt10_Select1stIS7_ESt4lessIjESaIS7_EE24_M_get_insert_unique_posERS1_.isra.0)
    *(.text._ZNSt8_Rb_treeIjSt4pairIKjN2lx2pw12_GLOBAL__N_18PwStream3MixEESt10_Select1stIS7_ESt4lessIjESaIS7_EE24_M_get_insert_unique_posERS1_.isra.0)
    *(.text._ZNSt8_Rb_treeIjSt4pairIKjN2lx2pw12_GLOBAL__N_17MemPool5BlockEESt10_Select1stIS7_ESt4lessIjESaIS7_EE24_M_get_insert_unique_posERS1_.isra.0)
    *(.text._ZN2lx2pw12_GLOBAL__N_17Session5NewIdEv)
    *(.text._ZN2lx2pw12_GLOBAL__N_110Connection4SendEjhRKNS_3spa7BuilderERKSt6vectorIiSaIiEE.isra.0)
    *(.text._ZSt8_DestroyIPN2lx2pw12_GLOBAL__N_18PwStream6BufferEEvT_S6_)
    *(.text._ZN2lx2pw12_GLOBAL__N_1L15ParseUseBuffersEPKhmRNS1_10UseBuffersE)
    *(.text._ZN2lx2pw12_GLOBAL__N_1L8JsonNameERKNSt7__cxx1112basic_stringIcSt11char_traitsIcESaIcEEE)
    *(.text._ZN2lx3spa7BuilderD1Ev)
    *(.text._ZN2lx3spa7BuilderD2Ev)
    *(.text._ZN2lx2pw12_GLOBAL__N_17Session4SyncEi)
    *(.text._ZN2lx2pw12_GLOBAL__N_1L11ClientPropsEv)
    *(.text._ZN2lx2pw12_GLOBAL__N_110Connection7ReceiveIZNS1_8PwStream3RunEvEUlRNS1_7MessageEE_EEbOT_)
    *(.text._ZN2lx2pw12_GLOBAL__N_18PwStream3RunEv)
    *(.text._ZN2lx4type12_GLOBAL__N_1L13IndicCategoryEjj)
    *(.text._ZN2lx4type12_GLOBAL__N_1L5PropsEj)
    *(.text._ZN2lx4type12_GLOBAL__N_1L3CccEj)
    *(.text._ZSt14__copy_move_a2ILb0EPN2lx4type12_GLOBAL__N_14InfoES4_S4_ET2_T0_T1_S5_)
    *(.text._ZSt14__copy_move_a2ILb1EPN2lx4type12_GLOBAL__N_14InfoES4_S4_ET2_T0_T1_S5_)
    *(.text._ZSt12__move_mergeIPSt4pairIN2lx4type12_GLOBAL__N_14InfoEmEN9__gnu_cxx17__normal_iteratorIS6_St6vectorIS5_SaIS5_EEEEZNS3_7Shaping15ReorderSyllableIRZNSD_12IndicInitialEvEUltE_EEvmmbOT_EUlRKSH_RKT0_E_ESL_SH_SH_SH_SH_SL_T1_.isra.0)
    *(.text._ZSt12__move_mergeIN9__gnu_cxx17__normal_iteratorIPSt4pairIN2lx4type12_GLOBAL__N_14InfoEmESt6vectorIS7_SaIS7_EEEES8_ZNS5_7Shaping15ReorderSyllableIRZNSD_12IndicInitialEvEUltE_EEvmmbOT_EUlRKSH_RKT0_E_ESL_SH_SH_SH_SH_SL_T1_.isra.0)
    *(.text._ZSt16__merge_adaptiveIN9__gnu_cxx17__normal_iteratorIPSt4pairIN2lx4type12_GLOBAL__N_14InfoEmESt6vectorIS7_SaIS7_EEEElS8_ZNS5_7Shaping15ReorderSyllableIRZNSD_12IndicInitialEvEUltE_EEvmmbOT_EUlRKSH_RKT0_E_EvSH_SH_SH_SL_SL_T1_T2_.isra.0)
    *(.text._ZNSt6vectorIN2lx4type12_GLOBAL__N_111FeatureSpecESaIS3_EEC2ESt16initializer_listIS3_ERKS4_.isra.0)
    *(.text._ZN2lx4type12_GLOBAL__N_1L13MergeClustersERSt6vectorINS1_4InfoESaIS3_EEmm.isra.0)
    *(.text._ZN2lx4type12_GLOBAL__N_1L2AtENS0_5BytesEm.constprop.0)
    *(.text._ZSt23__merge_adaptive_resizeIN9__gnu_cxx17__normal_iteratorIPSt4pairIN2lx4type12_GLOBAL__N_14InfoEmESt6vectorIS7_SaIS7_EEEElS8_ZNS5_7Shaping15ReorderSyllableIRZNSD_12IndicInitialEvEUltE_EEvmmbOT_EUlRKSH_RKT0_E_EvSH_SH_SH_SL_SL_T1_SL_T2_)
    *(.text._ZNK2lx4type12_GLOBAL__N_15Table13AppendLookupsENS0_5BytesEPSt6vectorItSaItEE)
    *(.text._ZNSt8_Rb_treeIjSt4pairIKjiESt10_Select1stIS2_ESt4lessIjESaIS2_EE8_M_eraseEPSt13_Rb_tree_nodeIS2_E.isra.0)
    *(.text._ZNSt8_Rb_treeImSt4pairIKmSt10unique_ptrIN2lx4type6Shaper4PlanESt14default_deleteIS6_EEESt10_Select1stISA_ESt4lessImESaISA_EE8_M_eraseEPSt13_Rb_tree_nodeISA_E.isra.0)
    *(.text._ZN2lx4type12_GLOBAL__N_1L2AtENS0_5BytesEm)
    *(.text._ZSt16__introsort_loopIN9__gnu_cxx17__normal_iteratorIPN2lx4type12_GLOBAL__N_17AppliedESt6vectorIS5_SaIS5_EEEElZNS3_6Shaper7PlanForEjbEUlRKS5_SD_E_EvT_SF_T0_T1_.isra.0)
    *(.text._ZSt22__merge_without_bufferIN9__gnu_cxx17__normal_iteratorIPSt4pairIN2lx4type12_GLOBAL__N_14InfoEmESt6vectorIS7_SaIS7_EEEElZNS5_7Shaping15ReorderSyllableIRZNSD_12IndicInitialEvEUltE_EEvmmbOT_EUlRKSH_RKT0_E_EvSH_SH_SH_SL_SL_T1_)
    *(.text._ZSt24__merge_sort_with_bufferIN9__gnu_cxx17__normal_iteratorIPN2lx4type12_GLOBAL__N_14InfoESt6vectorIS5_SaIS5_EEEES6_ZNS4_7Shaping9NormalizeEvEUlRKS5_SD_E_EvT_SF_T0_T1_.isra.0)
    *(.text._ZSt22__merge_without_bufferIN9__gnu_cxx17__normal_iteratorIPN2lx4type12_GLOBAL__N_14InfoESt6vectorIS5_SaIS5_EEEElZNS4_7Shaping9NormalizeEvEUlRKS5_SD_E_EvT_SF_SF_T0_SG_T1_.isra.0)
    *(.text._ZSt24__merge_sort_with_bufferIN9__gnu_cxx17__normal_iteratorIPSt4pairIN2lx4type12_GLOBAL__N_14InfoEmESt6vectorIS7_SaIS7_EEEES8_ZNS5_7Shaping15ReorderSyllableIRZNSD_12IndicInitialEvEUltE_EEvmmbOT_EUlRKSH_RKT0_E_EvSH_SH_SL_T1_.isra.0)
    *(.text._ZSt29__stable_sort_adaptive_resizeIN9__gnu_cxx17__normal_iteratorIPSt4pairIN2lx4type12_GLOBAL__N_14InfoEmESt6vectorIS7_SaIS7_EEEES8_lZNS5_7Shaping15ReorderSyllableIRZNSD_12IndicInitialEvEUltE_EEvmmbOT_EUlRKSH_RKT0_E_EvSH_SH_SL_T1_T2_.isra.0)
    *(.text._ZNSt8_Rb_treeIjSt4pairIKjiESt10_Select1stIS2_ESt4lessIjESaIS2_EE22_M_emplace_hint_uniqueIJRKSt21piecewise_construct_tSt5tupleIJRS1_EESD_IJEEEEESt17_Rb_tree_iteratorIS2_ESt23_Rb_tree_const_iteratorIS2_EDpOT_.isra.0)
    *(.text._ZNSt8_Rb_treeIjSt4pairIKjjESt10_Select1stIS2_ESt4lessIjESaIS2_EE22_M_emplace_hint_uniqueIJRKSt21piecewise_construct_tSt5tupleIJRS1_EESD_IJEEEEESt17_Rb_tree_iteratorIS2_ESt23_Rb_tree_const_iteratorIS2_EDpOT_.isra.0)
    *(.text._ZN2lx4type12_GLOBAL__N_1L13CoverageIndexENS0_5BytesEt)
    *(.text._ZSt21__inplace_stable_sortIN9__gnu_cxx17__normal_iteratorIPN2lx4type12_GLOBAL__N_14InfoESt6vectorIS5_SaIS5_EEEEZNS4_7Shaping9NormalizeEvEUlRKS5_SD_E_EvT_SF_T0_.isra.0)
    *(.text._ZN2lx4type12_GLOBAL__N_1L11DeviceDeltaERKNS1_3CtxENS0_5BytesEi.isra.0)
    *(.text._ZN2lx4type12_GLOBAL__N_1L8AddValueERKNS1_3CtxENS0_5BytesES5_tRNS1_3PosE)
    *(.text._ZZN2lx4type6Shaper7PlanForEjbENKUlSt6vectorINS0_12_GLOBAL__N_111FeatureSpecESaIS4_EEiE_clES6_i)
    *(.text._ZSt16__merge_adaptiveIN9__gnu_cxx17__normal_iteratorIPN2lx4type12_GLOBAL__N_14InfoESt6vectorIS5_SaIS5_EEEElS6_ZNS4_7Shaping9NormalizeEvEUlRKS5_SD_E_EvT_SF_SF_T0_SG_T1_T2_.isra.0)
    *(.text._ZSt23__merge_adaptive_resizeIN9__gnu_cxx17__normal_iteratorIPN2lx4type12_GLOBAL__N_14InfoESt6vectorIS5_SaIS5_EEEElS6_ZNS4_7Shaping9NormalizeEvEUlRKS5_SD_E_EvT_SF_SF_T0_SG_T1_SG_T2_.isra.0)
    *(.text._ZSt29__stable_sort_adaptive_resizeIN9__gnu_cxx17__normal_iteratorIPN2lx4type12_GLOBAL__N_14InfoESt6vectorIS5_SaIS5_EEEES6_lZNS4_7Shaping9NormalizeEvEUlRKS5_SD_E_EvT_SF_T0_T1_T2_.isra.0)
    *(.text._ZN2lx4type12_GLOBAL__N_15Table4LoadENS0_5BytesEb)
    *(.text._ZNK2lx4type12_GLOBAL__N_15Table7LangSysERKSt6vectorIjSaIjEE)
    *(.text._ZN2lx4type12_GLOBAL__N_1L7ClassOfENS0_5BytesEt)
    *(.text._ZN2lx4type12_GLOBAL__N_17Shaping9PropagateEmi)
    *(.text._ZN2lx4type12_GLOBAL__N_1L10AttachMarkERNS1_3CtxEmiNS0_5BytesEiS4_)
    *(.text._ZN2lx4type12_GLOBAL__N_17Shaping9NormalizeEv)
    *(.text._ZN2lx4type8ScriptOfEj)
    *(.text._ZN2lx4type18IsDefaultIgnorableEj)
    *(.text._ZN2lx4type6IsMarkEj)
    *(.text._ZN2lx4type19IsEmojiPresentationEj)
    *(.text._ZN2lx4type14JoinsGraphemesEj)
    *(.text._ZN2lx4type7ItemizeERKSt6vectorIjSaIjEEPbi)
    *(.text._ZN2lx4type11VisualOrderERKSt6vectorINS0_3RunESaIS2_EE)
    *(.text._ZN2lx4type6ShaperC1EPKNS0_4FaceE)
    *(.text._ZN2lx4type6ShaperC2EPKNS0_4FaceE)
    *(.text._ZN2lx4type6ShaperD1Ev)
    *(.text._ZN2lx4type6ShaperD2Ev)
    *(.text._ZN2lx4type12_GLOBAL__N_1L12ApplyContextERNS1_3CtxENS0_5BytesEbm)
    *(.text._ZN2lx4type12_GLOBAL__N_1L9ApplyGsubERNS1_3CtxERKNS1_6LookupEm)
    *(.text._ZN2lx4type12_GLOBAL__N_1L9ApplyGposERNS1_3CtxERKNS1_6LookupEm)
    *(.text._ZN2lx4type12_GLOBAL__N_1L11ApplyNestedERNS1_3CtxERSt6vectorIiSaIiEENS0_5BytesEt)
    *(.text._ZNK2lx4type12_GLOBAL__N_15Table14FeatureLookupsENS0_5BytesEjPb)
    *(.text._ZNK2lx4type12_GLOBAL__N_17Shaping11WouldLigateEjtt)
    *(.text._ZN2lx4type12_GLOBAL__N_17Shaping12IndicInitialEv)
    *(.text._ZN2lx4type6Shaper7PlanForEjb)
    *(.text._ZN2lx4type6Shaper5ShapeERKNS0_9ShapeFontEPKjS6_mjbPSt6vectorINS0_11ShapedGlyphESaIS8_EE)
    *(.text._ZN2lx3spa7Builder3PadEv)
    *(.text._ZN2lx3spa7Builder6ScalarEjPKvj)
    *(.text._ZN2lx3spa7Builder3StrESt17basic_string_viewIcSt11char_traitsIcEE)
    *(.text._ZN2lx3spa7Builder3RawEPKhm)
    *(.text._ZN2lx3spa7Builder8ChoiceIdENS0_10ChoiceTypeESt16initializer_listIjE)
    *(.text._ZN2lx3spa7Builder11BeginStructEv)
    *(.text._ZN2lx3spa7Builder11BeginObjectEjj)
    *(.text._ZN2lx3spa7Builder4PropEjj)
    *(.text._ZN2lx3spa7Builder3EndEv)
    *(.text._ZN4gpod11ChapterData11add_chapterEjNSt7__cxx1112basic_stringIcSt11char_traitsIcESaIcEEE)
    *(.text._ZN4gpod11ChapterData14remove_chapterEm)
    *(.text.__cxa_thread_atexit)
    *(.text._ZNK10__cxxabiv117__class_type_info20__do_find_public_srcElPKvPKS0_S2_)
    *(.text._ZN10__cxxabiv117__class_type_infoD1Ev)
    *(.text._ZN10__cxxabiv117__class_type_infoD2Ev)
    *(.text._ZN10__cxxabiv117__class_type_infoD0Ev)
    *(.text._ZNK10__cxxabiv117__class_type_info11__do_upcastEPKS0_PKvRNS0_15__upcast_resultE)
    *(.text._ZNK10__cxxabiv117__class_type_info11__do_upcastEPKS0_PKvRNS0_15__upcast_resultE.localalias)
    *(.text._ZNK10__cxxabiv117__class_type_info10__do_catchEPKSt9type_infoPPvj)
    *(.text._ZNK10__cxxabiv117__class_type_info12__do_dyncastElNS0_10__sub_kindEPKS0_PKvS3_S5_RNS0_16__dyncast_resultE)
    *(.text._ZNK10__cxxabiv117__class_type_info11__do_upcastEPKS0_PPv)
    *(.text._ZdlPvm)
    *(.text._ZdaPv)
    *(.text._ZNK9__gnu_cxx24__concurrence_lock_error4whatEv)
    *(.text._ZNK9__gnu_cxx26__concurrence_unlock_error4whatEv)
    *(.text._ZN9__gnu_cxx24__concurrence_lock_errorD1Ev)
    *(.text._ZN9__gnu_cxx24__concurrence_lock_errorD2Ev)
    *(.text._ZN9__gnu_cxx24__concurrence_lock_errorD0Ev)
    *(.text._ZN9__gnu_cxx26__concurrence_unlock_errorD1Ev)
    *(.text._ZN9__gnu_cxx26__concurrence_unlock_errorD2Ev)
    *(.text._ZN9__gnu_cxx26__concurrence_unlock_errorD0Ev)
    *(.text._ZN12_GLOBAL__N_14pool4freeEPv.constprop.0)
    *(.text._ZN12_GLOBAL__N_14pool8allocateEm.constprop.0)
    *(.text.__cxa_allocate_exception)
    *(.text.__cxa_free_exception)
    *(.text.__cxa_allocate_dependent_exception)
    *(.text.__cxa_free_dependent_exception)
    *(.text.__cxa_get_exception_ptr)
    *(.text.__cxa_begin_catch)
    *(.text.__cxa_end_catch)
    *(.text._ZSt18uncaught_exceptionv)
    *(.text._ZSt19uncaught_exceptionsv)
    *(.text._ZNSt9exceptionD1Ev)
    *(.text._ZNSt9exceptionD2Ev)
    *(.text._ZNSt13bad_exceptionD1Ev)
    *(.text._ZNSt13bad_exceptionD2Ev)
    *(.text._ZNKSt9exception4whatEv)
    *(.text._ZNKSt13bad_exception4whatEv)
    *(.text._ZNSt9exceptionD0Ev)
    *(.text._ZNSt13bad_exceptionD0Ev)
    *(.text._ZN10__cxxabiv115__forced_unwindD1Ev)
    *(.text._ZN10__cxxabiv115__forced_unwindD2Ev)
    *(.text._ZN10__cxxabiv115__forced_unwindD0Ev)
    *(.text._ZN10__cxxabiv119__foreign_exceptionD1Ev)
    *(.text._ZN10__cxxabiv119__foreign_exceptionD2Ev)
    *(.text._ZN10__cxxabiv119__foreign_exceptionD0Ev)
    *(.text._ZGTtNKSt9exceptionD1Ev)
    *(.text._ZGTtNKSt9exception4whatEv)
    *(.text._ZGTtNKSt13bad_exceptionD1Ev)
    *(.text._ZGTtNKSt13bad_exception4whatEv)
    *(.text.__cxa_get_globals_fast)
    *(.text.__cxa_get_globals)
    *(.text._ZL16get_adjusted_ptrPKSt9type_infoS1_PPv)
    *(.text._ZL28read_encoded_value_with_basehmPKhPm)
    *(.text._ZL21base_of_encoded_valuehP15_Unwind_Context)
    *(.text._ZL20check_exception_specP16lsda_header_infoPKSt9type_infoPvl)
    *(.text._ZL17parse_lsda_headerP15_Unwind_ContextPKhP16lsda_header_info)
    *(.text.__gxx_personality_v0)
    *(.text.__cxa_call_unexpected)
    *(.text._ZN10__cxxabiv111__terminateEPFvvE)
    *(.text._ZSt13set_terminatePFvvE)
    *(.text._ZSt13get_terminatev)
    *(.text._ZN10__cxxabiv112__unexpectedEPFvvE)
    *(.text._ZSt14set_unexpectedPFvvE)
    *(.text._ZSt14get_unexpectedv)
    *(.text._ZL23__gxx_exception_cleanup19_Unwind_Reason_CodeP17_Unwind_Exception)
    *(.text.__cxa_init_primary_exception)
    *(.text.__cxa_throw)
    *(.text.__cxa_rethrow)
    *(.text._ZNK10__cxxabiv120__function_type_info15__is_function_pEv)
    *(.text._ZN10__cxxabiv120__function_type_infoD1Ev)
    *(.text._ZN10__cxxabiv120__function_type_infoD2Ev)
    *(.text._ZN10__cxxabiv120__function_type_infoD0Ev)
    *(.text.__cxa_guard_acquire)
    *(.text.__cxa_guard_abort)
    *(.text.__cxa_guard_release)
    *(.text._ZN9__gnu_cxx20recursive_init_errorD1Ev)
    *(.text._ZN9__gnu_cxx20recursive_init_errorD2Ev)
    *(.text._ZN9__gnu_cxx20recursive_init_errorD0Ev)
    *(.text._ZN9__gnu_cxx20recursive_init_errorC1Ev)
    *(.text._ZN9__gnu_cxx20recursive_init_errorC2Ev)
    *(.text._ZSt11_Hash_bytesPKvmm)
    *(.text._ZSt15_Fnv_hash_bytesPKvmm)
    *(.text._Znwm)
    *(.text._ZnwmRKSt9nothrow_t)
    *(.text._ZNSs4_Rep8_M_cloneERKSaIcEm.isra.0)
    *(.text._ZNSt11logic_errorD1Ev)
    *(.text._ZNSt11logic_errorD2Ev)
    *(.text._ZNSt11logic_errorD0Ev)
    *(.text._ZNSt12domain_errorD1Ev)
    *(.text._ZNSt12domain_errorD2Ev)
    *(.text._ZNSt12domain_errorD0Ev)
    *(.text._ZNSt16invalid_argumentD1Ev)
    *(.text._ZNSt16invalid_argumentD2Ev)
    *(.text._ZNSt16invalid_argumentD0Ev)
    *(.text._ZNSt12length_errorD1Ev)
    *(.text._ZNSt12length_errorD2Ev)
    *(.text._ZNSt12length_errorD0Ev)
    *(.text._ZNSt12out_of_rangeD1Ev)
    *(.text._ZNSt12out_of_rangeD2Ev)
    *(.text._ZNSt12out_of_rangeD0Ev)
    *(.text._ZNSt13runtime_errorD1Ev)
    *(.text._ZNSt13runtime_errorD2Ev)
    *(.text._ZNSt13runtime_errorD0Ev)
    *(.text._ZNSt11range_errorD1Ev)
    *(.text._ZNSt11range_errorD2Ev)
    *(.text._ZNSt11range_errorD0Ev)
    *(.text._ZNSt14overflow_errorD1Ev)
    *(.text._ZNSt14overflow_errorD2Ev)
    *(.text._ZNSt14overflow_errorD0Ev)
    *(.text._ZNSt15underflow_errorD1Ev)
    *(.text._ZNSt15underflow_errorD2Ev)
    *(.text._ZNSt15underflow_errorD0Ev)
    *(.text._ZNSt11logic_errorC1ERKSs)
    *(.text._ZNSt11logic_errorC2ERKSs)
    *(.text._ZNSt12domain_errorC1ERKSs)
    *(.text._ZNSt12domain_errorC2ERKSs)
    *(.text._ZNSt16invalid_argumentC1ERKSs)
    *(.text._ZNSt16invalid_argumentC2ERKSs)
    *(.text._ZNSt12length_errorC1ERKSs)
    *(.text._ZNSt12length_errorC2ERKSs)
    *(.text._ZNSt12out_of_rangeC1ERKSs)
    *(.text._ZNSt12out_of_rangeC2ERKSs)
    *(.text._ZNSt13runtime_errorC1ERKSs)
    *(.text._ZNSt13runtime_errorC2ERKSs)
    *(.text._ZNSt11range_errorC1ERKSs)
    *(.text._ZNSt11range_errorC2ERKSs)
    *(.text._ZNSt14overflow_errorC1ERKSs)
    *(.text._ZNSt14overflow_errorC2ERKSs)
    *(.text._ZNSt15underflow_errorC1ERKSs)
    *(.text._ZNSt15underflow_errorC2ERKSs)
    *(.text._ZSt18_Rb_tree_incrementPSt18_Rb_tree_node_base)
    *(.text._ZSt18_Rb_tree_incrementPKSt18_Rb_tree_node_base)
    *(.text._ZSt18_Rb_tree_decrementPSt18_Rb_tree_node_base)
    *(.text._ZSt18_Rb_tree_decrementPKSt18_Rb_tree_node_base)
    *(.text._ZSt20_Rb_tree_rotate_leftPSt18_Rb_tree_node_baseRS0_)
    *(.text._ZSt21_Rb_tree_rotate_rightPSt18_Rb_tree_node_baseRS0_)
    *(.text._ZSt29_Rb_tree_insert_and_rebalancebPSt18_Rb_tree_node_baseS0_RS_)
    *(.text._ZSt28_Rb_tree_rebalance_for_erasePSt18_Rb_tree_node_baseRS_)
    *(.text._ZSt20_Rb_tree_black_countPKSt18_Rb_tree_node_baseS1_)
    *(.text._ZN12_GLOBAL__N_1L10fopen_modeESt13_Ios_Openmode)
    *(.text._ZNSt12__basic_fileIcEC1EP15pthread_mutex_t)
    *(.text._ZNSt12__basic_fileIcEC2EP15pthread_mutex_t)
    *(.text._ZNKSt12__basic_fileIcE7is_openEv)
    *(.text._ZNSt12__basic_fileIcE8sys_openEP8_IO_FILESt13_Ios_Openmode)
    *(.text._ZNSt12__basic_fileIcE8sys_openEiSt13_Ios_Openmode)
    *(.text._ZNSt12__basic_fileIcE4openEPKcSt13_Ios_Openmodei)
    *(.text._ZNSt12__basic_fileIcE2fdEv)
    *(.text._ZNSt12__basic_fileIcE4fileEv)
    *(.text._ZNSt12__basic_fileIcE5closeEv)
    *(.text._ZNSt12__basic_fileIcED1Ev)
    *(.text._ZNSt12__basic_fileIcED2Ev)
    *(.text._ZNSt12__basic_fileIcE6xsgetnEPcl)
    *(.text._ZNSt12__basic_fileIcE6xsputnEPKcl)
    *(.text._ZNSt12__basic_fileIcE8xsputn_2EPKclS2_l)
    *(.text._ZNSt12__basic_fileIcE7seekoffElSt12_Ios_Seekdir)
    *(.text._ZNSt12__basic_fileIcE4syncEv)
    *(.text._ZNSt12__basic_fileIcE9showmanycEv)
    *(.text._ZNKSt12__basic_fileIcE13native_handleEv)
    *(.text._ZNSt6chrono3_V212system_clock3nowEv)
    *(.text._ZNSt6chrono3_V212steady_clock3nowEv)
    *(.text._ZNKSt19__codecvt_utf8_baseIDiE10do_unshiftER11__mbstate_tPcS3_RS3_)
    *(.text._ZNKSt19__codecvt_utf8_baseIDsE10do_unshiftER11__mbstate_tPcS3_RS3_)
    *(.text._ZNKSt19__codecvt_utf8_baseIwE10do_unshiftER11__mbstate_tPcS3_RS3_)
    *(.text._ZNKSt20__codecvt_utf16_baseIDiE10do_unshiftER11__mbstate_tPcS3_RS3_)
    *(.text._ZNKSt20__codecvt_utf16_baseIDsE10do_unshiftER11__mbstate_tPcS3_RS3_)
    *(.text._ZNKSt20__codecvt_utf16_baseIwE10do_unshiftER11__mbstate_tPcS3_RS3_)
    *(.text._ZNKSt25__codecvt_utf8_utf16_baseIDiE10do_unshiftER11__mbstate_tPcS3_RS3_)
    *(.text._ZNKSt25__codecvt_utf8_utf16_baseIDsE10do_unshiftER11__mbstate_tPcS3_RS3_)
    *(.text._ZNKSt25__codecvt_utf8_utf16_baseIwE10do_unshiftER11__mbstate_tPcS3_RS3_)
    *(.text._ZNKSt7codecvtIDic11__mbstate_tE10do_unshiftERS0_PcS3_RS3_)
    *(.text._ZNKSt7codecvtIDsc11__mbstate_tE10do_unshiftERS0_PcS3_RS3_)
    *(.text._ZNKSt19__codecvt_utf8_baseIDiE11do_encodingEv)
    *(.text._ZNKSt19__codecvt_utf8_baseIDsE11do_encodingEv)
    *(.text._ZNKSt19__codecvt_utf8_baseIwE11do_encodingEv)
    *(.text._ZNKSt20__codecvt_utf16_baseIDiE11do_encodingEv)
    *(.text._ZNKSt20__codecvt_utf16_baseIDsE11do_encodingEv)
    *(.text._ZNKSt20__codecvt_utf16_baseIwE11do_encodingEv)
    *(.text._ZNKSt25__codecvt_utf8_utf16_baseIDiE11do_encodingEv)
    *(.text._ZNKSt25__codecvt_utf8_utf16_baseIDsE11do_encodingEv)
    *(.text._ZNKSt25__codecvt_utf8_utf16_baseIwE11do_encodingEv)
    *(.text._ZNKSt7codecvtIDiDu11__mbstate_tE11do_encodingEv)
    *(.text._ZNKSt7codecvtIDic11__mbstate_tE11do_encodingEv)
    *(.text._ZNKSt7codecvtIDsDu11__mbstate_tE11do_encodingEv)
    *(.text._ZNKSt7codecvtIDsc11__mbstate_tE11do_encodingEv)
    *(.text._ZNKSt19__codecvt_utf8_baseIDiE16do_always_noconvEv)
    *(.text._ZNKSt19__codecvt_utf8_baseIDsE16do_always_noconvEv)
    *(.text._ZNKSt19__codecvt_utf8_baseIwE16do_always_noconvEv)
    *(.text._ZNKSt20__codecvt_utf16_baseIDiE16do_always_noconvEv)
    *(.text._ZNKSt20__codecvt_utf16_baseIDsE16do_always_noconvEv)
    *(.text._ZNKSt20__codecvt_utf16_baseIwE16do_always_noconvEv)
    *(.text._ZNKSt25__codecvt_utf8_utf16_baseIDiE16do_always_noconvEv)
    *(.text._ZNKSt25__codecvt_utf8_utf16_baseIDsE16do_always_noconvEv)
    *(.text._ZNKSt25__codecvt_utf8_utf16_baseIwE16do_always_noconvEv)
    *(.text._ZNKSt7codecvtIDiDu11__mbstate_tE16do_always_noconvEv)
    *(.text._ZNKSt7codecvtIDic11__mbstate_tE16do_always_noconvEv)
    *(.text._ZNKSt7codecvtIDsDu11__mbstate_tE16do_always_noconvEv)
    *(.text._ZNKSt7codecvtIDsc11__mbstate_tE16do_always_noconvEv)
    *(.text._ZNKSt7codecvtIDiDu11__mbstate_tE13do_max_lengthEv)
    *(.text._ZNKSt7codecvtIDic11__mbstate_tE13do_max_lengthEv)
    *(.text._ZNKSt7codecvtIDsDu11__mbstate_tE13do_max_lengthEv)
    *(.text._ZNKSt7codecvtIDsc11__mbstate_tE13do_max_lengthEv)
    *(.text._ZNKSt7codecvtIDiDu11__mbstate_tE10do_unshiftERS0_PDuS3_RS3_)
    *(.text._ZNKSt7codecvtIDsDu11__mbstate_tE10do_unshiftERS0_PDuS3_RS3_)
    *(.text._ZNKSt19__codecvt_utf8_baseIDsE13do_max_lengthEv)
    *(.text._ZNKSt19__codecvt_utf8_baseIDiE13do_max_lengthEv)
    *(.text._ZNKSt19__codecvt_utf8_baseIwE13do_max_lengthEv)
    *(.text._ZNKSt20__codecvt_utf16_baseIDsE13do_max_lengthEv)
    *(.text._ZNKSt20__codecvt_utf16_baseIDiE13do_max_lengthEv)
    *(.text._ZNKSt20__codecvt_utf16_baseIwE13do_max_lengthEv)
    *(.text._ZNKSt25__codecvt_utf8_utf16_baseIDsE13do_max_lengthEv)
    *(.text._ZNKSt25__codecvt_utf8_utf16_baseIDiE13do_max_lengthEv)
    *(.text._ZNKSt25__codecvt_utf8_utf16_baseIwE13do_max_lengthEv)
    *(.text._ZNSt12_GLOBAL__N_1L14read_utf16_bomILb0EEEvRNS_5rangeIKDsXT_EEERSt12codecvt_mode)
    *(.text._ZNSt12_GLOBAL__N_1L20read_utf8_code_pointIcEEDiRNS_5rangeIKT_Lb1EEEm)
    *(.text._ZNSt12_GLOBAL__N_1L20read_utf8_code_pointIDuEEDiRNS_5rangeIKT_Lb1EEEm)
    *(.text._ZNSt7codecvtIDsc11__mbstate_tED1Ev)
    *(.text._ZNSt7codecvtIDsc11__mbstate_tED2Ev)
    *(.text._ZNSt19__codecvt_utf8_baseIDsED1Ev)
    *(.text._ZNSt19__codecvt_utf8_baseIDsED2Ev)
    *(.text._ZNSt20__codecvt_utf16_baseIDsED1Ev)
    *(.text._ZNSt20__codecvt_utf16_baseIDsED2Ev)
    *(.text._ZNSt25__codecvt_utf8_utf16_baseIDsED1Ev)
    *(.text._ZNSt25__codecvt_utf8_utf16_baseIDsED2Ev)
    *(.text._ZNSt7codecvtIDic11__mbstate_tED1Ev)
    *(.text._ZNSt7codecvtIDic11__mbstate_tED2Ev)
    *(.text._ZNSt19__codecvt_utf8_baseIDiED1Ev)
    *(.text._ZNSt19__codecvt_utf8_baseIDiED2Ev)
    *(.text._ZNSt20__codecvt_utf16_baseIDiED1Ev)
    *(.text._ZNSt20__codecvt_utf16_baseIDiED2Ev)
    *(.text._ZNSt25__codecvt_utf8_utf16_baseIDiED1Ev)
    *(.text._ZNSt25__codecvt_utf8_utf16_baseIDiED2Ev)
    *(.text._ZNSt7codecvtIDsDu11__mbstate_tED1Ev)
    *(.text._ZNSt7codecvtIDsDu11__mbstate_tED2Ev)
    *(.text._ZNSt7codecvtIDiDu11__mbstate_tED1Ev)
    *(.text._ZNSt7codecvtIDiDu11__mbstate_tED2Ev)
    *(.text._ZNSt7codecvtIDsc11__mbstate_tED0Ev)
    *(.text._ZNSt19__codecvt_utf8_baseIDsED0Ev)
    *(.text._ZNSt20__codecvt_utf16_baseIDsED0Ev)
    *(.text._ZNSt25__codecvt_utf8_utf16_baseIDsED0Ev)
    *(.text._ZNSt7codecvtIDic11__mbstate_tED0Ev)
    *(.text._ZNKSt19__codecvt_utf8_baseIDsE6do_outER11__mbstate_tPKDsS4_RS4_PcS6_RS6_)
    *(.text._ZNKSt20__codecvt_utf16_baseIwE6do_outER11__mbstate_tPKwS4_RS4_PcS6_RS6_)
    *(.text._ZNKSt20__codecvt_utf16_baseIDiE6do_outER11__mbstate_tPKDiS4_RS4_PcS6_RS6_)
    *(.text._ZNKSt7codecvtIDsc11__mbstate_tE9do_lengthERS0_PKcS4_m)
    *(.text._ZNKSt20__codecvt_utf16_baseIwE9do_lengthER11__mbstate_tPKcS4_m)
    *(.text._ZNKSt20__codecvt_utf16_baseIDiE9do_lengthER11__mbstate_tPKcS4_m)
    *(.text._ZNKSt20__codecvt_utf16_baseIDsE9do_lengthER11__mbstate_tPKcS4_m)
    *(.text._ZNKSt20__codecvt_utf16_baseIDsE5do_inER11__mbstate_tPKcS4_RS4_PDsS6_RS6_)
    *(.text._ZZNSt12_GLOBAL__N_1L8key_initEvEN5key_sD1Ev)
    *(.text._ZZNSt12_GLOBAL__N_1L8key_initEvEN5key_sD2Ev)
    *(.text._ZNSt12_GLOBAL__N_1L8key_initEv)
    *(.text._ZNSt18condition_variableC1Ev)
    *(.text._ZNSt18condition_variableC2Ev)
    *(.text._ZNSt18condition_variableD1Ev)
    *(.text._ZNSt18condition_variableD2Ev)
    *(.text._ZNSt18condition_variable4waitERSt11unique_lockISt5mutexE)
    *(.text._ZNSt18condition_variable10notify_oneEv)
    *(.text._ZNSt18condition_variable10notify_allEv)
    *(.text._ZNSt12_GLOBAL__N_18notifier3runEPv)
    *(.text._ZNSt12_GLOBAL__N_1L3runEPv)
    *(.text._ZNSt12_GLOBAL__N_1L3runEv)
    *(.text._ZSt16__at_thread_exitPSt20__at_thread_exit_elt)
    *(.text._ZNSt13basic_fstreamIwSt11char_traitsIwEED2Ev)
    *(.text._ZNKSt17bad_function_call4whatEv)
    *(.text._ZNSt17bad_function_callD1Ev)
    *(.text._ZNSt17bad_function_callD2Ev)
    *(.text._ZNSt17bad_function_callD0Ev)
    *(.text._ZNKSt8__detail20_Prime_rehash_policy11_M_next_bktEm)
    *(.text._ZNKSt8__detail20_Prime_rehash_policy14_M_need_rehashEmmm)
    *(.text._ZNSt9basic_iosIcSt11char_traitsIcEED1Ev)
    *(.text._ZNSt9basic_iosIcSt11char_traitsIcEED2Ev)
    *(.text._ZNSt9basic_iosIwSt11char_traitsIwEED1Ev)
    *(.text._ZNSt9basic_iosIwSt11char_traitsIwEED2Ev)
    *(.text._ZNSt9basic_iosIcSt11char_traitsIcEED0Ev)
    *(.text._ZNSt9basic_iosIwSt11char_traitsIwEED0Ev)
    *(.text._ZNKSt9basic_iosIcSt11char_traitsIcEEcvbEv)
    *(.text._ZNKSt9basic_iosIcSt11char_traitsIcEEntEv)
    *(.text._ZNKSt9basic_iosIcSt11char_traitsIcEE7rdstateEv)
    *(.text._ZNSt9basic_iosIcSt11char_traitsIcEE5clearESt12_Ios_Iostate)
    *(.text._ZNSt9basic_iosIcSt11char_traitsIcEE8setstateESt12_Ios_Iostate)
    *(.text._ZNSt9basic_iosIcSt11char_traitsIcEE11_M_setstateESt12_Ios_Iostate)
    *(.text._ZNKSt9basic_iosIcSt11char_traitsIcEE4goodEv)
    *(.text._ZNKSt9basic_iosIcSt11char_traitsIcEE3eofEv)
    *(.text._ZNKSt9basic_iosIcSt11char_traitsIcEE4failEv)
    *(.text._ZNKSt9basic_iosIcSt11char_traitsIcEE3badEv)
    *(.text._ZNKSt9basic_iosIcSt11char_traitsIcEE10exceptionsEv)
    *(.text._ZNSt9basic_iosIcSt11char_traitsIcEE10exceptionsESt12_Ios_Iostate)
    *(.text._ZNKSt9basic_iosIcSt11char_traitsIcEE3tieEv)
    *(.text._ZNSt9basic_iosIcSt11char_traitsIcEE3tieEPSo)
    *(.text._ZNKSt9basic_iosIcSt11char_traitsIcEE5rdbufEv)
    *(.text._ZNSt9basic_iosIcSt11char_traitsIcEE5rdbufEPSt15basic_streambufIcS1_E)
    *(.text._ZNKSt9basic_iosIcSt11char_traitsIcEE4fillEv)
    *(.text._ZNSt15basic_streambufIcSt11char_traitsIcEE4swapERS2_)
    *(.text._ZSt17__copy_streambufsIcSt11char_traitsIcEElPSt15basic_streambufIT_T0_ES6_)
    *(.text._ZNSt15basic_streambufIwSt11char_traitsIwEE8pubimbueERKSt6locale)
    *(.text._ZNKSt15basic_streambufIwSt11char_traitsIwEE6getlocEv)
    *(.text._ZNSt15basic_streambufIwSt11char_traitsIwEE9pubsetbufEPwl)
    *(.text._ZNSt15basic_streambufIwSt11char_traitsIwEE10pubseekoffElSt12_Ios_SeekdirSt13_Ios_Openmode)
    *(.text._ZNSt15basic_streambufIwSt11char_traitsIwEE10pubseekposESt4fposI11__mbstate_tESt13_Ios_Openmode)
    *(.text._ZNSt15basic_streambufIwSt11char_traitsIwEE7pubsyncEv)
    *(.text._ZNSt15basic_streambufIwSt11char_traitsIwEE8in_availEv)
    *(.text._ZNSt15basic_streambufIwSt11char_traitsIwEE6snextcEv)
    *(.text._ZNSt15basic_streambufIwSt11char_traitsIwEE6sbumpcEv)
    *(.text._ZNSt15basic_streambufIwSt11char_traitsIwEE5sgetcEv)
    *(.text._ZNSt15basic_streambufIwSt11char_traitsIwEE5sgetnEPwl)
    *(.text._ZNSt15basic_streambufIwSt11char_traitsIwEE9sputbackcEw)
    *(.text._ZNSt15basic_streambufIwSt11char_traitsIwEE7sungetcEv)
    *(.text._ZNSt15basic_streambufIwSt11char_traitsIwEE5sputcEw)
    *(.text._ZNSt15basic_streambufIwSt11char_traitsIwEE5sputnEPKwl)
    *(.text._ZNSt15basic_streambufIwSt11char_traitsIwEEC1Ev)
    *(.text._ZNSt15basic_streambufIwSt11char_traitsIwEEC2Ev)
    *(.text._ZNKSt15basic_streambufIwSt11char_traitsIwEE5ebackEv)
    *(.text._ZNKSt15basic_streambufIwSt11char_traitsIwEE4gptrEv)
    *(.text._ZNKSt15basic_streambufIwSt11char_traitsIwEE5egptrEv)
    *(.text._ZNSt15basic_streambufIwSt11char_traitsIwEE5gbumpEi)
    *(.text._ZNSt15basic_streambufIwSt11char_traitsIwEE4setgEPwS3_S3_)
    *(.text._ZNKSt15basic_streambufIwSt11char_traitsIwEE5pbaseEv)
    *(.text._ZNKSt15basic_streambufIwSt11char_traitsIwEE4pptrEv)
    *(.text._ZNKSt15basic_streambufIwSt11char_traitsIwEE5epptrEv)
    *(.text._ZNSt15basic_streambufIwSt11char_traitsIwEE5pbumpEi)
    *(.text._ZNSt15basic_streambufIwSt11char_traitsIwEE4setpEPwS3_)
    *(.text._ZNSt15basic_streambufIwSt11char_traitsIwEE6stosscEv)
    *(.text._ZNSt15basic_streambufIwSt11char_traitsIwEE12__safe_gbumpEl)
    *(.text._ZNSt15basic_streambufIwSt11char_traitsIwEE12__safe_pbumpEl)
    *(.text._ZNSt15basic_streambufIwSt11char_traitsIwEEC1ERKS2_)
    *(.text._ZNSt15basic_streambufIwSt11char_traitsIwEEC2ERKS2_)
    *(.text._ZNSt15basic_streambufIwSt11char_traitsIwEEaSERKS2_)
    *(.text._ZNSt15basic_streambufIwSt11char_traitsIwEE4swapERS2_)
    *(.text._ZSt17__copy_streambufsIwSt11char_traitsIwEElPSt15basic_streambufIT_T0_ES6_)
    *(.text._ZNSt7__cxx1112basic_stringIcSt11char_traitsIcESaIcEE11_S_allocateERS3_m)
    *(.text._ZNSt7__cxx1112basic_stringIcSt11char_traitsIcESaIcEE7_M_dataEPc)
    *(.text._ZNSt7__cxx1112basic_stringIcSt11char_traitsIcESaIcEE9_M_lengthEm)
    *(.text._ZNKSt7__cxx1112basic_stringIcSt11char_traitsIcESaIcEE7_M_dataEv)
    *(.text._ZNSt7__cxx1112basic_stringIcSt11char_traitsIcESaIcEE13_M_local_dataEv)
    *(.text._ZNKSt7__cxx1112basic_stringIcSt11char_traitsIcESaIcEE13_M_local_dataEv)
    *(.text._ZNSt7__cxx1112basic_stringIcSt11char_traitsIcESaIcEE11_M_capacityEm)
    *(.text._ZNSt7__cxx1112basic_stringIcSt11char_traitsIcESaIcEE13_M_set_lengthEm)
    *(.text._ZNKSt7__cxx1112basic_stringIcSt11char_traitsIcESaIcEE11_M_is_localEv)
    *(.text._ZNSt7__cxx1112basic_stringIcSt11char_traitsIcESaIcEE9_M_createERmm)
    *(.text._ZNSt7__cxx1112basic_stringIcSt11char_traitsIcESaIcEE10_M_disposeEv)
    *(.text._ZNSt7__cxx1112basic_stringIcSt11char_traitsIcESaIcEE10_M_destroyEm)
    *(.text._ZNSt7__cxx1112basic_stringIcSt11char_traitsIcESaIcEE12_M_constructEmc)
    *(.text._ZNSt7__cxx1112basic_stringIcSt11char_traitsIcESaIcEE18_M_construct_aux_2Emc)
    *(.text._ZNSt7__cxx1112basic_stringIcSt11char_traitsIcESaIcEE16_M_get_allocatorEv)
    *(.text._ZNKSt7__cxx1112basic_stringIcSt11char_traitsIcESaIcEE16_M_get_allocatorEv)
    *(.text._ZNSt7__cxx1112basic_stringIcSt11char_traitsIcESaIcEE17_M_init_local_bufEv)
    *(.text._ZNSt7__cxx1112basic_stringIcSt11char_traitsIcESaIcEE17_M_use_local_dataEv)
    *(.text._ZNKSt7__cxx1112basic_stringIcSt11char_traitsIcESaIcEE8_M_checkEmPKc)
    *(.text._ZNKSt7__cxx1112basic_stringIcSt11char_traitsIcESaIcEE15_M_check_lengthEmmPKc)
    *(.text._ZNKSt7__cxx1112basic_stringIcSt11char_traitsIcESaIcEE8_M_limitEmm)
    *(.text._ZNKSt7__cxx1112basic_stringIcSt11char_traitsIcESaIcEE11_M_disjunctEPKc)
    *(.text._ZNSt7__cxx1112basic_stringIcSt11char_traitsIcESaIcEE7_S_copyEPcPKcm)
    *(.text._ZNSt7__cxx1112basic_stringIcSt11char_traitsIcESaIcEE7_S_moveEPcPKcm)
    *(.text._ZNSt7__cxx1112basic_stringIcSt11char_traitsIcESaIcEE9_S_assignEPcmc)
    *(.text._ZNSt7__cxx1112basic_stringIcSt11char_traitsIcESaIcEE13_S_copy_charsEPcN9__gnu_cxx17__normal_iteratorIS5_S4_EES8_)
    *(.text._ZNSt7__cxx1112basic_stringIcSt11char_traitsIcESaIcEE13_S_copy_charsEPcN9__gnu_cxx17__normal_iteratorIPKcS4_EESA_)
    *(.text._ZNSt7__cxx1112basic_stringIcSt11char_traitsIcESaIcEE13_S_copy_charsEPcS5_S5_)
    *(.text._ZNSt7__cxx1112basic_stringIcSt11char_traitsIcESaIcEE13_S_copy_charsEPcPKcS7_)
    *(.text._ZNSt7__cxx1112basic_stringIcSt11char_traitsIcESaIcEE10_S_compareEmm)
    *(.text._ZNSt7__cxx1112basic_stringIcSt11char_traitsIcESaIcEE9_M_assignERKS4_)
    *(.text._ZNSt7__cxx1112basic_stringIcSt11char_traitsIcESaIcEE9_M_mutateEmmPKcm)
    *(.text._ZNSt7__cxx1112basic_stringIcSt11char_traitsIcESaIcEE8_M_eraseEmm)
    *(.text._ZNSt7__cxx1112basic_stringIcSt11char_traitsIcESaIcEEC1Ev)
    *(.text._ZNSt7__cxx1112basic_stringIcSt11char_traitsIcESaIcEEC2Ev)
    *(.text._ZNSt7__cxx1112basic_stringIcSt11char_traitsIcESaIcEEC1ERKS3_)
    *(.text._ZNSt7__cxx1112basic_stringIcSt11char_traitsIcESaIcEEC2ERKS3_)
    *(.text._ZNSt7__cxx1112basic_stringIcSt11char_traitsIcESaIcEEC1EmcRKS3_)
    *(.text._ZNSt7__cxx1112basic_stringIcSt11char_traitsIcESaIcEEC2EmcRKS3_)
    *(.text._ZNSt7__cxx1112basic_stringIcSt11char_traitsIcESaIcEEC1EOS4_)
    *(.text._ZNSt7__cxx1112basic_stringIcSt11char_traitsIcESaIcEEC2EOS4_)
    *(.text._ZNSt7__cxx1112basic_stringIcSt11char_traitsIcESaIcEEC1EOS4_RKS3_)
    *(.text._ZNSt7__cxx1112basic_stringIcSt11char_traitsIcESaIcEEC2EOS4_RKS3_)
    *(.text._ZNSt7__cxx1112basic_stringIcSt11char_traitsIcESaIcEED1Ev)
    *(.text._ZNSt7__cxx1112basic_stringIcSt11char_traitsIcESaIcEED2Ev)
    *(.text._ZNSt7__cxx1112basic_stringIcSt11char_traitsIcESaIcEEaSERKS4_)
    *(.text._ZNSt7__cxx1112basic_stringIcSt11char_traitsIcESaIcEEaSEOS4_)
    *(.text._ZNSt7__cxx1112basic_stringIcSt11char_traitsIcESaIcEE5beginEv)
    *(.text._ZNKSt7__cxx1112basic_stringIcSt11char_traitsIcESaIcEE5beginEv)
    *(.text._ZNSt7__cxx1112basic_stringIcSt11char_traitsIcESaIcEE3endEv)
    *(.text._ZNKSt7__cxx1112basic_stringIcSt11char_traitsIcESaIcEE3endEv)
    *(.text._ZNSt7__cxx1112basic_stringIcSt11char_traitsIcESaIcEE6rbeginEv)
    *(.text._ZNKSt7__cxx1112basic_stringIcSt11char_traitsIcESaIcEE6rbeginEv)
    *(.text._ZNSt7__cxx1112basic_stringIcSt11char_traitsIcESaIcEE4rendEv)
    *(.text._ZNKSt7__cxx1112basic_stringIcSt11char_traitsIcESaIcEE4rendEv)
    *(.text._ZNKSt7__cxx1112basic_stringIcSt11char_traitsIcESaIcEE6cbeginEv)
    *(.text._ZNKSt7__cxx1112basic_stringIcSt11char_traitsIcESaIcEE4cendEv)
    *(.text._ZNKSt7__cxx1112basic_stringIcSt11char_traitsIcESaIcEE7crbeginEv)
    *(.text._ZNKSt7__cxx1112basic_stringIcSt11char_traitsIcESaIcEE5crendEv)
    *(.text._ZNKSt7__cxx1112basic_stringIcSt11char_traitsIcESaIcEE4sizeEv)
    *(.text._ZNKSt7__cxx1112basic_stringIcSt11char_traitsIcESaIcEE6lengthEv)
    *(.text._ZNKSt7__cxx1112basic_stringIcSt11char_traitsIcESaIcEE8max_sizeEv)
    *(.text._ZNKSt7__cxx1112basic_stringIcSt11char_traitsIcESaIcEE8capacityEv)
    *(.text._ZNSt7__cxx1112basic_stringIcSt11char_traitsIcESaIcEE7reserveEm)
    *(.text._ZNSt7__cxx1112basic_stringIcSt11char_traitsIcESaIcEE7reserveEv)
    *(.text._ZNSt7__cxx1112basic_stringIcSt11char_traitsIcESaIcEE13shrink_to_fitEv)
    *(.text._ZNSt7__cxx1112basic_stringIcSt11char_traitsIcESaIcEE5clearEv)
    *(.text._ZNKSt7__cxx1112basic_stringIcSt11char_traitsIcESaIcEE5emptyEv)
    *(.text._ZNKSt7__cxx1112basic_stringIcSt11char_traitsIcESaIcEEixEm)
    *(.text._ZNSt7__cxx1112basic_stringIcSt11char_traitsIcESaIcEEixEm)
    *(.text._ZNKSt7__cxx1112basic_stringIcSt11char_traitsIcESaIcEE2atEm)
    *(.text._ZNSt7__cxx1112basic_stringIcSt11char_traitsIcESaIcEE2atEm)
    *(.text._ZNSt7__cxx1112basic_stringIcSt11char_traitsIcESaIcEE5frontEv)
    *(.text._ZNKSt7__cxx1112basic_stringIcSt11char_traitsIcESaIcEE5frontEv)
    *(.text._ZNSt7__cxx1112basic_stringIcSt11char_traitsIcESaIcEE4backEv)
    *(.text._ZNKSt7__cxx1112basic_stringIcSt11char_traitsIcESaIcEE4backEv)
    *(.text._ZNSt7__cxx1112basic_stringIcSt11char_traitsIcESaIcEEpLEc)
    *(.text._ZNSt7__cxx1112basic_stringIcSt11char_traitsIcESaIcEE9push_backEc)
    *(.text._ZNSt7__cxx1112basic_stringIcSt11char_traitsIcESaIcEE6assignERKS4_)
    *(.text._ZNSt7__cxx1112basic_stringIcSt11char_traitsIcESaIcEE6assignEOS4_)
    *(.text._ZNSt7__cxx1112basic_stringIcSt11char_traitsIcESaIcEE5eraseEmm)
    *(.text._ZNSt7__cxx1112basic_stringIcSt11char_traitsIcESaIcEE5eraseEN9__gnu_cxx17__normal_iteratorIPKcS4_EE)
    *(.text._ZNSt7__cxx1112basic_stringIcSt11char_traitsIcESaIcEE5eraseEN9__gnu_cxx17__normal_iteratorIPKcS4_EES9_)
    *(.text._ZNSt7__cxx1112basic_stringIcSt11char_traitsIcESaIcEE8pop_backEv)
    *(.text._ZNSt7__cxx1112basic_stringIcSt11char_traitsIcESaIcEE14_M_replace_auxEmmmc)
    *(.text._ZNSt7__cxx1112basic_stringIcSt11char_traitsIcESaIcEE6appendEmc)
    *(.text._ZNSt7__cxx1112basic_stringIcSt11char_traitsIcESaIcEE6assignEmc)
    *(.text._ZNSt7__cxx1112basic_stringIcSt11char_traitsIcESaIcEE6insertEmmc)
    *(.text._ZNSt7__cxx1112basic_stringIcSt11char_traitsIcESaIcEE6insertEN9__gnu_cxx17__normal_iteratorIPKcS4_EEc)
    *(.text._ZNSt7__cxx1112basic_stringIcSt11char_traitsIcESaIcEE7replaceEmmmc)
    *(.text._ZNSt7__cxx1112basic_stringIcSt11char_traitsIcESaIcEE7replaceEN9__gnu_cxx17__normal_iteratorIPKcS4_EES9_mc)
    *(.text._ZNSt7__cxx1112basic_stringIcSt11char_traitsIcESaIcEEaSEc)
    *(.text._ZNSt7__cxx1112basic_stringIcSt11char_traitsIcESaIcEE6insertEN9__gnu_cxx17__normal_iteratorIPKcS4_EEmc)
    *(.text._ZNSt7__cxx1112basic_stringIcSt11char_traitsIcESaIcEE6resizeEmc)
    *(.text._ZNSt7__cxx1112basic_stringIcSt11char_traitsIcESaIcEE6resizeEm)
    *(.text._ZNSt7__cxx1112basic_stringIcSt11char_traitsIcESaIcEE10_M_replaceEmmPKcm)
    *(.text._ZNSt7__cxx1112basic_stringIcSt11char_traitsIcESaIcEE6assignERKS4_mm)
    *(.text._ZNSt7__cxx1112basic_stringIcSt11char_traitsIcESaIcEE6assignEPKcm)
    *(.text._ZNSt7__cxx1112basic_stringIcSt11char_traitsIcESaIcEE6assignEPKc)
    *(.text._ZNSt7__cxx1112basic_stringIcSt11char_traitsIcESaIcEE7replaceEmmPKcm)
    *(.text._ZNSt7__cxx1112basic_stringIcSt11char_traitsIcESaIcEEaSESt16initializer_listIcE)
    *(.text._ZNSt7__cxx1112basic_stringIcSt11char_traitsIcESaIcEEaSEPKc)
    *(.text._ZNSt7__cxx1112basic_stringIcSt11char_traitsIcESaIcEE6insertEmPKcm)
    *(.text._ZNSt7__cxx1112basic_stringIcSt11char_traitsIcESaIcEE6insertEmRKS4_)
    *(.text._ZNSt7__cxx1112basic_stringIcSt11char_traitsIcESaIcEE7replaceEmmRKS4_)
    *(.text._ZNSt7__cxx1112basic_stringIcSt11char_traitsIcESaIcEE6insertEmPKc)
    *(.text._ZNSt7__cxx1112basic_stringIcSt11char_traitsIcESaIcEE7replaceEmmPKc)
    *(.text._ZNKSt9money_getIwSt19istreambuf_iteratorIwSt11char_traitsIwEEE10_M_extractILb0EEES3_S3_S3_RSt8ios_baseRSt12_Ios_IostateRSs)
    *(.text._ZNKSt9money_getIwSt19istreambuf_iteratorIwSt11char_traitsIwEEE6do_getES3_S3_bRSt8ios_baseRSt12_Ios_IostateRe)
    *(.text._ZNKSt9money_getIwSt19istreambuf_iteratorIwSt11char_traitsIwEEE6do_getES3_S3_bRSt8ios_baseRSt12_Ios_IostateRSbIwS2_SaIwEE)
    *(.text._ZNSt11char_traitsIwE4copyEPwPKwm.isra.0)
    *(.text._ZNSt11char_traitsIwE4moveEPwPKwm.isra.0)
    *(.text._ZNSt7__cxx1112basic_stringIwSt11char_traitsIwESaIwEE11_S_allocateERS3_m)
    *(.text._ZNSt7__cxx1112basic_stringIwSt11char_traitsIwESaIwEE7_M_dataEPw)
    *(.text._ZNSt7__cxx1112basic_stringIwSt11char_traitsIwESaIwEE9_M_lengthEm)
    *(.text._ZNKSt7__cxx1112basic_stringIwSt11char_traitsIwESaIwEE7_M_dataEv)
    *(.text._ZNSt7__cxx1112basic_stringIwSt11char_traitsIwESaIwEE13_M_local_dataEv)
    *(.text._ZNKSt7__cxx1112basic_stringIwSt11char_traitsIwESaIwEE13_M_local_dataEv)
    *(.text._ZNSt7__cxx1112basic_stringIwSt11char_traitsIwESaIwEE11_M_capacityEm)
    *(.text._ZNSt7__cxx1112basic_stringIwSt11char_traitsIwESaIwEE13_M_set_lengthEm)
    *(.text._ZNKSt7__cxx1112basic_stringIwSt11char_traitsIwESaIwEE11_M_is_localEv)
    *(.text._ZNSt7__cxx1112basic_stringIwSt11char_traitsIwESaIwEE9_M_createERmm)
    *(.text._ZNSt7__cxx1112basic_stringIwSt11char_traitsIwESaIwEE10_M_disposeEv)
    *(.text._ZNSt7__cxx1112basic_stringIwSt11char_traitsIwESaIwEE10_M_destroyEm)
    *(.text._ZNSt7__cxx1112basic_stringIwSt11char_traitsIwESaIwEE12_M_constructEmw)
    *(.text._ZNSt7__cxx1112basic_stringIwSt11char_traitsIwESaIwEE18_M_construct_aux_2Emw)
    *(.text._ZNSt7__cxx1112basic_stringIwSt11char_traitsIwESaIwEE16_M_get_allocatorEv)
    *(.text._ZNKSt7__cxx1112basic_stringIwSt11char_traitsIwESaIwEE16_M_get_allocatorEv)
    *(.text._ZNSt7__cxx1112basic_stringIwSt11char_traitsIwESaIwEE17_M_init_local_bufEv)
    *(.text._ZNSt7__cxx1112basic_stringIwSt11char_traitsIwESaIwEE17_M_use_local_dataEv)
    *(.text._ZNKSt7__cxx1112basic_stringIwSt11char_traitsIwESaIwEE8_M_checkEmPKc)
    *(.text._ZNKSt7__cxx1112basic_stringIwSt11char_traitsIwESaIwEE15_M_check_lengthEmmPKc)
    *(.text._ZNKSt7__cxx1112basic_stringIwSt11char_traitsIwESaIwEE8_M_limitEmm)
    *(.text._ZNKSt7__cxx1112basic_stringIwSt11char_traitsIwESaIwEE11_M_disjunctEPKw)
    *(.text._ZNSt7__cxx1112basic_stringIwSt11char_traitsIwESaIwEE7_S_copyEPwPKwm)
    *(.text._ZNSt7__cxx1112basic_stringIwSt11char_traitsIwESaIwEE7_S_moveEPwPKwm)
    *(.text._ZNSt7__cxx1112basic_stringIwSt11char_traitsIwESaIwEE9_S_assignEPwmw)
    *(.text._ZNSt7__cxx1112basic_stringIwSt11char_traitsIwESaIwEE13_S_copy_charsEPwN9__gnu_cxx17__normal_iteratorIS5_S4_EES8_)
    *(.text._ZNSt7__cxx1112basic_stringIwSt11char_traitsIwESaIwEE13_S_copy_charsEPwN9__gnu_cxx17__normal_iteratorIPKwS4_EESA_)
    *(.text._ZNSt7__cxx1112basic_stringIwSt11char_traitsIwESaIwEE13_S_copy_charsEPwS5_S5_)
    *(.text._ZNSt7__cxx1112basic_stringIwSt11char_traitsIwESaIwEE13_S_copy_charsEPwPKwS7_)
    *(.text._ZNSt7__cxx1112basic_stringIwSt11char_traitsIwESaIwEE10_S_compareEmm)
    *(.text._ZNSt7__cxx1112basic_stringIwSt11char_traitsIwESaIwEE9_M_assignERKS4_)
    *(.text._ZNSt7__cxx1112basic_stringIwSt11char_traitsIwESaIwEE9_M_mutateEmmPKwm)
    *(.text._ZNSt7__cxx1112basic_stringIwSt11char_traitsIwESaIwEE8_M_eraseEmm)
    *(.text._ZNSt7__cxx1112basic_stringIwSt11char_traitsIwESaIwEEC1Ev)
    *(.text._ZNSt7__cxx1112basic_stringIwSt11char_traitsIwESaIwEEC2Ev)
    *(.text._ZNSt7__cxx1112basic_stringIwSt11char_traitsIwESaIwEEC1ERKS3_)
    *(.text._ZNSt7__cxx1112basic_stringIwSt11char_traitsIwESaIwEEC2ERKS3_)
    *(.text._ZNSt7__cxx1112basic_stringIwSt11char_traitsIwESaIwEEC1EmwRKS3_)
    *(.text._ZNSt7__cxx1112basic_stringIwSt11char_traitsIwESaIwEEC2EmwRKS3_)
    *(.text._ZNSt7__cxx1112basic_stringIwSt11char_traitsIwESaIwEEC1EOS4_)
    *(.text._ZNSt7__cxx1112basic_stringIwSt11char_traitsIwESaIwEEC2EOS4_)
    *(.text._ZNSt7__cxx1112basic_stringIwSt11char_traitsIwESaIwEEC1EOS4_RKS3_)
    *(.text._ZNSt7__cxx1112basic_stringIwSt11char_traitsIwESaIwEEC2EOS4_RKS3_)
    *(.text._ZNSt7__cxx1112basic_stringIwSt11char_traitsIwESaIwEED1Ev)
    *(.text._ZNSt7__cxx1112basic_stringIwSt11char_traitsIwESaIwEED2Ev)
    *(.text._ZNSt7__cxx1112basic_stringIwSt11char_traitsIwESaIwEEaSERKS4_)
    *(.text._ZNSt7__cxx1112basic_stringIwSt11char_traitsIwESaIwEEaSEOS4_)
    *(.text._ZNSt7__cxx1112basic_stringIwSt11char_traitsIwESaIwEE5beginEv)
    *(.text._ZNKSt7__cxx1112basic_stringIwSt11char_traitsIwESaIwEE5beginEv)
    *(.text._ZNSt7__cxx1112basic_stringIwSt11char_traitsIwESaIwEE3endEv)
    *(.text._ZNKSt7__cxx1112basic_stringIwSt11char_traitsIwESaIwEE3endEv)
    *(.text._ZNSt7__cxx1112basic_stringIwSt11char_traitsIwESaIwEE6rbeginEv)
    *(.text._ZNKSt7__cxx1112basic_stringIwSt11char_traitsIwESaIwEE6rbeginEv)
    *(.text._ZNSt7__cxx1112basic_stringIwSt11char_traitsIwESaIwEE4rendEv)
    *(.text._ZNKSt7__cxx1112basic_stringIwSt11char_traitsIwESaIwEE4rendEv)
    *(.text._ZNKSt7__cxx1112basic_stringIwSt11char_traitsIwESaIwEE6cbeginEv)
    *(.text._ZNKSt7__cxx1112basic_stringIwSt11char_traitsIwESaIwEE4cendEv)
    *(.text._ZNKSt7__cxx1112basic_stringIwSt11char_traitsIwESaIwEE7crbeginEv)
    *(.text._ZNKSt7__cxx1112basic_stringIwSt11char_traitsIwESaIwEE5crendEv)
    *(.text._ZNKSt7__cxx1112basic_stringIwSt11char_traitsIwESaIwEE4sizeEv)
    *(.text._ZNKSt7__cxx1112basic_stringIwSt11char_traitsIwESaIwEE6lengthEv)
    *(.text._ZNKSt7__cxx1112basic_stringIwSt11char_traitsIwESaIwEE8max_sizeEv)
    *(.text._ZNKSt7__cxx1112basic_stringIwSt11char_traitsIwESaIwEE8capacityEv)
    *(.text._ZNSt7__cxx1112basic_stringIwSt11char_traitsIwESaIwEE7reserveEm)
    *(.text._ZNSt7__cxx1112basic_stringIwSt11char_traitsIwESaIwEE7reserveEv)
    *(.text._ZNSt7__cxx1112basic_stringIwSt11char_traitsIwESaIwEE13shrink_to_fitEv)
    *(.text._ZNSt7__cxx1112basic_stringIwSt11char_traitsIwESaIwEE5clearEv)
    *(.text._ZNKSt7__cxx1112basic_stringIwSt11char_traitsIwESaIwEE5emptyEv)
    *(.text._ZNKSt7__cxx1112basic_stringIwSt11char_traitsIwESaIwEEixEm)
    *(.text._ZNSt7__cxx1112basic_stringIwSt11char_traitsIwESaIwEEixEm)
    *(.text._ZNKSt7__cxx1112basic_stringIwSt11char_traitsIwESaIwEE2atEm)
    *(.text._ZNSt7__cxx1112basic_stringIwSt11char_traitsIwESaIwEE2atEm)
    *(.text._ZNSt7__cxx1112basic_stringIwSt11char_traitsIwESaIwEE5frontEv)
    *(.text._ZNKSt7__cxx1112basic_stringIwSt11char_traitsIwESaIwEE5frontEv)
    *(.text._ZNSt7__cxx1112basic_stringIwSt11char_traitsIwESaIwEE4backEv)
    *(.text._ZNKSt7__cxx1112basic_stringIwSt11char_traitsIwESaIwEE4backEv)
    *(.text._ZNSt7__cxx1112basic_stringIwSt11char_traitsIwESaIwEEpLEw)
    *(.text._ZNSt7__cxx1112basic_stringIwSt11char_traitsIwESaIwEE9push_backEw)
    *(.text._ZNSt7__cxx1112basic_stringIwSt11char_traitsIwESaIwEE6assignERKS4_)
    *(.text._ZNSt7__cxx1112basic_stringIwSt11char_traitsIwESaIwEE6assignEOS4_)
    *(.text._ZNSt7__cxx1112basic_stringIwSt11char_traitsIwESaIwEE5eraseEmm)
    *(.text._ZNSt7__cxx1112basic_stringIwSt11char_traitsIwESaIwEE5eraseEN9__gnu_cxx17__normal_iteratorIPKwS4_EE)
    *(.text._ZNSt7__cxx1112basic_stringIwSt11char_traitsIwESaIwEE5eraseEN9__gnu_cxx17__normal_iteratorIPKwS4_EES9_)
    *(.text._ZNSt7__cxx1112basic_stringIwSt11char_traitsIwESaIwEE8pop_backEv)
    *(.text._ZNSt7__cxx1112basic_stringIwSt11char_traitsIwESaIwEE14_M_replace_auxEmmmw)
    *(.text._ZNSt7__cxx1112basic_stringIwSt11char_traitsIwESaIwEE6appendEmw)
    *(.text._ZNSt7__cxx1112basic_stringIwSt11char_traitsIwESaIwEE6assignEmw)
    *(.text._ZNSt7__cxx1112basic_stringIwSt11char_traitsIwESaIwEE6insertEmmw)
    *(.text._ZNSt7__cxx1112basic_stringIwSt11char_traitsIwESaIwEE6insertEN9__gnu_cxx17__normal_iteratorIPKwS4_EEw)
    *(.text._ZNSt7__cxx1112basic_stringIwSt11char_traitsIwESaIwEE7replaceEmmmw)
    *(.text._ZNSt7__cxx1112basic_stringIwSt11char_traitsIwESaIwEE7replaceEN9__gnu_cxx17__normal_iteratorIPKwS4_EES9_mw)
    *(.text._ZNSt7__cxx1112basic_stringIwSt11char_traitsIwESaIwEEaSEw)
    *(.text._ZNSt7__cxx1112basic_stringIwSt11char_traitsIwESaIwEE6insertEN9__gnu_cxx17__normal_iteratorIPKwS4_EEmw)
    *(.text._ZNSt7__cxx1112basic_stringIwSt11char_traitsIwESaIwEE6resizeEmw)
    *(.text._ZNSt7__cxx1112basic_stringIwSt11char_traitsIwESaIwEE6resizeEm)
    *(.text._ZNSt7__cxx1112basic_stringIwSt11char_traitsIwESaIwEE10_M_replaceEmmPKwm)
    *(.text._ZNSt7__cxx1112basic_stringIwSt11char_traitsIwESaIwEE6assignERKS4_mm)
    *(.text._ZNSt7__cxx1112basic_stringIwSt11char_traitsIwESaIwEE6assignEPKwm)
    *(.text._ZNSt7__cxx1112basic_stringIwSt11char_traitsIwESaIwEE6assignEPKw)
    *(.text._ZNSt7__cxx1112basic_stringIwSt11char_traitsIwESaIwEE7replaceEmmPKwm)
    *(.text._ZNSt7__cxx1112basic_stringIwSt11char_traitsIwESaIwEEaSESt16initializer_listIwE)
    *(.text._ZNSt7__cxx1112basic_stringIwSt11char_traitsIwESaIwEEaSEPKw)
    *(.text._ZNSt7__cxx1112basic_stringIwSt11char_traitsIwESaIwEE6insertEmPKwm)
    *(.text._ZNSt7__cxx1112basic_stringIwSt11char_traitsIwESaIwEE6insertEmRKS4_)
    *(.text._ZNSt7__cxx1112basic_stringIwSt11char_traitsIwESaIwEE7replaceEmmRKS4_)
    *(.text._ZNSt7__cxx1112basic_stringIwSt11char_traitsIwESaIwEE6insertEmPKw)
    *(.text._ZNSt7__cxx1112basic_stringIwSt11char_traitsIwESaIwEE7replaceEmmPKw)
    *(.text._ZNSt7__cxx1112basic_stringIwSt11char_traitsIwESaIwEE7replaceEN9__gnu_cxx17__normal_iteratorIPKwS4_EES9_S8_m)
    *(.text._ZNSt7__cxx1112basic_stringIwSt11char_traitsIwESaIwEE7replaceEN9__gnu_cxx17__normal_iteratorIPKwS4_EES9_RKS4_)
    *(.text._ZNSt7__cxx1112basic_stringIwSt11char_traitsIwESaIwEE7replaceEN9__gnu_cxx17__normal_iteratorIPKwS4_EES9_St16initializer_listIwE)
    *(.text._ZNSt7__cxx1112basic_stringIwSt11char_traitsIwESaIwEE7replaceEN9__gnu_cxx17__normal_iteratorIPKwS4_EES9_S8_)
    *(.text._ZNSt7__cxx1112basic_stringIwSt11char_traitsIwESaIwEE7replaceEN9__gnu_cxx17__normal_iteratorIPKwS4_EES9_PwSA_)
    *(.text._ZNSt7__cxx1112basic_stringIwSt11char_traitsIwESaIwEE7replaceEN9__gnu_cxx17__normal_iteratorIPKwS4_EES9_S8_S8_)
    *(.text._ZNSt7__cxx1112basic_stringIwSt11char_traitsIwESaIwEE6insertEN9__gnu_cxx17__normal_iteratorIPwS4_EESt16initializer_listIwE)
    *(.text._ZNSt7__cxx1112basic_stringIwSt11char_traitsIwESaIwEE7replaceEN9__gnu_cxx17__normal_iteratorIPKwS4_EES9_NS6_IPwS4_EESB_)
    *(.text._ZNSt7__cxx1112basic_stringIwSt11char_traitsIwESaIwEE7replaceEN9__gnu_cxx17__normal_iteratorIPKwS4_EES9_S9_S9_)
    *(.text._ZNSt7__cxx1112basic_stringIwSt11char_traitsIwESaIwEE6insertEmRKS4_mm)
    *(.text._ZNSt7__cxx1112basic_stringIwSt11char_traitsIwESaIwEE7replaceEmmRKS4_mm)
    *(.text._ZNSt7__cxx1112basic_stringIwSt11char_traitsIwESaIwEE6insertEN9__gnu_cxx17__normal_iteratorIPKwS4_EESt16initializer_listIwE)
    *(.text._ZNSt7__cxx1112basic_stringIwSt11char_traitsIwESaIwEE9_M_appendEPKwm)
    *(.text._ZNSt7__cxx1112basic_stringIwSt11char_traitsIwESaIwEE6appendEPKwm)
    *(.text._ZNSt7__cxx1112basic_stringIwSt11char_traitsIwESaIwEE6appendEPKw)
    *(.text._ZNSt7__cxx1112basic_stringIwSt11char_traitsIwESaIwEEpLEPKw)
    *(.text._ZNSt7__cxx1112basic_stringIwSt11char_traitsIwESaIwEEpLESt16initializer_listIwE)
    *(.text._ZNSt7__cxx1112basic_stringIwSt11char_traitsIwESaIwEE6appendERKS4_)
    *(.text._ZNSt7__cxx1112basic_stringIwSt11char_traitsIwESaIwEEpLERKS4_)
    *(.text._ZNSt7__cxx1112basic_stringIwSt11char_traitsIwESaIwEE6appendESt16initializer_listIwE)
    *(.text._ZNSt7__cxx1112basic_stringIwSt11char_traitsIwESaIwEE6appendERKS4_mm)
    *(.text._ZNKSt7__cxx1112basic_stringIwSt11char_traitsIwESaIwEE4copyEPwmm)
    *(.text._ZNSt7__cxx1112basic_stringIwSt11char_traitsIwESaIwEE4swapERS4_)
    *(.text._ZNKSt7__cxx1112basic_stringIwSt11char_traitsIwESaIwEE5c_strEv)
    *(.text._ZNKSt7__cxx1112basic_stringIwSt11char_traitsIwESaIwEE4dataEv)
    *(.text._ZNKSt7__cxx1112basic_stringIwSt11char_traitsIwESaIwEE13get_allocatorEv)
    *(.text._ZNKSt7__cxx1112basic_stringIwSt11char_traitsIwESaIwEE4findEPKwmm)
    *(.text._ZNKSt7__cxx1112basic_stringIwSt11char_traitsIwESaIwEE4findERKS4_m)
    *(.text._ZNKSt7__cxx1112basic_stringIwSt11char_traitsIwESaIwEE4findEPKwm)
    *(.text._ZNKSt7__cxx1112basic_stringIwSt11char_traitsIwESaIwEE4findEwm)
    *(.text._ZNKSt7__cxx1112basic_stringIwSt11char_traitsIwESaIwEE5rfindEPKwmm)
    *(.text._ZNKSt7__cxx1112basic_stringIwSt11char_traitsIwESaIwEE5rfindERKS4_m)
    *(.text._ZNKSt7__cxx1112basic_stringIwSt11char_traitsIwESaIwEE5rfindEPKwm)
    *(.text._ZNKSt7__cxx1112basic_stringIwSt11char_traitsIwESaIwEE5rfindEwm)
    *(.text._ZNKSt7__cxx1112basic_stringIwSt11char_traitsIwESaIwEE13find_first_ofEPKwmm)
    *(.text._ZdlPv)
    *(.text._ZdlPvmSt11align_val_t)
    *(.text.__dynamic_cast)
    *(.text.__cxa_current_exception_type)
    *(.text._ZN10__cxxabiv123__fundamental_type_infoD1Ev)
    *(.text._ZN10__cxxabiv123__fundamental_type_infoD2Ev)
    *(.text._ZN10__cxxabiv123__fundamental_type_infoD0Ev)
    *(.text._ZSt15set_new_handlerPFvvE)
    *(.text._ZSt15get_new_handlerv)
    *(.text._ZnwmSt11align_val_t)
    *(.text._ZnamRKSt9nothrow_t)
    *(.text._ZNK10__cxxabiv117__pbase_type_info15__pointer_catchEPKS0_PPvj)
    *(.text._ZN10__cxxabiv117__pbase_type_infoD1Ev)
    *(.text._ZN10__cxxabiv117__pbase_type_infoD2Ev)
    *(.text._ZN10__cxxabiv117__pbase_type_infoD0Ev)
    *(.text._ZNK10__cxxabiv117__pbase_type_info10__do_catchEPKSt9type_infoPPvj)
    *(.text._ZN10__cxxabiv129__pointer_to_member_type_infoD1Ev)
    *(.text._ZN10__cxxabiv129__pointer_to_member_type_infoD2Ev)
    *(.text._ZN10__cxxabiv129__pointer_to_member_type_infoD0Ev)
    *(.text._ZNK10__cxxabiv129__pointer_to_member_type_info15__pointer_catchEPKNS_17__pbase_type_infoEPPvj)
    *(.text._ZNSt8CatalogsD1Ev)
    *(.text._ZNSt8CatalogsD2Ev)
    *(.text._ZSt14__convert_to_vIfEvPKcRT_RSt12_Ios_IostateRKP15__locale_struct)
    *(.text._ZSt14__convert_to_vIdEvPKcRT_RSt12_Ios_IostateRKP15__locale_struct)
    *(.text._ZSt14__convert_to_vIeEvPKcRT_RSt12_Ios_IostateRKP15__locale_struct)
    *(.text._ZNSt6locale5facet18_S_create_c_localeERP15__locale_structPKcS2_)
    *(.text._ZNSt6locale5facet19_S_destroy_c_localeERP15__locale_struct)
    *(.text._ZNSt6locale5facet17_S_clone_c_localeERP15__locale_struct)
    *(.text._ZNSt13basic_istreamIwSt11char_traitsIwEE6ignoreEl)
    *(.text._ZSt9has_facetINSt7__cxx118time_getIcSt19istreambuf_iteratorIcSt11char_traitsIcEEEEEbRKSt6locale)
    *(.text._ZSt15__try_use_facetINSt7__cxx118messagesIcEEEPKT_RKSt6locale)
    *(.text._ZSt9use_facetINSt7__cxx118messagesIcEEERKT_RKSt6locale)
    *(.text._ZSt9has_facetINSt7__cxx118messagesIcEEEbRKSt6locale)
    *(.text._ZNK12_GLOBAL__N_117io_error_category4nameEv)
    *(.text._ZN12_GLOBAL__N_113constant_initD1Ev)
    *(.text._ZN12_GLOBAL__N_113constant_initD2Ev)
    *(.text._ZN12_GLOBAL__N_117io_error_categoryD1Ev)
    *(.text._ZN12_GLOBAL__N_117io_error_categoryD2Ev)
    *(.text._ZN12_GLOBAL__N_117io_error_categoryD0Ev)
    *(.text._ZNSt7__cxx1112basic_stringIcSt11char_traitsIcESaIcEE10_M_replaceEmmPKcm.isra.0)
    *(.text._ZNK12_GLOBAL__N_117io_error_category7messageB5cxx11Ei)
    *(.text._ZSt17iostream_categoryv)
    *(.text._ZNSi6ignoreEl)
    *(.text.__popcountdi2)
    *(.text.__mulsc3)
    *(.text.__muldc3)
    *(.text.__floattidf)
    *(.text.__udivti3)
    *(.text.__udivmodti4)
  }
}
INSERT BEFORE .text;
